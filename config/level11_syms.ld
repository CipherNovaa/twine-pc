/* Generated by tools/port_level.py: LEVEL01 names (L1_ prefix) bound to level11's symbols. */
L1_AddPrim = func_80088D58;
L1_ApplyMatrix = func_8008BA38;
L1_ApplyMatrixLV = func_80079D28;
L1_ApplyMatrixSV = func_8008DBAC;
L1_CALLOC3_OBJ_54 = func_8008AF1C;
func_8004B72C = L1_Camera_ResetZoom;
func_8002C3F8 = L1_CdBin_Disable;
func_8002C43C = L1_CdBin_Enable;
func_8002C558 = L1_CdBin_SetLevel;
L1_CdInit = func_80085020;
L1_CdSearchFile = func_80082B84;
L1_ChangeClearPAD = func_800922E0;
L1_ChangeClearRCnt = func_800922F0;
L1_Cheat_AllWeapons = func_8002E468;
func_8002DE48 = L1_Cheat_CheckCodes;
func_8002DB54 = L1_Cheat_DoAction;
L1_Cheat_RefillAmmo = func_8002E4AC;
L1_Cheat_ResetCodes = func_8002E314;
L1_CloseEvent = func_80080A4C;
L1_D_80082604 = func_80081C18;
L1_D_80095808 = D_80094EAC;
L1_D_8009C180 = D_8009B824;
L1_D_8009C1EC = D_8009B890;
L1_D_8009C1ED = D_8009B891;
L1_D_8009C1F0 = D_8009B894;
L1_D_8009C1F4 = D_8009B898;
L1_D_8009C1F8 = D_8009B89C;
L1_D_8009C200 = D_8009B8A4;
L1_D_8009C204 = D_8009B8A8;
L1_D_8009C208 = D_8009B8AC;
L1_D_8009C20A = D_8009B8AE;
L1_D_8009C20C = D_8009B8B0;
L1_D_8009CA56 = D_8009C0FA;
L1_D_8009CA58 = D_8009C0FC;
L1_D_8009CA59 = D_8009C0FD;
L1_D_8009CA5A = D_8009C0FE;
L1_D_8009CA5C = D_8009C100;
L1_D_8009CA5E = D_8009C102;
L1_D_8009CA60 = D_8009C104;
L1_D_8009CA64 = D_8009C108;
L1_D_8009CA68 = D_8009C10C;
L1_D_8009CA6C = D_8009C110;
L1_D_8009CA70 = D_8009C114;
L1_D_8009CA74 = D_8009C118;
L1_D_8009CA78 = D_8009C11C;
L1_D_8009CA7C = D_8009C120;
L1_D_8009CA80 = D_8009C124;
L1_D_8009CA84 = D_8009C128;
L1_D_8009CA8C = D_8009C130;
L1_D_8009CA90 = D_8009C134;
L1_D_8009CA94 = D_8009C138;
L1_D_8009CA9C = D_8009C140;
L1_D_8009CAA0 = D_8009C144;
L1_D_8009CAA4 = D_8009C148;
L1_D_8009CAA8 = D_8009C14C;
L1_D_8009CAAC = D_8009C150;
L1_D_8009CAB0 = D_8009C154;
L1_D_8009CABD = D_8009C161;
L1_D_8009CABE = D_8009C162;
L1_D_8009CABF = D_8009C163;
L1_D_8009CAC0 = D_8009C164;
L1_D_8009CAC4 = D_8009C168;
L1_D_8009CACC = D_8009C170;
L1_D_8009CAD0 = D_8009C174;
L1_D_8009CD00 = D_8009C3A4;
L1_D_8009CD30 = D_8009C3D4;
L1_D_8009CD3C = D_8009C3E0;
L1_D_8009CD4C = D_8009C3F0;
L1_D_8009CD50 = D_8009C3F4;
L1_D_8009CD54 = D_8009C3F8;
L1_D_8009CD58 = D_8009C3FC;
L1_D_8009CD5C = D_8009C400;
L1_D_8009CD5E = D_8009C402;
L1_D_8009CD60 = D_8009C404;
L1_D_8009CD62 = D_8009C406;
L1_D_8009CD6C = D_8009C410;
L1_D_8009CD6E = D_8009C412;
L1_D_8009CD80 = D_8009C424;
L1_D_8009CD88 = D_8009C42C;
L1_D_8009CD8C = D_8009C430;
L1_D_8009CD98 = D_8009C43C;
L1_D_8009CDA0 = D_8009C444;
L1_D_8009CDA2 = D_8009C446;
L1_D_8009CDA8 = D_8009C44C;
L1_D_8009CDC0 = D_8009C464;
L1_D_8009CDC4 = D_8009C468;
L1_D_8009CDD0 = D_8009C474;
L1_D_8009CDD4 = D_8009C478;
L1_D_8009CDD8 = D_8009C47C;
L1_D_8009CDDC = D_8009C480;
L1_D_8009CDE4 = D_8009C488;
L1_D_8009CDE5 = D_8009C489;
L1_D_8009CDE6 = D_8009C48A;
L1_D_8009CDE8 = D_8009C48C;
L1_D_8009CDEC = D_8009C490;
L1_D_8009CDF0 = D_8009C494;
L1_D_8009CE20 = D_8009C4C4;
L1_D_8009CE28 = D_8009C4CC;
L1_D_8009CE38 = D_8009C4DC;
L1_D_8009CE44 = D_8009C4E8;
L1_D_8009CEB0 = D_8009C554;
L1_D_8009CEE0 = D_8009C584;
L1_D_8009CF10 = D_8009C5B4;
L1_D_8009CF14 = D_8009C5B8;
L1_D_8009CF2C = D_8009C5D0;
L1_D_8009CF30 = D_8009C5D4;
L1_D_8009CF48 = D_8009C5EC;
L1_D_8009CF4C = D_8009C5F0;
L1_D_8009CF50 = D_8009C5F4;
L1_D_8009CF54 = D_8009C5F8;
L1_D_8009CF68 = D_8009C608;
L1_D_8009CF6C = D_8009C60C;
L1_D_8009CF70 = D_8009C610;
L1_D_8009CF74 = D_8009C614;
L1_D_8009CF79 = D_8009C619;
L1_D_8009CF7C = D_8009C61C;
L1_D_8009CF80 = D_8009C620;
L1_D_8009CF82 = D_8009C622;
L1_D_8009CF8C = D_8009C62C;
L1_D_8009CF90 = D_8009C630;
L1_D_8009CF94 = D_8009C634;
L1_D_8009CF98 = D_8009C638;
L1_D_8009CF9C = D_8009C63C;
L1_D_8009CFA8 = D_8009C648;
L1_D_8009CFB0 = D_8009C650;
L1_D_8009CFB4 = D_8009C654;
L1_D_8009CFBB = D_8009C65B;
L1_D_8009CFBE = D_8009C65E;
L1_D_8009CFC0 = D_8009C660;
L1_D_8009CFC4 = D_8009C664;
L1_D_8009CFC8 = D_8009C668;
L1_D_8009CFCC = D_8009C66C;
L1_D_8009CFE4 = D_8009C684;
L1_D_8009CFE8 = D_8009C688;
L1_D_8009CFEC = D_8009C68C;
L1_D_8009CFF0 = D_8009C690;
L1_D_8009CFFC = D_8009C69C;
L1_D_8009D000 = D_8009C6A0;
L1_D_8009D00E = D_8009C6AE;
L1_D_8009D010 = D_8009C6B0;
L1_D_8009D014 = D_8009C6B4;
L1_D_8009D018 = D_8009C6B8;
L1_D_8009D01A = D_8009C6BA;
L1_D_8009D038 = D_8009C6D8;
L1_D_8009D040 = D_8009C6E0;
L1_D_8009D084 = D_8009C724;
L1_D_8009D088 = D_8009C728;
L1_D_8009D0FC = D_8009C73C;
L1_D_8009D104 = D_8009C744;
L1_D_8009D106 = D_8009C746;
L1_D_8009D108 = D_8009C748;
L1_D_8009D10A = D_8009C74A;
L1_D_8009D10C = D_8009C74C;
L1_D_8009D124 = D_8009C764;
L1_D_8009D130 = D_8009C770;
L1_D_8009D26C = D_8009C8AC;
L1_D_8009D270 = D_8009C8B0;
L1_D_8009D274 = D_8009C8B4;
L1_D_8009D280 = D_8009C8C0;
L1_D_8009D2A8 = D_8009C8E8;
L1_D_8009D2AC = D_8009C8EC;
L1_D_8009D2B0 = D_8009C8F0;
L1_D_8009D35C = D_8009C968;
L1_D_8009D368 = D_8009C974;
L1_D_8009D36C = D_8009C978;
L1_D_8009D374 = D_8009C980;
L1_D_8009D384 = D_8009C990;
L1_D_8009D394 = D_8009C9A0;
L1_D_8009D3A4 = D_8009C9B0;
L1_D_8009D3A8 = D_8009C9B4;
L1_D_8009D3AC = D_8009C9B8;
L1_D_8009D3B0 = D_8009C9BC;
L1_D_8009D3BC = D_8009C9CC;
L1_D_8009D3F0 = D_8009CA00;
L1_D_8009D3F4 = D_8009CA04;
L1_D_8009D3F8 = D_8009CA08;
L1_D_8009D3FC = D_8009CA0C;
L1_D_8009D444 = D_8009CA54;
L1_D_8009D5A8 = D_8009CB60;
L1_D_8009D5AC = D_8009CB64;
L1_D_8009D5F8 = D_8009CBB8;
L1_D_8009D5FC = D_8009CBBC;
L1_D_8009D600 = D_8009CBC0;
L1_D_8009D610 = D_8009CBD0;
L1_D_8009D620 = D_8009CBE0;
L1_D_8009D660 = D_8009CC20;
L1_D_8009D7A4 = D_8009CD64;
L1_D_8009D7A8 = D_8009CD68;
L1_D_8009D8B8 = D_8009CE78;
L1_D_8009D8BE = D_8009CE7E;
L1_D_8009D8C4 = D_8009CE84;
L1_D_8009D8C8 = D_8009CE88;
L1_D_8009D8CC = D_8009CE8C;
L1_D_8009D8D4 = D_8009CE94;
L1_D_8009D8D5 = D_8009CE95;
L1_D_8009D8D6 = D_8009CE96;
L1_D_8009D8D8 = D_8009CE98;
L1_D_8009D8DC = D_8009CE9C;
L1_D_8009D8DD = D_8009CE9D;
L1_D_8009D8E4 = D_8009CEA4;
L1_D_8009D8E8 = D_8009CEA8;
L1_D_8009D8F0 = D_8009CEB0;
L1_D_8009D8F4 = D_8009CEB4;
L1_D_8009D8F8 = D_8009CEB8;
L1_D_8009D8FC = D_8009CEBC;
L1_D_8009D900 = D_8009CEC0;
L1_D_8009D904 = D_8009CEC4;
L1_D_8009D90C = D_8009CECC;
L1_D_8009D910 = D_8009CED0;
L1_D_8009D914 = D_8009CED4;
L1_D_8009D918 = D_8009CED8;
L1_D_8009D91C = D_8009CEDC;
L1_D_8009D920 = D_8009CEE0;
L1_D_8009D924 = D_8009CEE4;
L1_D_8009D928 = D_8009CEE8;
L1_D_8009DB50 = D_8009D0FC;
L1_D_8009E480 = D_8009D66C;
L1_D_8009E490 = D_8009D6A4;
L1_D_8009E908 = D_8009DA64;
L1_D_8009E9A8 = D_8009DACC;
L1_D_8009E9B4 = D_8009DAD8;
L1_D_8009E9B8 = D_8009DADC;
L1_D_8009E9BC = D_8009DAE0;
L1_D_8009E9C0 = D_8009DAE4;
L1_D_8009E9C4 = D_8009DAE8;
L1_D_8009E9D8 = D_8009DAFC;
L1_D_8009EA0C = D_8009DEA8;
L1_D_8009EADC = D_8009DF78;
L1_D_8009EB5C = D_8009DFF8;
L1_D_8009EB7C = D_8009E018;
L1_D_8009EB88 = D_8009E024;
L1_D_8009EB8C = D_8009E028;
L1_D_8009EE0C = D_8009E2A8;
L1_D_8009EE3D = D_8009E2D9;
L1_D_8009EE8C = D_8009E328;
L1_D_8009EEC4 = D_8009E360;
L1_D_8009EEC8 = D_8009E364;
L1_D_8009EED0 = D_8009E36C;
L1_D_8009EED4 = D_8009E370;
L1_D_8009EED8 = D_8009E374;
L1_D_8009EEF0 = D_8009E38C;
L1_D_8009EEF4 = D_8009E390;
L1_D_8009EEF8 = D_8009E394;
L1_D_8009EF1C = D_8009E3B8;
L1_D_8009EF94 = D_8009E430;
L1_D_8009EF98 = D_8009E434;
L1_D_8009EF9C = D_8009E438;
L1_D_8009EFA0 = D_8009E43C;
L1_D_8009EFA4 = D_8009E440;
L1_D_8009EFA8 = D_8009E444;
L1_D_8009EFC8 = D_8009E464;
L1_D_8009F008 = D_8009E4A4;
L1_D_8009F00C = D_8009E4A8;
L1_D_8009F010 = D_8009E4AC;
L1_D_8009F012 = D_8009E4AE;
L1_D_8009F013 = D_8009E4AF;
L1_D_8009F014 = D_8009E4B0;
L1_D_8009F016 = D_8009E4B2;
L1_D_8009F018 = D_8009E4B4;
L1_D_8009F01C = D_8009E4B8;
L1_D_8009F07C = D_8009E518;
L1_D_8009F084 = D_8009E520;
L1_D_8009F090 = D_8009E52C;
L1_D_8009F09C = D_8009E538;
L1_D_8009F0BC = D_8009E558;
L1_D_8009F0D0 = D_8009E56C;
L1_D_8009F0E4 = D_8009E580;
L1_D_8009F0E6 = D_8009E582;
L1_D_8009F10C = D_8009E5A8;
L1_D_8009F114 = D_8009E5B0;
L1_D_8009F118 = D_8009E5B4;
L1_D_8009F11C = D_8009E5B8;
L1_D_8009F120 = D_8009E5BC;
L1_D_8009F124 = D_8009E5C0;
L1_D_8009F128 = D_8009E5C4;
L1_D_8009F12C = D_8009E5C8;
L1_D_8009F130 = D_8009E5CC;
L1_D_8009F134 = D_8009E5D0;
L1_D_8009F138 = D_8009E5D4;
L1_D_8009F13C = D_8009E5D8;
L1_D_8009F140 = D_8009E5DC;
L1_D_8009F144 = D_8009E5E0;
L1_D_8009F148 = D_8009E5E4;
L1_D_8009F14C = D_8009E5E8;
L1_D_8009F150 = D_8009E5EC;
L1_D_8009F160 = D_8009E5FC;
L1_D_8009F170 = D_8009E60C;
L1_D_8009F178 = D_8009E614;
L1_D_8009F17C = D_8009E618;
L1_D_8009F18C = D_8009E628;
L1_D_8009F190 = D_8009E62C;
L1_D_8009F194 = D_8009E630;
L1_D_8009F198 = D_8009E634;
L1_D_8009F1B0 = D_8009E64C;
L1_D_8009F230 = D_8009E6CC;
L1_D_8009F234 = D_8009E6D0;
L1_D_8009F248 = D_8009E6E4;
L1_D_8009F24C = D_8009E6E8;
L1_D_8009F250 = D_8009E6EC;
L1_D_8009F254 = D_8009E6F0;
L1_D_8009F2B8 = D_8009E754;
L1_D_8009F2BA = D_8009E756;
L1_D_8009F2BC = D_8009E758;
L1_D_8009F2E8 = D_8009E784;
L1_D_8009F2F4 = D_8009E790;
L1_D_800A0340 = D_8009F7DC;
L1_D_800A0344 = D_8009F7E0;
L1_D_800A0348 = D_8009F7E4;
L1_D_800A034C = D_8009F7E8;
L1_D_800A0350 = D_8009F7EC;
L1_D_800A0370 = D_8009F80C;
L1_D_800A4370 = D_800A380C;
L1_D_800A4374 = D_800A3810;
L1_D_800A4378 = D_800A3814;
L1_D_800A437C = D_800A3818;
L1_D_800A4380 = D_800A381C;
L1_D_800A4382 = D_800A381E;
L1_D_800A4384 = D_800A3820;
L1_D_800A4390 = D_800A382C;
L1_D_800A4394 = D_800A3830;
L1_D_800A43B0 = D_800A384C;
L1_D_800A43C8 = D_800A3864;
L1_D_800A43CC = D_800A3868;
L1_D_800A43D0 = D_800A386C;
L1_D_800A43D4 = D_800A3870;
L1_D_800A43D8 = D_800A3874;
L1_D_800A43DC = D_800A3878;
L1_D_800A43E0 = D_800A387C;
L1_D_800A43E4 = D_800A3880;
L1_D_800A43E8 = D_800A3884;
L1_D_800A43EC = D_800A3888;
L1_D_800A43F0 = D_800A388C;
L1_D_800A43F4 = D_800A3890;
L1_D_800A43F8 = D_800A3894;
L1_D_800A43FC = D_800A3898;
L1_D_800A4400 = D_800A389C;
L1_D_800A4404 = D_800A38A0;
L1_D_800A4408 = D_800A38A4;
L1_D_800A440C = D_800A38A8;
L1_D_800A4410 = D_800A38AC;
L1_D_800A4414 = D_800A38B0;
L1_D_800A4418 = D_800A38B4;
L1_D_800A441C = D_800A38B8;
L1_D_800A4420 = D_800A38BC;
L1_D_800A4428 = D_800A38C4;
L1_D_800A442C = D_800A38C8;
L1_D_800A4430 = D_800A38CC;
L1_D_800A4440 = D_800A38DC;
L1_D_800A4450 = D_800A38EC;
L1_D_800A4460 = D_800A38FC;
L1_D_800A446C = D_800A3908;
L1_D_800A4470 = D_800A390C;
L1_D_800A4474 = D_800A3910;
L1_D_800A4478 = D_800A3914;
L1_D_800A447C = D_800A3918;
L1_D_800A45D0 = D_800A3A6C;
L1_D_800A45D4 = D_800A3A70;
L1_D_800A45D8 = D_800A3A74;
L1_D_800A4EA0 = D_800A433C;
L1_D_800A4FD8 = D_800A4474;
L1_D_800A4FDC = D_800A4478;
L1_D_800A4FF0 = D_800A448C;
L1_D_800A5000 = D_800A449C;
L1_D_800A5010 = D_800A44AC;
L1_D_800A56A0 = D_800A4B3C;
L1_D_800A5834 = D_800A4CD0;
L1_D_800A59D0 = D_800A4E6C;
L1_D_800A59D4 = D_800A4E70;
L1_D_800A59D8 = D_800A4E74;
L1_D_800A59DC = D_800A4E78;
L1_D_800A59E0 = D_800A4E7C;
L1_D_800A5B60 = D_800A4FFC;
L1_D_800A5B6C = D_800A5008;
L1_D_800A5B90 = D_800A502C;
L1_D_800A5BA8 = D_800A5044;
L1_D_800A5CB0 = D_800A514C;
L1_D_800A5CB4 = D_800A5150;
L1_D_800A5CB8 = D_800A5154;
L1_D_800A5CBC = D_800A5158;
L1_D_800A5CC0 = D_800A515C;
L1_D_800A5CC8 = D_800A5164;
L1_D_800A5CCC = D_800A5168;
L1_D_800A5CD0 = D_800A516C;
L1_D_800A5CD4 = D_800A5170;
L1_D_800A5CD8 = D_800A5174;
L1_D_800A5CDC = D_800A5178;
L1_D_800A5CE0 = D_800A517C;
L1_D_800A5CE4 = D_800A5180;
L1_D_800A5CE8 = D_800A5184;
L1_D_800A5CEC = D_800A5188;
L1_D_800A5CF0 = D_800A518C;
L1_D_800A5D00 = D_800A519C;
L1_D_800A5D04 = D_800A51A0;
L1_D_800A5D08 = D_800A51A4;
L1_D_800A5D18 = D_800A51B4;
L1_D_800A5D1C = D_800A51B8;
L1_D_800A5D20 = D_800A51BC;
L1_D_800A5D24 = D_800A51C0;
L1_D_800A5D28 = D_800A51C4;
L1_D_800A5D2C = D_800A51C8;
L1_D_800A5D34 = D_800A51D0;
L1_D_800A5D44 = D_800A51E0;
L1_D_800A5D48 = D_800A51E4;
L1_D_800A5D4C = D_800A51E8;
L1_D_800A5D7A = D_800A5216;
L1_D_800A5D7C = D_800A5218;
L1_D_800A5D80 = D_800A521C;
L1_D_800A5D98 = D_800A5234;
L1_D_800A5D9C = D_800A5238;
L1_D_800A5DA0 = D_800A523C;
L1_D_800A5DA4 = D_800A5240;
L1_D_800A5DA8 = D_800A5244;
L1_D_800A5DAC = D_800A5248;
L1_D_800A5DB0 = D_800A524C;
L1_D_800A5DB4 = D_800A5250;
L1_D_800A5DB5 = D_800A5251;
L1_D_800A5DBC = D_800A5258;
L1_D_800A5E3C = D_800A52D8;
L1_D_800A5E5C = D_800A52F8;
L1_D_800A5EA0 = D_800A533C;
L1_D_800A5EDC = D_800A5378;
L1_D_800A5F5C = D_800A53F8;
L1_D_800A5FDC = D_800A5478;
L1_D_800A605C = D_800A54F8;
L1_D_800A6060 = D_800A54FC;
L1_D_800A6064 = D_800A5500;
L1_D_800A6068 = D_800A5504;
L1_D_800A606C = D_800A5508;
L1_D_800A6070 = D_800A550C;
L1_D_800A6074 = D_800A5510;
L1_D_800A6075 = D_800A5511;
L1_D_800A6078 = D_800A5514;
L1_D_800A6090 = D_800A552C;
L1_D_800A6094 = D_800A5530;
L1_D_800A6098 = D_800A5534;
L1_D_800A609C = D_800A5538;
L1_D_800A60A0 = D_800A553C;
L1_D_800A60B0 = D_800A554C;
L1_D_800A60D0 = D_800A556C;
L1_D_800A60D4 = D_800A5570;
L1_D_800A60E0 = D_800A557C;
L1_D_800A60E4 = D_800A5580;
L1_D_800A6104 = D_800A55A0;
L1_D_800A6110 = D_800A55AC;
L1_D_800A6114 = D_800A55B0;
L1_D_800A6118 = D_800A55B4;
L1_D_800A611C = D_800A55B8;
L1_D_800A6120 = D_800A55BC;
L1_D_800A6140 = D_800A55DC;
L1_D_800A6170 = D_800A560C;
L1_D_800A6174 = D_800A5610;
L1_D_800A6178 = D_800A5614;
L1_D_800A6180 = D_800A561C;
L1_D_800A6198 = D_800A5634;
L1_D_800A62A0 = D_800A573C;
L1_D_800A66A0 = D_800A5B3C;
L1_D_800A6EB0 = D_800A634C;
L1_D_800A6ED0 = D_800A636C;
L1_D_800A6EF8 = D_800A6394;
L1_D_800A6F00 = D_800A639C;
L1_D_800A6F1C = D_800A63B8;
L1_D_800A7048 = D_800A64E4;
L1_D_800A7060 = D_800A64FC;
L1_D_800A70A0 = D_800A653C;
L1_D_800A70C8 = D_800A6564;
L1_D_800A70D4 = D_800A6570;
L1_D_800A70F8 = D_800A6594;
L1_D_800A7190 = D_800A662C;
L1_D_800A71EC = D_800A6688;
L1_D_800A71F0 = D_800A668C;
L1_D_800A71F4 = D_800A6690;
L1_D_800A71F8 = D_800A6694;
L1_D_800A7214 = D_800A66B0;
L1_D_800A7260 = D_800A66FC;
L1_D_800A7290 = D_800A672C;
L1_D_800A72E8 = D_800A6784;
L1_D_800A7330 = D_800A67CC;
L1_D_800A7344 = D_800A67E0;
L1_D_800A735C = D_800A67F8;
L1_D_800A7370 = D_800A680C;
L1_D_800A73BC = D_800A6858;
L1_D_800A73D8 = D_800A6874;
L1_D_800A7418 = D_800A68B4;
L1_D_800A7424 = D_800A68C0;
L1_D_800A7474 = D_800A6910;
L1_D_800A747C = D_800A6918;
L1_D_800A7498 = D_800A6934;
L1_D_800A74D4 = D_800A6970;
L1_D_800A74E0 = D_800A697C;
L1_D_800A7510 = D_800A69AC;
L1_D_800A75D0 = D_800A6A6C;
L1_D_800A7678 = D_800A6B14;
L1_D_800A76A0 = D_800A6B3C;
L1_D_800A76E4 = D_800A6B80;
L1_D_800A76F8 = D_800A6B94;
L1_D_800A770C = D_800A6BA8;
L1_D_800A7714 = D_800A6BB0;
L1_D_800A7728 = D_800A6BC4;
L1_D_800A773C = D_800A6BD8;
L1_D_800A7750 = D_800A6BEC;
L1_D_800A775C = D_800A6BF8;
L1_D_800A7778 = D_800A6C14;
L1_D_800A7784 = D_800A6C20;
L1_D_800A77B4 = D_800A6C24;
L1_D_800A77CC = D_800A6C3C;
L1_D_800A79F0 = D_800A6E80;
L1_D_800A7A0C = D_800A6E9C;
L1_D_800A7A24 = D_800A6EB4;
L1_D_800A7A30 = D_800A6EC0;
L1_D_800A7CF0 = D_800A71AC;
L1_D_800A7D08 = D_800A71C4;
L1_D_800A7D20 = D_800A71DC;
L1_D_800A7D44 = D_800A7200;
L1_D_800A7D64 = D_800A7220;
L1_D_800A7D74 = D_800A7230;
L1_D_800A7D90 = D_800A724C;
L1_D_800A7DC0 = D_800A727C;
L1_D_800A7DE8 = D_800A72A4;
L1_D_800A7DF4 = D_800A72B0;
L1_D_800A7E14 = D_800A72D0;
L1_D_800A7E34 = D_800A72F0;
L1_D_800A7E50 = D_800A730C;
L1_D_800A7E74 = D_800A7330;
L1_D_800A7E90 = D_800A734C;
L1_D_800A7EC4 = D_800A7380;
L1_D_800A7EFC = D_800A73B8;
L1_D_800A7F1C = D_800A73D8;
L1_D_800A7F2C = D_800A73E8;
L1_D_800A7F80 = D_800A743C;
L1_D_800A7FA0 = D_800A745C;
L1_D_800A7FC8 = D_800A7484;
L1_D_800A7FF8 = D_800A74B4;
L1_D_800A8000 = D_800A74BC;
L1_D_800A80A4 = D_800A7560;
L1_D_800A80B0 = D_800A756C;
L1_D_800A80BC = D_800A7578;
L1_D_800A80C8 = D_800A7584;
L1_D_800A811C = D_800A75D8;
L1_D_800A8144 = D_800A7600;
L1_D_800A81F8 = D_800A76B4;
L1_D_800A8210 = D_800A76CC;
L1_D_800A8224 = D_800A76E0;
L1_D_800A8238 = D_800A76F4;
L1_D_800A824C = D_800A7708;
L1_D_800A8260 = D_800A771C;
L1_D_800A8274 = D_800A7730;
L1_D_800A8280 = D_800A773C;
L1_D_800A828C = D_800A7748;
L1_D_800A82B4 = D_800A7770;
L1_D_800A82DC = D_800A7798;
L1_D_800A8304 = D_800A77C0;
L1_D_800A8308 = D_800A77C4;
L1_D_800A8310 = D_800A77CC;
L1_D_800A8318 = D_800A77D4;
L1_D_800A8320 = D_800A77DC;
L1_D_800A832C = D_800A77E8;
L1_D_800A8340 = D_800A77FC;
L1_D_800A8370 = D_800A782C;
L1_D_800A8390 = D_800A784C;
L1_D_800A83B0 = D_800A786C;
L1_D_800A83BC = D_800A7878;
L1_D_800A83C8 = D_800A7884;
L1_D_800A83D4 = D_800A7890;
L1_D_800A83E0 = D_800A789C;
L1_D_800A83E8 = D_800A78A4;
L1_D_800A83F0 = D_800A78AC;
L1_D_800A8400 = D_800A78BC;
L1_D_800A8410 = D_800A78CC;
L1_D_800A8418 = D_800A78D4;
L1_D_800A8420 = D_800A78DC;
L1_D_800A842C = D_800A78E8;
L1_D_800A8444 = D_800A7900;
L1_D_800A844C = D_800A7908;
L1_D_800A8458 = D_800A7914;
L1_D_800A8460 = D_800A791C;
L1_D_800A8464 = D_800A7920;
L1_D_800A8468 = D_800A7924;
L1_D_800A8478 = D_800A7934;
L1_D_800A8484 = D_800A7940;
L1_D_800A8490 = D_800A794C;
L1_D_800A849C = D_800A7958;
L1_D_800A84A8 = D_800A7964;
L1_D_800A84B4 = D_800A7970;
L1_D_800A84B8 = D_800A7974;
L1_D_800A84BC = D_800A7978;
L1_D_800A84C0 = D_800A797C;
L1_D_800A84D0 = D_800A798C;
L1_D_800A84D8 = D_800A7994;
L1_D_800A84E4 = D_800A79A0;
L1_D_800A84F0 = D_800A79AC;
L1_D_800A84FC = D_800A79B8;
L1_D_800A850C = D_800A79C8;
L1_D_800A851C = D_800A79D8;
L1_D_800A8528 = D_800A79E4;
L1_D_800A8534 = D_800A79F0;
L1_D_800A8544 = D_800A7A00;
L1_D_800A857C = D_800A7A38;
L1_D_800A85C4 = D_800A7A80;
L1_D_800A85D4 = D_800A7A90;
L1_D_800A85F8 = D_800A7AB4;
L1_D_800A86CC = D_800A7B7C;
L1_D_800A8764 = D_800A7BA0;
L1_D_800A87EC = D_800A7C28;
L1_D_800A87F8 = D_800A7C34;
L1_D_800A8808 = D_800A7C44;
L1_D_800A880C = D_800A7C48;
L1_D_800A8820 = D_800A7C5C;
L1_D_800A8858 = D_800A7C94;
L1_D_800A887C = D_800A7CB8;
L1_D_800A8884 = D_800A7CC0;
L1_D_800A8894 = D_800A7CD0;
L1_D_800A88A4 = D_800A7CE0;
L1_D_800A88D0 = D_800A7D0C;
L1_D_800A89A4 = D_800A7DF0;
L1_D_800A89F0 = D_800A7E3C;
L1_D_800A8A08 = D_800A7E54;
L1_D_800A8A2C = D_800A7E78;
L1_D_800A8AA8 = D_800A7EF4;
L1_D_800A8C08 = D_800A8054;
L1_D_800A8C28 = D_800A8074;
L1_D_800A8C48 = D_800A8094;
L1_D_800A8CB0 = D_800A80FC;
L1_D_800A8CC4 = D_800A8110;
L1_D_800A8CEC = D_800A8138;
L1_D_800A8CF8 = D_800A8144;
L1_D_800A8D14 = D_800A8160;
L1_D_800A8D34 = D_800A8180;
L1_D_800A8D44 = D_800A8190;
L1_D_800A8D58 = D_800A81A4;
L1_D_800A8F94 = D_800A8244;
L1_D_800A8FAC = D_800A825C;
L1_D_800A9318 = D_800A85C8;
L1_D_800A932C = D_800A85DC;
L1_D_800A9354 = D_800A8604;
L1_D_800A9390 = D_800A8640;
L1_D_800A9488 = D_800A86FC;
L1_D_800A9498 = D_800A870C;
L1_D_800A9794 = D_800A8E70;
L1_D_800A97BC = D_800A912C;
L1_D_800A9808 = D_800A9178;
L1_D_800A9820 = D_800A9190;
L1_D_800A98C8 = D_800A91FC;
L1_D_800A99D0 = D_800A935C;
L1_D_800A99EC = D_800A9378;
L1_D_800A9A08 = D_800A9394;
L1_D_800A9A1C = D_800A93A8;
L1_D_800A9A60 = D_800A93EC;
L1_D_800A9A84 = D_800A9410;
L1_D_800A9AA8 = D_800A9434;
L1_D_800A9B6C = D_800A94F8;
L1_D_800A9B78 = D_800A9504;
L1_D_800A9BE8 = D_800A9574;
L1_D_800A9C08 = D_800A9594;
L1_D_800A9C78 = D_800A9604;
L1_D_800A9C8C = D_800A9618;
L1_D_800A9CA0 = D_800A962C;
L1_D_800A9CAC = D_800A9638;
L1_D_800A9CC0 = D_800A964C;
L1_D_800A9CC4 = D_800A9650;
L1_D_800A9CDC = D_800A9668;
L1_D_800A9D00 = D_800A968C;
L1_D_800A9D18 = D_800A96A4;
L1_D_800A9D30 = D_800A96BC;
L1_D_800A9D44 = D_800A96D0;
L1_D_800A9D78 = D_800A9704;
L1_D_800A9D90 = D_800A971C;
L1_D_800A9EB0 = D_800A983C;
L1_D_800A9EC8 = D_800A9854;
L1_D_800A9EE0 = D_800A986C;
L1_D_800A9F10 = D_800A989C;
L1_D_800A9F2C = D_800A98B8;
L1_D_800A9F44 = D_800A98D0;
L1_D_800A9F60 = D_800A98EC;
L1_D_800A9F80 = D_800A990C;
L1_D_800A9F8C = D_800A9918;
L1_D_800A9F9C = D_800A9928;
L1_D_800A9FC8 = D_800A9954;
L1_D_800A9FD0 = D_800A995C;
L1_D_800AA000 = D_800A998C;
L1_D_800AA024 = D_800A99B0;
L1_D_800AA044 = D_800A99D0;
L1_D_800AA058 = D_800A99E4;
L1_D_800AA07C = D_800A9A08;
L1_D_800AA09C = D_800A9A28;
L1_D_800AA0B8 = D_800A9A44;
L1_D_800AA0BC = D_800A9A48;
L1_D_800AA0BE = D_800A9A4A;
L1_D_800AA0C0 = D_800A9A4C;
L1_D_800AA0DC = D_800A9A68;
L1_D_800AA110 = D_800A9A9C;
L1_D_800AA154 = D_800A9AE0;
L1_D_800AA170 = D_800A9AFC;
L1_D_800AA1B0 = D_800A9B3C;
L1_D_800AA1D0 = D_800A9B5C;
L1_D_800AA3C0 = D_800A9D4C;
L1_D_800AA3E8 = D_800A9D74;
L1_D_800AA410 = D_800A9D9C;
L1_D_800AA438 = D_800A9DC4;
L1_D_800AA444 = D_800A9DD0;
L1_D_800AA46C = D_800A9DF8;
L1_D_800AA494 = D_800A9E20;
L1_D_800AA4C0 = D_800A9E4C;
L1_D_800AA4F0 = D_800A9E7C;
L1_D_800AA518 = D_800A9EA4;
L1_D_800AA580 = D_800A9F0C;
L1_D_800AA590 = D_800A9F1C;
L1_D_800AA5A0 = D_800A9F2C;
L1_D_800AA5B4 = D_800A9F40;
L1_D_800AA70C = D_800AA098;
L1_D_800AA71C = D_800AA0A8;
L1_D_800AA738 = D_800AA0C4;
L1_D_800AA744 = D_800AA0D0;
L1_D_800AA760 = D_800AA0EC;
L1_D_800AA774 = D_800AA100;
L1_D_800AA794 = D_800AA120;
L1_D_800AA79C = D_800AA128;
L1_D_800AA7A8 = D_800AA134;
L1_D_800AA7B0 = D_800AA13C;
L1_D_800AA7C0 = D_800AA14C;
L1_D_800AA800 = D_800AA18C;
L1_D_800AA80C = D_800AA198;
L1_D_800AA818 = D_800AA1A4;
L1_D_800AA830 = D_800AA1BC;
L1_D_800AA84C = D_800AA1D8;
L1_D_800AA8A0 = D_800AA22C;
L1_D_800AA8C8 = D_800AA254;
L1_D_800AA8E0 = D_800AA26C;
L1_D_800AA8E8 = D_800AA274;
L1_D_800AA8F0 = D_800AA27C;
L1_D_800AB4A0 = D_800AAE30;
L1_D_800AB540 = D_800AAED0;
L1_D_800AB5E0 = D_800AAF70;
L1_D_800AB5E4 = D_800AAF74;
L1_D_800AB5E8 = D_800AAF78;
L1_D_800AB5EC = D_800AAF7C;
L1_D_800AB5F0 = D_800AAF80;
L1_D_800AB5F4 = D_800AAF84;
L1_D_800AB5F8 = D_800AAF88;
L1_D_800AB5FC = D_800AAF8C;
L1_D_800AB600 = D_800AAF90;
L1_D_800AB604 = D_800AAF94;
L1_D_800AB608 = D_800AAF98;
L1_D_800AB60C = D_800AAF9C;
L1_D_800AB610 = D_800AAFA0;
L1_D_800AB614 = D_800AAFA4;
L1_D_800AB618 = D_800AAFA8;
L1_D_800AB744 = D_800AB214;
L1_D_800AB754 = D_800AB224;
L1_D_800AC284 = D_800ABD54;
L1_D_800AC384 = D_800ABE54;
L1_D_800AC38C = D_800ABE5C;
L1_D_800AC4C8 = D_800AC0D8;
L1_D_800AC4D0 = D_800AC0E0;
L1_D_800AC4D8 = D_800AC0E8;
L1_D_800AC4DC = D_800AC0EC;
L1_D_800AC4E0 = D_800AC0F0;
L1_D_800AC4E4 = D_800AC0F4;
L1_D_800AC4E8 = D_800AC0F8;
L1_D_800AC4EC = D_800AC0FC;
L1_D_800AC54C = D_800AC15C;
L1_D_800AC550 = D_800AC160;
L1_D_800AE940 = D_800B1F20;
L1_D_800AE9B8 = D_800B1F98;
L1_D_800AE9C0 = D_800B1FA0;
L1_D_800AEB1A = D_800B20FA;
L1_D_800AEC38 = D_800B2218;
L1_D_800AEDA0 = D_800B2380;
L1_D_800AEDA4 = D_800B2384;
L1_D_800AEDA8 = D_800B2388;
L1_D_800AEDAC = D_800B238C;
L1_D_800AEDB0 = D_800B2390;
L1_D_800AEDB4 = D_800B2394;
L1_D_800AEDB8 = D_800B2398;
L1_D_800AEDBC = D_800B239C;
L1_D_800AEDD4 = D_800B23B4;
L1_D_800AEDD8 = D_800B23B8;
L1_D_800AEDDC = D_800B23BC;
L1_D_800AEDE0 = D_800B23C0;
L1_D_800AEDE4 = D_800B23C4;
L1_D_800AEDE8 = D_800B23C8;
L1_D_800AEDEC = D_800B23CC;
L1_D_800AEDF0 = D_800B23D0;
L1_D_800AEE10 = D_800B23F0;
L1_D_800AEE14 = D_800B23F4;
L1_D_800AF620 = D_800B2C00;
L1_D_800AF624 = D_800B2C04;
L1_D_800AF6A4 = D_800B2C84;
L1_D_800AF6A5 = D_800B2C85;
L1_D_800AF6A8 = D_800B2C88;
L1_D_800AFEA8 = D_800B3488;
L1_D_800AFEAC = D_800B348C;
L1_D_800AFEB0 = D_800B3490;
L1_D_800AFEB5 = D_800B3495;
L1_D_800AFEB6 = D_800B3496;
L1_D_800AFEB7 = D_800B3497;
L1_D_800AFEB8 = D_800B3498;
L1_D_800AFEB9 = D_800B3499;
L1_D_800AFEBC = D_800B349C;
L1_D_800AFEC0 = D_800B34A0;
L1_D_800AFEC8 = D_800B34A8;
L1_D_800AFF2C = D_800B350C;
L1_D_800AFF4C = D_800B352C;
L1_D_800AFF58 = D_800B3538;
L1_D_800AFF5C = D_800B353C;
L1_D_800AFF60 = D_800B3540;
L1_D_800AFF64 = D_800B3544;
L1_D_800AFF68 = D_800B3548;
L1_D_800AFF70 = D_800B3550;
L1_D_800AFF78 = D_800B3558;
L1_D_800AFF80 = D_800B3560;
L1_D_800AFF84 = D_800B3564;
L1_D_800AFF88 = D_800B3568;
L1_D_800AFF8C = D_800B356C;
L1_D_800AFF94 = D_800B3574;
L1_D_800AFF98 = D_800B3578;
L1_D_800AFFA4 = D_800B3584;
L1_D_800AFFA8 = D_800B3588;
L1_D_800AFFAC = D_800B358C;
L1_D_800AFFB0 = D_800B3590;
L1_D_800AFFB4 = D_800B3594;
L1_D_800AFFC0 = D_800B35A0;
L1_D_800AFFC4 = D_800B35A4;
L1_D_800AFFC8 = D_800B35A8;
L1_D_800AFFCC = D_800B35AC;
L1_D_800B0014 = D_800B35F4;
L1_D_800B0018 = D_800B35F8;
L1_D_800B0064 = D_800B3644;
L1_D_800B0066 = D_800B3646;
L1_D_800B0068 = D_800B3648;
L1_D_800B0070 = D_800B3650;
L1_D_800B0084 = D_800B3664;
L1_D_800B008C = D_800B366C;
L1_D_800B0094 = D_800B3674;
L1_D_800B00A0 = D_800B3680;
L1_D_800B0108 = D_800B36E8;
L1_D_800B05AC = D_800B3A1C;
L1_D_800B05B0 = D_800B3A20;
L1_D_800B077C = D_800B3BEC;
L1_D_800B0794 = D_800B3C04;
L1_D_800B0798 = D_800B3C08;
L1_D_800B07A4 = D_800B3C14;
L1_D_800B07A8 = D_800B3C18;
L1_D_800B07AC = D_800B3C1C;
L1_D_800B07B0 = D_800B3C20;
L1_D_800B07B4 = D_800B3C24;
L1_D_800B07B8 = D_800B3C28;
L1_D_800B07BC = D_800B3C2C;
L1_D_800B07C0 = D_800B3C30;
L1_D_800B07C4 = D_800B3C34;
L1_D_800B0804 = D_800B3C74;
L1_D_800B0808 = D_800B3C78;
L1_D_800B0848 = D_800B3CB8;
L1_D_800B0868 = D_800B3CD8;
L1_D_800B087C = D_800B3CEC;
L1_D_800B0A94 = D_800B3F04;
L1_D_800B0A98 = D_800B3F08;
L1_D_800B0AA0 = D_800B3F10;
L1_D_800B0AA4 = D_800B3F14;
L1_D_800B0AA8 = D_800B3F18;
L1_D_800B0AB4 = D_800B3F24;
L1_D_800B0AB8 = D_800B3F28;
L1_D_800B0AC0 = D_800B3F30;
L1_D_800B0AC8 = D_800B3F38;
L1_D_800B0ACC = D_800B3F3C;
L1_D_800B0AD0 = D_800B3F40;
L1_D_800B0AD4 = D_800B3F44;
L1_D_800B0ADC = D_800B3F4C;
L1_D_800B0AE0 = D_800B3F50;
L1_D_800B0AE4 = D_800B3F54;
L1_D_800B0AE8 = D_800B3F58;
L1_D_800B0AEC = D_800B3F5C;
L1_D_800B0AFC = D_800B3F6C;
L1_D_800B0B10 = D_800B3F80;
L1_D_800B0B14 = D_800B3F84;
L1_D_800B0B54 = D_800B3FC4;
L1_D_800B0B68 = D_800B3FD8;
L1_D_800B0B6A = D_800B3FDA;
L1_D_800B0B6C = D_800B3FDC;
L1_D_800B0B70 = D_800B3FE0;
L1_D_800B0B72 = D_800B3FE2;
L1_D_800B0B78 = D_800B3FE8;
L1_D_800B0B80 = D_800B3FF0;
L1_D_800B0B84 = D_800B3FF4;
L1_D_800B0B88 = D_800B3FF8;
L1_D_800B0B8C = D_800B3FFC;
L1_D_800B0B9C = D_800B400C;
L1_D_800B0BA0 = D_800B4010;
L1_D_800B0BB4 = D_800B4024;
L1_D_800B0BB8 = D_800B4028;
L1_D_800B0BBC = D_800B402C;
L1_D_800B0BC0 = D_800B4030;
L1_D_800B0C10 = D_800B4080;
L1_D_800B0C30 = D_800B40A0;
L1_D_800B0C38 = D_800B40A8;
L1_D_800B0C58 = D_800B40C8;
L1_D_800B0C5C = D_800B40CC;
L1_D_800B0C60 = D_800B40D0;
L1_D_800B0C64 = D_800B40D4;
L1_D_800B0C68 = D_800B40D8;
L1_D_800B0C6C = D_800B40DC;
L1_D_800B0C74 = D_800B40E4;
L1_D_800B0C7C = D_800B40EC;
L1_D_800B0C84 = D_800B40F4;
L1_D_800B0C8C = D_800B40FC;
L1_D_800B0C94 = D_800B4104;
L1_D_800B0C98 = D_800B4108;
L1_D_800B0C9C = D_800B410C;
L1_D_800B0CA0 = D_800B4110;
L1_D_800B0CA4 = D_800B4114;
L1_D_800B0CA8 = D_800B4118;
L1_D_800B0CAC = D_800B411C;
L1_D_800B0CB0 = D_800B4120;
L1_D_800B0CC4 = D_800B4134;
L1_D_800B0D50 = D_800B41C0;
L1_D_800B0D94 = D_800B4204;
L1_D_800B0DA0 = D_800B4210;
L1_D_800B0DA4 = D_800B4214;
L1_D_800B0DA8 = D_800B4218;
L1_D_800B0DAC = D_800B421C;
L1_D_800B0DB0 = D_800B4220;
L1_D_800B0DB4 = D_800B4224;
L1_D_800B0DB8 = D_800B4228;
L1_D_800B0DBC = D_800B422C;
L1_D_800B0DC0 = D_800B4230;
L1_D_800B0DC4 = D_800B4234;
L1_D_800B0DC8 = D_800B4238;
L1_D_800B0DCC = D_800B423C;
L1_D_800B0DD0 = D_800B4240;
L1_D_800B0DD4 = D_800B4244;
L1_D_800B0DD8 = D_800B4248;
L1_D_800B0DDC = D_800B424C;
L1_D_800B0DE4 = D_800B4254;
L1_D_800B0E34 = D_800B42A4;
L1_D_800B0E36 = D_800B42A6;
L1_D_800B0E48 = D_800B42B8;
L1_D_800B0E54 = D_800B42C4;
L1_D_800B0E58 = D_800B42C8;
L1_D_800B0E5E = D_800B42CE;
L1_D_800B0E5F = D_800B42CF;
L1_D_800B0E62 = D_800B42D2;
L1_D_800B0E63 = D_800B42D3;
L1_D_800B0E8C = D_800B42FC;
L1_D_800B0EA0 = D_800B4310;
L1_D_800B0EFC = D_800B436C;
L1_D_800B8EFC = D_800BC36C;
L1_D_800B8F24 = D_800BC394;
L1_D_800B8F28 = D_800BC398;
L1_D_800B8F68 = D_800BC3D8;
L1_D_800B8F88 = D_800BC3F8;
L1_D_800B8FB0 = D_800BC420;
L1_D_800B8FB4 = D_800BC424;
L1_D_800C1C54 = D_800C50C4;
L1_D_800CA8F4 = D_800CDD64;
L1_D_800D28F4 = D_800D5D64;
L1_D_800D2AF4 = D_800D5F64;
L1_D_800D2AF8 = D_800D5F68;
L1_D_800D2AFC = D_800D5F6C;
L1_D_800D2BC4 = D_800D6034;
L1_D_800D2BE8 = D_800D6058;
L1_D_800D2BEC = D_800D605C;
L1_D_800D2BF0 = D_800D6060;
L1_D_800D2D30 = D_800D61A0;
L1_D_800D2E70 = D_800D62E0;
L1_D_800D2E74 = D_800D62E4;
L1_D_800D2E84 = D_800D62F4;
L1_D_800D2E90 = D_800D6300;
L1_D_800D2F48 = D_800D63B8;
L1_D_800D2F68 = D_800D63D8;
L1_D_800D2F8C = D_800D63FC;
L1_D_800D2F90 = D_800D6400;
L1_D_800D2F94 = D_800D6404;
L1_D_800D2FA4 = D_800D6414;
L1_D_800D2FAC = D_800D641C;
L1_D_800D2FB0 = D_800D6420;
L1_D_800D2FC0 = D_800D6430;
L1_D_800D2FC4 = D_800D6434;
L1_D_800D2FF4 = D_800D6464;
L1_D_800D305C = D_800D64CC;
L1_D_800D3068 = D_800D64D8;
L1_D_800D308C = D_800D64FC;
L1_D_800D30C0 = D_800D6530;
L1_D_800D30D4 = D_800D6544;
L1_D_800D30D8 = D_800D6548;
L1_D_800D31B8 = D_800D6628;
L1_D_800D31C0 = D_800D6630;
L1_D_800D31D0 = D_800D6640;
L1_D_800D3234 = D_800D66A4;
L1_D_800D3238 = D_800D66A8;
L1_D_800D3288 = D_800D66F8;
L1_D_800D3FA8 = D_800D7418;
L1_D_800D3FAC = D_800D741C;
L1_D_800D3FB0 = D_800D7420;
L1_D_800D3FD4 = D_800D7444;
L1_D_800D3FD8 = D_800D7448;
L1_D_800D3FE0 = D_800D7450;
L1_D_800D3FE4 = D_800D7454;
L1_D_800D3FEC = D_800D745C;
L1_D_800D3FF0 = D_800D7460;
L1_D_800D4050 = D_800D74C0;
L1_D_800D4058 = D_800D74C8;
L1_D_800D4068 = D_800D74D8;
L1_D_800D406C = D_800D74DC;
L1_D_800D4070 = D_800D74E0;
L1_D_800D4074 = D_800D74E4;
L1_D_800D4080 = D_800D74F0;
L1_D_800D40D8 = D_800D7548;
L1_D_800D40F8 = D_800D7568;
L1_D_800D40FC = D_800D756C;
L1_D_800D4100 = D_800D7570;
L1_D_800D4104 = D_800D7574;
L1_D_800D4108 = D_800D7578;
L1_D_800D410C = D_800D757C;
L1_D_800D4110 = D_800D7580;
L1_D_800D4114 = D_800D7584;
L1_D_800D4128 = D_800D7598;
L1_D_800D424C = D_800D76BC;
L1_D_800D4250 = D_800D76C0;
L1_D_800D4260 = D_800D76D0;
L1_D_800D4264 = D_800D76D4;
L1_D_800D430C = D_800D777C;
L1_D_800D4384 = D_800D77F4;
L1_D_800D4385 = D_800D77F5;
L1_D_800D4386 = D_800D77F6;
L1_D_800D4387 = D_800D77F7;
L1_D_800D4388 = D_800D77F8;
L1_D_800D4389 = D_800D77F9;
L1_D_800D438A = D_800D77FA;
L1_D_800D438B = D_800D77FB;
L1_D_800D438C = D_800D77FC;
L1_D_800D438D = D_800D77FD;
L1_D_800D438E = D_800D77FE;
L1_D_800D438F = D_800D77FF;
L1_D_800D4390 = D_800D7800;
L1_D_800D43A8 = D_800D7818;
L1_D_800D43AC = D_800D781C;
L1_D_800D43C0 = D_800D7830;
L1_D_800D43C4 = D_800D7834;
L1_D_800D43CC = D_800D783C;
L1_D_800D43D0 = D_800D7840;
L1_D_800D43E4 = D_800D7854;
L1_D_800D43F0 = D_800D7860;
L1_D_800D43F4 = D_800D7864;
L1_D_800D43F8 = D_800D7868;
L1_D_800D4400 = D_800D7870;
L1_D_800D4404 = D_800D7874;
L1_D_800D440C = D_800D787C;
L1_D_800D4410 = D_800D7880;
L1_D_800D4414 = D_800D7884;
L1_D_800D4424 = D_800D7894;
L1_D_800D4440 = D_800D78B0;
L1_D_800D4444 = D_800D78B4;
L1_D_800D4450 = D_800D78F0;
L1_D_800D4454 = D_800D78F4;
L1_D_800D4458 = D_800D78F8;
L1_D_800D445C = D_800D78FC;
L1_D_800D4464 = D_800D7904;
L1_D_800D4468 = D_800D7908;
L1_D_800D446C = D_800D790C;
L1_D_800D4474 = D_800D7910;
L1_D_800D45C4 = D_800D7920;
L1_D_800D45F4 = D_800D7950;
L1_D_800D4958 = D_800D7CB4;
L1_D_800D4984 = D_800D7CE0;
L1_D_800D5DA4 = D_800D9100;
L1_D_800D5ED0 = D_800D922C;
L1_D_800D5ED8 = D_800D9234;
L1_D_800D5F40 = D_800D929C;
L1_D_800D74FC = D_800DA858;
L1_D_800D7550 = D_800DA8AC;
L1_D_800D7588 = D_800DA8E4;
L1_D_800D7A1C = D_800DAD78;
L1_D_800D7A20 = D_800DAD7C;
L1_D_800D7C24 = D_800DAF80;
L1_D_800D7CB4 = D_800DB010;
L1_D_800D7CB8 = D_800DB014;
L1_D_800D7D08 = D_800DB064;
L1_D_800D7DF8 = D_800DB154;
L1_D_800D8154 = D_800DB4B0;
L1_D_800D861C = D_800DB978;
L1_D_800D8620 = D_800DB97C;
L1_D_800D86C4 = D_800DBA20;
L1_D_800D86C8 = D_800DBA24;
L1_D_800D86DC = D_800DBA38;
L1_D_800D86E0 = D_800DBA3C;
L1_D_800D86E4 = D_800DBA40;
L1_D_800D86E8 = D_800DBA44;
L1_D_800D8BE8 = D_800DBF44;
L1_D_800D8C7C = D_800DBFD8;
L1_D_800D8C90 = D_800DBFEC;
L1_D_800D8C94 = D_800DBFF0;
L1_D_800D8E74 = D_800DC1D0;
L1_D_800D8E8C = D_800DC1E8;
L1_D_800D8EA4 = D_800DC200;
L1_D_800D8EA8 = D_800DC204;
L1_D_800D8EE8 = D_800DC244;
L1_D_800D8FE8 = D_800DC344;
L1_D_800D8FF8 = D_800DC354;
L1_D_800D90C0 = D_800DC41C;
L1_D_800D911C = D_800DC478;
L1_D_800D91E4 = D_800DC540;
L1_D_800D91E7 = D_800DC543;
L1_D_800D91E8 = D_800DC544;
L1_D_800D91F0 = D_800DC54C;
L1_D_800D91F8 = D_800DC554;
L1_D_800D91FC = D_800DC558;
L1_D_800D9200 = D_800DC55C;
L1_D_800D9208 = D_800DC564;
L1_D_800D920C = D_800DC568;
L1_D_800D9210 = D_800DC56C;
L1_D_800D9214 = D_800DC570;
L1_D_800D9218 = D_800DC574;
L1_D_800D9232 = D_800DC58E;
L1_D_800D9268 = D_800DC5C8;
L1_D_800D9278 = D_800DC5D8;
L1_D_800DA270 = D_800DD5D0;
L1_D_800DA5C0 = D_800DD920;
L1_D_800DA5C4 = D_800DD924;
L1_D_800DB7E4 = D_800DEB44;
L1_D_800DB884 = D_800DEBE4;
L1_D_800DCAA4 = D_800DFE04;
L1_D_800DCB44 = D_800DFEA4;
L1_D_800DCB4C = D_800DFEAC;
L1_D_800DD7F4 = D_800E0B54;
L1_D_800DD7F8 = D_800E0B58;
L1_D_800DD7FC = D_800E0B5C;
L1_D_800DD800 = D_800E0B60;
L1_D_800DD804 = D_800E0B64;
L1_D_800DD808 = D_800E0B68;
L1_D_800DD810 = D_800E0B70;
L1_D_800DD818 = D_800E0B78;
L1_D_800DD838 = D_800E0B98;
L1_D_800DD83C = D_800E0B9C;
L1_D_800DDA40 = D_800E0DA0;
L1_D_800DDC44 = D_800E0FA4;
L1_D_800DDC48 = D_800E0FA8;
L1_D_800DDC4C = D_800E0FAC;
L1_D_800DDC50 = D_800E0FB0;
L1_D_800DDC54 = D_800E0FB4;
L1_D_800DDC58 = D_800E0FB8;
L1_D_800DDC5C = D_800E0FBC;
L1_D_800DDC60 = D_800E0FC0;
L1_D_800DDC64 = D_800E0FC4;
L1_D_800DDC68 = D_800E0FC8;
L1_D_800DDC6C = D_800E0FCC;
L1_D_800DDCC0 = D_800E1020;
L1_D_800DDCC4 = D_800E1024;
L1_D_800DDCC8 = D_800E1028;
L1_D_800DDCCC = D_800E102C;
L1_D_800DDD8C = D_800E10EC;
L1_D_800DDD90 = D_800E10F0;
L1_D_800DDD94 = D_800E10F4;
L1_D_800DDD98 = D_800E10F8;
L1_D_800DDDA0 = D_800E1100;
L1_D_800DDDA4 = D_800E1104;
L1_D_800DDDA8 = D_800E1108;
L1_D_800DDDAC = D_800E110C;
L1_D_800DDDB0 = D_800E1110;
L1_D_800DDDB4 = D_800E1114;
L1_D_800DDDB8 = D_800E1118;
L1_D_800DDDBC = D_800E111C;
L1_D_800DDDCC = D_800E112C;
L1_D_800DDDDC = D_800E113C;
L1_D_800DDDEC = D_800E114C;
L1_D_800DDE04 = D_800E1164;
L1_D_800DDE08 = D_800E1168;
L1_D_800DDE10 = D_800E1170;
L1_D_800DDE30 = D_800E1190;
L1_D_800DDE34 = D_800E1194;
L1_D_800DDEE0 = D_800E1240;
L1_D_800DDEE4 = D_800E1244;
L1_D_800DDEE8 = D_800E1248;
L1_D_800DDEEC = D_800E124C;
L1_D_800DDEF0 = D_800E1250;
L1_D_800DDF08 = D_800E1268;
L1_D_800DDF24 = D_800E1284;
L1_D_800DDFEC = D_800E134C;
L1_D_800DE000 = D_800E1360;
L1_D_800DE004 = D_800E1364;
L1_D_800DE018 = D_800E1378;
L1_D_800DE0C4 = D_800E1424;
L1_D_800DE0C8 = D_800E1428;
L1_D_800DE0D4 = D_800E1434;
L1_D_800DE0D8 = D_800E1438;
L1_D_800DE0DC = D_800E143C;
L1_D_800DE0E0 = D_800E1440;
L1_D_800DE0E4 = D_800E1444;
L1_D_800DE0E8 = D_800E1448;
L1_D_800DE8E8 = D_800E1C48;
L1_D_800DF0E8 = D_800E2448;
L1_D_800DF0EC = D_800E244C;
L1_D_800DF0F0 = D_800E2450;
L1_D_800DF0F8 = D_800E2458;
L1_D_800DF10C = D_800E246C;
L1_D_800DF12C = D_800E248C;
L1_D_800DF1F4 = D_800E2554;
L1_D_800DF200 = D_800E2560;
L1_D_800DF540 = D_800E28A0;
L1_D_800DF5B8 = D_800E2918;
L1_D_800DF684 = D_800E29E4;
L1_D_800E02B4 = D_800E3614;
L1_D_800E23D4 = D_800E4C80;
L1_D_800E23E8 = D_800E4C84;
L1_D_800E2438 = D_800E4C88;
L1_D_800E2448 = D_800E4C98;
L1_D_800E2DA8 = D_800E55F8;
L1_D_800E2DBC = D_800E560C;
L1_D_800E2DE0 = D_800E5630;
L1_D_800E2DE4 = D_800E5634;
L1_D_800E2DF4 = D_800E5644;
L1_D_800E2E44 = D_800E5694;
L1_D_800E2E48 = D_800E5698;
L1_D_800E2E4C = D_800E569C;
L1_D_800E2F2C = D_800E577C;
L1_D_800E2F38 = D_800E5788;
L1_D_800E2F3C = D_800E578C;
L1_D_800E2F54 = D_800E57A4;
L1_D_800E2F58 = D_800FB934;
L1_D_800E2F5C = D_800FB938;
L1_D_800F0F5C = D_80108138;
L1_D_800F0F80 = D_8010815C;
L1_D_800F10A8 = D_80108284;
L1_D_800F10AC = D_80108288;
L1_D_800F1180 = D_8010835C;
L1_D_800F11A0 = D_8010837C;
L1_D_800F11D0 = D_801083AC;
L1_D_800F11EC = D_801083C8;
L1_D_800F11F0 = D_801083CC;
L1_D_800F128C = D_80108468;
L1_D_800F1294 = D_80108470;
L1_D_800F12D4 = D_801084B0;
L1_D_800F12EC = D_801084C8;
L1_D_800F12F4 = D_801084D0;
L1_D_800F1314 = D_801084F0;
L1_D_800F1354 = D_80108530;
L1_D_800F136C = D_80108548;
L1_D_800F1374 = D_80108550;
L1_D_800F138C = D_80108568;
L1_D_800F1398 = D_80108574;
L1_D_800F13A8 = D_80108584;
L1_D_800F1DCC = D_80108FA8;
L1_D_800F25D8 = D_801097B4;
L1_D_800F2FBC = D_8010A198;
L1_D_800F3848 = D_8010AA24;
L1_D_800F3B48 = D_8010AD24;
L1_D_800F3E98 = D_8010B074;
L1_D_800F40DC = D_8010B2B8;
L1_D_800F40E0 = D_8010B2BC;
L1_D_800F40F8 = D_8010B2D4;
L1_D_800F40FC = D_8010B2D8;
L1_D_800F4114 = D_8010B2F0;
L1_D_800F413C = D_8010B318;
L1_D_800F415C = D_8010B338;
L1_D_800F4264 = D_8010B440;
L1_D_800F4268 = D_8010B444;
L1_D_800F426C = D_8010B448;
L1_D_800F4270 = D_8010B44C;
L1_D_800F5A64 = D_8010CC40;
L1_D_800F5A65 = D_8010CC41;
L1_D_800F5A66 = D_8010CC42;
L1_D_800F5A68 = D_8010CC44;
L1_D_800F5A6C = D_8010CC48;
L1_D_800F6040 = D_8010D21C;
L1_D_800F6064 = D_8010D240;
L1_D_800F6068 = D_8010D244;
L1_D_800F606C = D_8010D248;
L1_D_800F6070 = D_8010D24C;
L1_D_800F7664 = D_8010E840;
L1_D_800F7E64 = D_8010F040;
L1_D_800F7EC4 = D_8010F0A0;
L1_D_800F7EC8 = D_8010F0A4;
L1_D_800F7EC9 = D_8010F0A5;
L1_D_800F7ECA = D_8010F0A6;
L1_D_800F7ECC = D_8010F0A8;
L1_D_800F7ECE = D_8010F0AA;
L1_D_800F7ED0 = D_8010F0AC;
L1_D_800F7ED2 = D_8010F0AE;
L1_D_800F7EE4 = D_8010F0C0;
L1_D_800F7EE8 = D_8010F0C4;
L1_D_800F7EEC = D_8010F0C8;
L1_D_800F7EF4 = D_8010F0D0;
L1_D_800F7EF8 = D_8010F0D4;
L1_D_800F7EFC = D_8010F0D8;
L1_D_800F7F00 = D_8010F0DC;
L1_D_800F7F04 = D_8010F0E0;
L1_D_800F7F08 = D_8010F0E4;
L1_D_800F7F10 = D_8010F0EC;
L1_D_800F7F1C = D_8010F0F8;
L1_D_800F7F64 = D_8010F140;
L1_D_800F7F68 = D_8010F144;
L1_D_800F7F6C = D_8010F148;
L1_D_800F7F70 = D_8010F14C;
L1_D_800F7F74 = D_8010F150;
L1_D_800F7F81 = D_8010F15D;
L1_D_800F7F84 = D_8010F160;
L1_D_800F7FCC = D_8010F1A8;
L1_D_800F8014 = D_8010F1F0;
L1_D_800F81F4 = D_8010F3D0;
L1_D_800F81F8 = D_8010F3D4;
L1_D_800F8204 = D_8010F3E0;
L1_D_800F8208 = D_8010F3E4;
L1_D_800F8214 = D_8010F3F0;
L1_D_800F8614 = D_8010F7F0;
L1_D_800FC614 = D_801137F0;
L1_D_800FC616 = D_801137F2;
L1_D_800FC624 = D_80113800;
L1_D_800FC628 = D_80113804;
L1_D_800FC62C = D_80113808;
L1_D_800FC630 = D_8011380C;
L1_D_800FC640 = D_8011381C;
L1_D_800FC644 = D_80113820;
L1_D_800FC648 = D_80113824;
L1_D_800FC650 = D_8011382C;
L1_D_800FC654 = D_80113830;
L1_D_800FC658 = D_80113834;
L1_D_800FC65C = D_80113838;
L1_D_800FC660 = D_8011383C;
L1_D_800FC664 = D_80113840;
L1_D_800FC670 = D_8011384C;
L1_D_800FC67C = D_80113858;
L1_D_800FC6A0 = D_8011387C;
L1_D_800FC6B0 = D_8011388C;
L1_D_800FC6C0 = D_8011389C;
L1_D_800FC780 = D_8011395C;
L1_D_800FC784 = D_80113960;
L1_D_800FC788 = D_80113964;
L1_D_800FC790 = D_8011396C;
L1_D_800FC794 = D_80113970;
L1_D_800FCF94 = D_80114170;
L1_D_800FCF98 = D_80114174;
L1_D_800FCF9C = D_80114178;
L1_D_800FCFA0 = D_8011417C;
L1_D_800FCFA4 = D_80114180;
L1_D_800FCFA8 = D_80114184;
L1_D_800FCFAC = D_80114188;
L1_D_800FCFB0 = D_8011418C;
L1_D_800FCFB4 = D_80114190;
L1_D_800FD038 = D_80114214;
L1_D_800FD0B8 = D_80114294;
L1_D_800FD0F8 = D_801142D4;
L1_D_800FD138 = D_80114314;
L1_D_800FD178 = D_80114354;
L1_D_800FD17C = D_80114358;
L1_D_800FD190 = D_8011436C;
L1_D_800FD191 = D_8011436D;
L1_D_800FD195 = D_80114371;
L1_D_800FD197 = D_80114373;
L1_D_800FD19A = D_80114376;
L1_D_800FD19B = D_80114377;
L1_D_800FD19F = D_8011437B;
L1_D_800FD1A1 = D_8011437D;
L1_D_800FD1A2 = D_8011437E;
L1_D_800FD1A4 = D_80114380;
L1_D_800FD1A6 = D_80114380 + 0x2;
L1_D_800FD1A8 = D_80114384;
L1_D_800FD1AC = D_80114388;
L1_D_800FD1BC = D_80114398;
L1_D_800FD1C0 = D_8011439C;
L1_D_800FD1C4 = D_801143A0;
L1_D_800FD1C8 = D_801143A4;
L1_D_800FD208 = D_801143E4;
L1_D_800FD248 = D_80114424;
L1_D_800FD24C = D_80114428;
L1_D_800FD254 = D_80114430;
L1_D_800FD258 = D_80114434;
L1_D_800FD25C = D_80114438;
L1_D_800FD260 = D_8011443C;
L1_D_800FD264 = D_80114440;
L1_D_800FD266 = D_80114442;
L1_D_800FD268 = D_80114444;
L1_D_800FD26A = D_80114446;
L1_D_800FD26C = D_80114448;
L1_D_800FD3E4 = D_801145C0;
L1_D_800FD3E8 = D_801145C4;
L1_D_800FD400 = D_801145DC;
L1_D_800FD440 = D_8011461C;
L1_D_800FD442 = D_8011461E;
L1_D_800FD444 = D_80114620;
L1_D_800FD446 = D_80114622;
L1_D_800FD448 = D_80114624;
L1_D_800FD44A = D_80114626;
L1_D_800FD44C = D_80114628;
L1_D_800FD44E = D_8011462A;
L1_D_800FD450 = D_8011462C;
L1_D_800FD452 = D_8011462E;
L1_D_800FD454 = D_80114630;
L1_D_800FD456 = D_80114632;
L1_D_800FD458 = D_80114634;
L1_D_800FD45A = D_80114636;
L1_D_800FD45D = D_80114639;
L1_D_800FD45E = D_8011463A;
L1_D_800FD460 = D_8011463C;
L1_D_800FD462 = D_8011463E;
L1_D_800FD464 = D_80114640;
L1_D_800FD466 = D_80114642;
L1_D_800FD46A = D_80114646;
L1_D_800FD46C = D_80114648;
L1_D_800FD46E = D_8011464A;
L1_D_800FD470 = D_8011464C;
L1_D_800FD472 = D_8011464E;
L1_D_800FD476 = D_80114652;
L1_D_800FD824 = D_80114A00;
L1_D_800FD980 = D_80114B5C;
L1_D_800FD984 = D_80114B60;
L1_D_800FD988 = D_80114B64;
L1_D_800FD98C = D_80114B68;
L1_D_800FD990 = D_80114B6C;
L1_D_800FD994 = D_80114B70;
L1_D_800FD998 = D_80114B74;
L1_D_800FD99C = D_80114B78;
L1_D_800FD9A0 = D_80114B7C;
L1_D_800FD9A4 = D_80114B80;
L1_D_800FD9AC = D_80114B88;
L1_D_800FD9C0 = D_80114B9C;
L1_D_800FD9C8 = D_80114BA4;
L1_D_800FD9D0 = D_80114BAC;
L1_D_800FD9D8 = D_80114BB4;
L1_D_800FD9DC = D_80114BB8;
L1_D_800FD9E0 = D_80114BBC;
L1_D_800FD9F4 = D_80114BD0;
L1_D_800FDA04 = D_80114BE0;
L1_D_800FDA08 = D_80114BE4;
L1_D_800FDA0C = D_80114BE8;
L1_D_800FDA24 = D_80114C00;
L1_D_800FDB2C = D_80114D08;
L1_DebugPage_ArtProfile = func_800404A4;
func_8004079C = L1_DebugPage_Camera;
L1_DebugPage_ContourMask = func_8007103C;
L1_DebugPage_FPWeapon = func_80078B24;
L1_DebugPage_Framerate = func_800404E0;
L1_DebugPage_Loadpoint = func_80031EA0;
func_8004052C = L1_DebugPage_ObjectCount;
L1_DebugPage_Profile = func_80040468;
func_8002FE74 = L1_DebugScreen_DrawPage;
L1_DeliverEvent = func_800932F8;
func_80032C70 = L1_DevMenu_Draw;
func_80032A18 = L1_DevMenu_HandleInput;
func_80032E38 = L1_DevMenu_Init;
L1_DisableEvent = func_8009A2A4;
L1_EVENT_OBJ_11C = func_8008513C;
L1_EVENT_OBJ_90 = func_800850B0;
L1_EVENT_OBJ_CC = func_800850EC;
L1_EVENT_OBJ_F4 = func_80085114;
L1_EnableEvent = func_8007E39C;
L1_FlushCache = func_8009A5B4;
L1_FntFlush = func_80087210;
L1_FntLoad = func_80086EB8;
L1_FntOpen = func_80086F58;
L1_FntPrint = func_8008752C;
L1_GPU_cw = func_8008DCCC;
L1_GS_001_OBJ_1F8 = func_80083F88;
L1_GS_001_OBJ_74 = func_80083E04;
L1_GS_107_OBJ_4B8 = func_80076808;
L1_GS_107_OBJ_51C = func_8007686C;
L1_GetClut = func_800812C8;
L1_GetTPage = func_80081348;
func_8002F878 = L1_Gfx_Init;
L1_GsClearOt = func_80088698;
L1_GsDefDispBuff = func_80089978;
L1_GsGetActiveBuff = func_80084300;
L1_GsGetHeadpUnit = func_8008DA04;
L1_GsGetLs = func_80079828;
L1_GsGetLsUnit = func_8008C170;
L1_GsGetLwUnit = func_8008C440;
L1_GsGetTimInfo = func_8008B518;
L1_GsInit3D = func_800898F8;
L1_GsInitGraph = func_80083D90;
L1_GsInitGraph2 = func_80083F20;
L1_GsInitVcount = func_80085200;
L1_GsLinkAnim = func_8008D698;
L1_GsLinkObject4 = func_80085240;
L1_GsMapCoordUnit = func_8008CCA0;
L1_GsMapModelingData = func_8008AE58;
L1_GsMapUnit = func_8008CD20;
L1_GsScanAnim = func_8008D5F0;
L1_GsScanUnit = func_8008D84C;
L1_GsSetAmbient = func_8008DB7C;
L1_GsSetDrawBuffClip = func_80092650;
L1_GsSetDrawBuffOffset = func_80084310;
L1_GsSetFlatLight = func_80076350;
L1_GsSetRefView2 = func_800844E0;
L1_GsSortClear = func_800841A8;
L1_GsSortObject4 = func_8007AB44;
L1_GsSortOt = func_80086DB8;
L1_GsSortUnit = func_8008BF9C;
L1_GsSwapDispBuff = func_800886F8;
L1_GsTMDdivF3NL = func_80089F68;
L1_GsTMDdivG3NL = func_8008A158;
L1_GsTMDdivNF3 = func_80089508;
L1_GsTMDdivNG3 = func_800896F8;
L1_GsTMDdivTF3L = func_8008A358;
L1_GsTMDdivTF3LFG = func_800887A8;
L1_GsTMDdivTF3NL = func_80087D78;
L1_GsTMDdivTG3NL = func_80088028;
L1_GsTMDdivTNF3 = func_8008A908;
L1_GsTMDdivTNG3 = func_8008ABB8;
L1_GsTMDfastF3GL = func_80088278;
L1_GsTMDfastF3GLFG = func_80089A38;
L1_GsTMDfastF3GNL = func_80088FD8;
L1_GsTMDfastF3L = func_8007C1B0;
L1_GsTMDfastF3LFG = func_8007C2F8;
L1_GsTMDfastF3NL = func_8007C070;
L1_GsTMDfastG3GL = func_80088498;
L1_GsTMDfastG3GLFG = func_80089C58;
L1_GsTMDfastG3GNL = func_80089398;
L1_GsTMDfastG3L = func_8007BC0C;
L1_GsTMDfastG3LFG = func_8007BD9C;
L1_GsTMDfastG3NL = func_8007BACC;
L1_GsTMDfastNF3 = func_8007BF34;
L1_GsTMDfastNG3 = func_8007B984;
L1_GsTMDfastTF3L = func_8007B6A4;
L1_GsTMDfastTF3LFG = func_8007B814;
L1_GsTMDfastTF3NL = func_8007B540;
L1_GsTMDfastTG3L = func_8007A7D8;
L1_GsTMDfastTG3LFG = func_8007A98C;
L1_GsTMDfastTG3NL = func_8007A67C;
L1_GsTMDfastTNF3 = func_8007B3D4;
L1_GsTMDfastTNG3 = func_8007A504;
L1_GsU_00000008 = func_80098B74;
L1_GsU_00000009 = func_80098CF4;
L1_GsU_0000000c = func_80098234;
L1_GsU_0000000d = func_800983F4;
L1_GsU_0000000f = func_800985C4;
L1_GsU_00000209 = func_80098E84;
L1_GsU_0000020d = func_800987A4;
L1_GsU_00200009 = func_80099024;
L1_GsU_0020000d = func_80098994;
L1_GsU_01000000 = func_80097294;
L1_GsU_0100000c = func_80096DF4;
L1_GsU_0100000d = func_80097064;
L1_GsU_02000000 = func_80096CB4;
L1_GsU_02000001 = func_80096D44;
L1_GsU_03000000 = D_800973C4;
L1_GsU_03000001 = func_80097B04;
L1_GsU_03000010 = func_80097CE4;
L1_GsU_03000011 = func_80097ED4;
L1_Gssub_make_matrix = func_8008B928;
L1_HookEntryInt = func_80092310;
L1_INTR_DMA_OBJ_1CC = func_800924EC;
L1_INTR_DMA_OBJ_278 = func_80092598;
L1_INTR_DMA_OBJ_4C = func_8009236C;
L1_INTR_VB_OBJ_58 = func_80092218;
L1_INTR_VB_OBJ_C4 = func_80092284;
L1_INTR_VB_OBJ_F0 = func_800922B0;
L1_ISO9660_OBJ_2D8 = func_80082E5C;
L1_ISO9660_OBJ_2F8 = func_80082E7C;
L1_ISO9660_OBJ_5BC = func_80083140;
L1_ISO9660_OBJ_660 = func_800831E4;
L1_ISO9660_OBJ_8FC = func_80083480;
L1_InitGeom = func_80086D30;
L1_InitHeap3 = func_8008ADF8;
L1_LoadClut = func_8008B438;
L1_LoadClut2 = func_8008B4A8;
L1_LoadTPage = func_80094EC8;
func_80071380 = L1_Math_Abs;
func_800713BC = L1_Math_Max;
func_80071470 = L1_Math_Max3;
func_80071408 = L1_Math_Min3;
L1_Menu_ResetState = func_800291F0;
L1_MulMatrix = func_80079E88;
L1_MulMatrix2 = func_80079F98;
L1_OpenEvent = func_8007E4C0;
L1_PADIF_OBJ_120 = func_800948C8;
L1_PADIF_OBJ_1CC = func_80094974;
L1_PADIF_OBJ_290 = func_80094A38;
L1_PADIF_OBJ_48 = func_800947F0;
L1_PADPORTD_OBJ_160 = func_80085690;
L1_PADPORTD_OBJ_1C8 = func_800856F8;
L1_PADPORTD_OBJ_2BC = func_800857EC;
L1_PADPORTD_OBJ_2CC = func_800857FC;
L1_PADPORTD_OBJ_388 = func_800858B8;
L1_PADPORTD_OBJ_604 = func_80085B34;
L1_PADPORTD_OBJ_63C = func_80085B6C;
L1_PADSEQD_OBJ_144 = func_8009374C;
L1_PADSEQD_OBJ_34 = func_8009363C;
L1_PADSEQD_OBJ_488 = func_80093A90;
L1_PATCHGTE_OBJ_DC = D_80094EC4;
L1_PCcreat = func_800842E0;
L1_PClseek = func_80083504;
L1_PCopen = func_80082B64;
L1_PCread = func_8008242C;
L1_PadInitDirect = func_80085530;
func_8004401C = L1_Pad_StickToSpeed;
func_8002F40C = L1_Pad_Update;
func_80040E3C = L1_PauseMenu_Open;
L1_PopMatrix = func_80076A24;
L1_PushMatrix = func_80076980;
L1_ResetEntryInt = func_800925F0;
func_8004181C = L1_RestartPrompt_Open;
L1_ReturnFromException = func_800925E0;
L1_RotAverage3 = func_80095A08;
L1_RotAverageNclip3 = func_80095978;
L1_RotAverageNclipColorCol3 = func_80096384;
L1_RotAverageNclipColorDpq3 = func_80095018;
L1_RotAverageNclipColorDpq3_1 = func_80095470;
L1_RotMatrix = func_8008D0D0;
L1_RotMatrixY = func_8008B788;
L1_RotMatrixYXZ = func_8008D360;
L1_RotMatrixYXZ_gte = func_8008BD0C;
L1_RotTrans = func_8008DC9C;
L1_ScaleMatrix = func_8008DA3C;
L1_SetBackColor = func_800991C4;
L1_SetColorMatrix = func_80076950;
L1_SetDefDispEnv = func_80089F28;
L1_SetDefDrawEnv = func_80089E58;
L1_SetDrawMode = func_800811C8;
L1_SetDumpFnt = func_80086E78;
L1_SetFarColor = func_800998C4;
L1_SetLightMatrix = func_8008DC5C;
L1_SetLineF4 = func_800811A8;
L1_SetRotMatrix = func_8008DC0C;
L1_SetTransMatrix = func_8008DC3C;
L1_SpuClearReverbWorkArea = func_80093328;
L1_SpuFree = func_80093548;
L1_SpuGetVoiceEnvelope = func_80099534;
L1_SpuInitMalloc = func_8009A5D4;
L1_SpuIsTransferCompleted = func_80096544;
L1_SpuMalloc = func_800969E4;
L1_SpuRead = func_800964E4;
L1_SpuSetCommonAttr = func_8008FBA4;
L1_SpuSetKey = func_80099584;
L1_SpuSetNoiseClock = func_80099774;
L1_SpuSetTransferMode = func_80096454;
L1_SpuSetTransferStartAddr = func_80096484;
L1_SpuSetVoiceAttr = func_80092A88;
L1_SpuStart = func_80090A04;
L1_SquareRoot0 = func_800768C0;
L1_SquareRoot12 = func_8008BB18;
L1_SsEnd = func_80085480;
L1_SsPitchFromNote = func_8008EAD0;
L1_SsSeqCalledTbyT = func_80093088;
L1_SsSetSerialAttr = func_800810B8;
L1_SsSetSerialVol = func_80080F0C;
L1_SsSetTickMode = func_80084BE0;
L1_SsUtAllKeyOff = func_80084A80;
L1_SsVabClose = func_800853D0;
L1_SsVabOpenHead = func_8008B398;
L1_SsVabTransBody = func_8008B148;
L1_SsVabTransCompleted = func_8008B218;
L1_SsVoKeyOn = func_80080B64;
L1_SysDeqIntRP = func_800946C8;
L1_SysEnqIntRP = func_800946D8;
L1_TestEvent = func_8009A5C4;
L1_TransposeMatrix = func_8008B9F8;
L1_VSYNC_OBJ_178 = func_800836B0;
L1_VS_VH2_OBJ_34 = func_8008B3CC;
L1_VSync = func_80083538;
func_800710AC = L1_Vec_Dot;
func_80071128 = L1_Vec_ProjectXZ;
func_800711D0 = L1_Vec_Scale;
L1_WaitEvent = func_8009A294;
L1__SN_read = func_80090B0C;
L1__SN_write = func_800926F0;
L1__SpuInit = func_8009091C;
L1__SpuSetAnyVoice = func_8009A634;
L1__SsGetSeqData = func_8009AC34;
L1__SsInit = func_8008DCEC;
L1__SsReadDeltaValue = func_8009B774;
L1__SsSeqGetEof = func_8009A9F0;
L1__SsSeqPlay = func_8009A8F4;
L1__SsSndCrescendo = func_80099B54;
L1__SsSndNextSep = func_8009B674;
L1__SsSndPause = func_80099F84;
L1__SsSndPlay = func_80099B24;
L1__SsSndReplay = func_8009A024;
L1__SsSndTempo = func_80099D64;
L1__SsVmAlloc = func_8008F8F4;
L1__SsVmDoAllocate = func_8008E2DC;
L1__SsVmFlush = func_8008DE4C;
L1__SsVmInit = func_800991E4;
L1__SsVmKeyOffNow = func_8008F0CC;
L1__SsVmKeyOnNow = func_8008EBFC;
L1__SsVmSelectToneAndVag = func_800997C4;
L1__SsVmVSetUp = func_8008DD8C;
L1__dirFailAuto = func_800939B0;
L1__gp = D_800AA26C;
L1__padInitDirSeq = func_80093608;
L1__patch_gte = func_80094DE8;
L1__spu_gcSPU = func_8009A2B4;
L1_bzero = func_80093AC8;
L1_calloc3 = func_8008AEC8;
L1_chkRC2wait = func_80094708;
L1_exit = func_800812E8;
L1_free3 = func_8008AFF8;
L1_func_80026B00 = func_80026B1C;
func_80026B60 = L1_func_80026B44;
L1_func_80026C14 = func_80026C30;
func_80026CAC = L1_func_80026C90;
L1_func_80026D08 = func_80026D24;
func_80026EEC = L1_func_80026ED0;
L1_func_80026F30 = func_80026F4C;
func_80027264 = L1_func_80027248;
func_800272C0 = L1_func_800272A4;
func_800273B0 = L1_func_80027394;
PROVIDE(L1_func_800274F4 = func_800276AC);
PROVIDE(func_800276AC = L1_func_800274F4);
func_80028528 = L1_func_80028370;
L1_func_8002847C = func_80028634;
func_80028830 = L1_func_80028678;
L1_func_800286EC = func_800288A4;
func_800288E4 = L1_func_8002872C;
func_800289C8 = L1_func_80028810;
func_80028A10 = L1_func_80028858;
func_80028B10 = L1_func_80028958;
L1_func_800289C0 = func_80028B78;
func_80028D10 = L1_func_80028B58;
func_80028DC0 = L1_func_80028C08;
func_80028F74 = L1_func_80028DBC;
func_8002921C = L1_func_80029064;
L1_func_800291B0 = func_80029368;
func_8002966C = L1_func_800294B4;
func_800296BC = L1_func_80029504;
func_8002983C = L1_func_80029684;
L1_func_80029868 = func_80029A20;
L1_func_800299CC = func_80029B84;
PROVIDE(L1_func_80029A34 = func_80029BEC);
PROVIDE(func_80029BEC = L1_func_80029A34);
L1_func_8002A3C8 = func_8002A580;
func_8002A7D4 = L1_func_8002A61C;
func_8002A8D8 = L1_func_8002A720;
func_8002AA0C = L1_func_8002A854;
func_8002AC4C = L1_func_8002AA94;
L1_func_8002AAC4 = func_8002AC7C;
func_8002ACB4 = L1_func_8002AAFC;
func_8002AE48 = L1_func_8002AC90;
L1_func_8002ADF0 = func_8002AFA8;
func_8002AFEC = L1_func_8002AE34;
L1_func_8002AF08 = func_8002B0C0;
func_8002B1B0 = L1_func_8002AFF8;
L1_func_8002B064 = func_8002B21C;
func_8002B258 = L1_func_8002B0A0;
func_8002B334 = L1_func_8002B17C;
PROVIDE(L1_func_8002B29C = func_8002B454);
PROVIDE(func_8002B454 = L1_func_8002B29C);
func_8002B854 = L1_func_8002B69C;
L1_func_8002BB34 = func_8002BCEC;
func_8002BD20 = L1_func_8002BB68;
func_8002BDD0 = L1_func_8002BC18;
L1_func_8002BDE4 = func_8002BF9C;
func_8002BFDC = L1_func_8002BE24;
func_8002C0EC = L1_func_8002BF34;
func_8002C320 = L1_func_8002C168;
L1_func_8002C2D8 = func_8002C490;
func_8002C648 = L1_func_8002C490;
L1_func_8002C664 = func_8002C81C;
func_8002C874 = L1_func_8002C6BC;
func_8002D2C4 = L1_func_8002D0F0;
func_8002D3A8 = L1_func_8002D1D4;
func_8002D6B8 = L1_func_8002D4E4;
func_8002D7D8 = L1_func_8002D604;
func_8002D8DC = L1_func_8002D708;
func_8002DF40 = L1_func_8002DD6C;
L1_func_8002E0E8 = func_8002E2BC;
func_8002E384 = L1_func_8002E1B0;
func_8002E4EC = L1_func_8002E318;
func_8002E6B0 = L1_func_8002E4DC;
func_8002E798 = L1_func_8002E5C4;
PROVIDE(L1_func_8002E798 = func_8002E96C);
PROVIDE(func_8002E96C = L1_func_8002E798);
L1_func_8002F1BC = func_8002F390;
L1_func_8002F1F4 = func_8002F3C8;
L1_func_8002F53C = func_8002F710;
func_8002F738 = L1_func_8002F564;
func_8002F7F8 = L1_func_8002F624;
L1_func_8002FE04 = func_8002FFD0;
PROVIDE(L1_func_8002FFD8 = func_800301A4);
PROVIDE(func_800301A4 = L1_func_8002FFD8);
func_800302E4 = L1_func_80030118;
func_80030478 = L1_func_800302AC;
L1_func_80030304 = func_800304D0;
func_80030500 = L1_func_80030334;
func_80030580 = L1_func_800303B4;
PROVIDE(L1_func_8003052C = func_800306F8);
PROVIDE(func_800306F8 = L1_func_8003052C);
L1_func_800305B4 = func_80030780;
L1_func_80030610 = func_800307DC;
func_8003083C = L1_func_80030670;
func_80030964 = L1_func_80030798;
PROVIDE(L1_func_80030994 = func_80030B60);
PROVIDE(func_80030B60 = L1_func_80030994);
func_80030CD0 = L1_func_80030B04;
func_80030ED4 = L1_func_80030D08;
func_80030F6C = L1_func_80030DA0;
func_800310EC = L1_func_80030F20;
func_80031174 = L1_func_80030FA8;
func_80031280 = L1_func_800310B4;
L1_func_800314A0 = func_8003166C;
L1_func_80031F18 = func_8003211C;
L1_func_80031F28 = func_8003212C;
L1_func_80031F54 = func_80032134;
L1_func_80032024 = func_8003213C;
func_8003218C = L1_func_80032074;
L1_func_80032150 = func_80032268;
func_80032308 = L1_func_800321F0;
L1_func_80032348 = func_80032460;
func_800325A8 = L1_func_8003246C;
L1_func_800324C0 = func_800325FC;
func_8003260C = L1_func_800324D0;
L1_func_80032648 = func_80032784;
func_80032860 = L1_func_80032724;
func_800328A4 = L1_func_80032768;
L1_func_80032880 = func_800329BC;
func_80032F88 = L1_func_80032E4C;
PROVIDE(L1_func_80032EFC = func_80033038);
PROVIDE(func_80033038 = L1_func_80032EFC);
func_800331CC = L1_func_80033090;
func_800333E0 = L1_func_800332A4;
func_80033458 = L1_func_80033348;
L1_func_80033F38 = func_80033A20;
func_8003446C = L1_func_80034998;
func_800344CC = L1_func_800349F8;
func_80034B04 = L1_func_80035030;
L1_func_800350F0 = func_80034BC4;
PROVIDE(L1_func_800352B8 = func_80034D5C);
PROVIDE(func_80034D5C = L1_func_800352B8);
func_80035408 = L1_func_80035964;
func_80035490 = L1_func_800359EC;
func_80035660 = L1_func_80035BBC;
func_8003588C = L1_func_80035DE8;
func_800359A8 = L1_func_80035F04;
func_80035C60 = L1_func_800361BC;
func_80035DCC = L1_func_80036328;
func_80036058 = L1_func_800365B4;
func_80036114 = L1_func_80036670;
func_8003689C = L1_func_80036E10;
L1_func_800373FC = func_80036E88;
func_800371B0 = L1_func_80037768;
func_8003723C = L1_func_800377F4;
func_80037344 = L1_func_800378FC;
func_8003746C = L1_func_80037A24;
func_80037514 = L1_func_80037ACC;
L1_func_80037B6C = func_800375B4;
func_80037AD0 = L1_func_800380DC;
PROVIDE(L1_func_800381CC = func_80037BC0);
PROVIDE(func_80037BC0 = L1_func_800381CC);
func_80037DF8 = L1_func_80038404;
func_800380F8 = L1_func_8003872C;
func_8003832C = L1_func_80038984;
func_80038628 = L1_func_80038C04;
func_800386B0 = L1_func_80038C8C;
L1_func_800390F8 = func_80038B1C;
PROVIDE(L1_func_800391B0 = func_80038BD4);
PROVIDE(func_80038BD4 = L1_func_800391B0);
L1_func_800393AC = func_80038DD0;
func_80038E08 = L1_func_800393E4;
L1_func_80039520 = func_80038F44;
L1_func_800395E8 = func_8003900C;
func_800391CC = L1_func_800397A8;
PROVIDE(L1_func_8003982C = func_80039250);
PROVIDE(func_80039250 = L1_func_8003982C);
func_80039458 = L1_func_80039A34;
PROVIDE(L1_func_80039A9C = func_800394C0);
PROVIDE(func_800394C0 = L1_func_80039A9C);
PROVIDE(L1_func_8003A51C = func_80039F40);
PROVIDE(func_80039F40 = L1_func_8003A51C);
PROVIDE(L1_func_8003A68C = func_8003A0B0);
PROVIDE(func_8003A0B0 = L1_func_8003A68C);
L1_func_8003A71C = func_8003A140;
func_8003A2BC = L1_func_8003A898;
func_8003A438 = L1_func_8003AA14;
PROVIDE(L1_func_8003AC1C = func_8003A640);
PROVIDE(func_8003A640 = L1_func_8003AC1C);
func_8003AF18 = L1_func_8003B4F4;
PROVIDE(L1_func_8003B53C = func_8003AF60);
PROVIDE(func_8003AF60 = L1_func_8003B53C);
L1_func_8003B750 = func_8003B174;
PROVIDE(L1_func_8003B808 = func_8003B22C);
PROVIDE(func_8003B22C = L1_func_8003B808);
func_8003B364 = L1_func_8003B940;
func_8003B6BC = L1_func_8003BC98;
func_8003B88C = L1_func_8003BE68;
func_8003B9DC = L1_func_8003BFB8;
L1_func_8003C1BC = func_8003BBE0;
func_8003BF1C = L1_func_8003C6B0;
func_8003BF50 = L1_func_8003C6E4;
func_8003C0F8 = L1_func_8003C88C;
func_8003C110 = L1_func_8003C8A4;
func_8003C230 = L1_func_8003C9C4;
L1_func_8003CA4C = func_8003C2B8;
func_8003C328 = L1_func_8003CABC;
PROVIDE(L1_func_8003CC8C = func_8003C4F8);
PROVIDE(func_8003C4F8 = L1_func_8003CC8C);
PROVIDE(L1_func_8003D76C = func_8003CFD8);
PROVIDE(func_8003CFD8 = L1_func_8003D76C);
func_8003D6C4 = L1_func_8003DE58;
func_8003D9C4 = L1_func_8003E158;
func_8003DD00 = L1_func_8003E494;
PROVIDE(L1_func_8003E5A0 = func_8003DE0C);
PROVIDE(func_8003DE0C = L1_func_8003E5A0);
func_8003E290 = L1_func_8003EA24;
func_8003E36C = L1_func_8003EB00;
PROVIDE(L1_func_8003EC44 = func_8003E4B0);
PROVIDE(func_8003E4B0 = L1_func_8003EC44);
func_8003EFD4 = L1_func_8003F768;
func_8003F4CC = L1_func_8003FC60;
func_8003F550 = L1_func_8003FCE4;
func_8003F808 = L1_func_8003FF9C;
PROVIDE(L1_func_8004009C = func_8003F908);
PROVIDE(func_8003F908 = L1_func_8004009C);
func_8003FF4C = L1_func_800406E0;
PROVIDE(L1_func_80040778 = func_8003FFE4);
PROVIDE(func_8003FFE4 = L1_func_80040778);
func_800401E4 = L1_func_80040978;
func_80040314 = L1_func_80040AA8;
func_800408C8 = L1_func_8004105C;
func_80040A28 = L1_func_800411BC;
func_80040C74 = L1_func_800413F4;
L1_func_800414AC = func_80040D2C;
func_80041044 = L1_func_800417C4;
L1_func_800419CC = func_80041310;
func_8004137C = L1_func_80041A38;
func_800414E4 = L1_func_80041BA0;
func_8004156C = L1_func_80041C28;
func_80041634 = L1_func_80041CF0;
func_80041700 = L1_func_80041DBC;
func_800417BC = L1_func_80041E78;
func_80041964 = L1_func_80042020;
func_80041AD0 = L1_func_8004218C;
PROVIDE(L1_func_800425E4 = func_80041F28);
PROVIDE(func_80041F28 = L1_func_800425E4);
L1_func_80042A94 = func_800423D8;
func_8004246C = L1_func_80042B28;
func_80042660 = L1_func_80042D1C;
L1_func_80042E34 = func_80042778;
L1_func_80042E6C = func_800427B0;
func_800429BC = L1_func_80043078;
func_80042B44 = L1_func_80043200;
L1_func_800433A8 = func_80042CEC;
L1_func_800433F4 = func_80042D38;
PROVIDE(L1_func_80043610 = func_80042F54);
PROVIDE(func_80042F54 = L1_func_80043610);
PROVIDE(L1_func_80043B14 = func_80043458);
PROVIDE(func_80043458 = L1_func_80043B14);
L1_func_80043EE0 = func_80043824;
func_800441C4 = L1_func_800448F4;
PROVIDE(L1_func_80044BCC = func_800443BC);
PROVIDE(func_800443BC = L1_func_80044BCC);
func_80044874 = L1_func_80045084;
func_80044924 = L1_func_8004514C;
func_80044B1C = L1_func_80045344;
PROVIDE(L1_func_80045A28 = func_80044E8C);
PROVIDE(func_80044E8C = L1_func_80045A28);
func_800456D0 = L1_func_8004626C;
func_80046798 = L1_func_80047318;
L1_func_800474AC = func_8004692C;
func_80046934 = L1_func_800475BC;
L1_func_800477C0 = func_80046B38;
L1_func_8004782C = func_80046BA4;
L1_func_8004783C = func_80046BB4;
L1_func_800478C8 = func_80046C40;
func_80046C90 = L1_func_80047A04;
func_80046DDC = L1_func_80047B50;
func_80047000 = L1_func_800483D8;
func_80047044 = L1_func_8004841C;
PROVIDE(L1_func_80048794 = func_800473BC);
PROVIDE(func_800473BC = L1_func_80048794);
func_80047774 = L1_func_80048B4C;
func_80047A0C = L1_func_80048DE4;
func_80047A88 = L1_func_80048E60;
L1_func_80048FE8 = func_80047C10;
L1_func_8004900C = func_80047C34;
func_80047E48 = L1_func_80049470;
func_80048114 = L1_func_8004973C;
func_800482BC = L1_func_800498E4;
func_80048460 = L1_func_80049A88;
L1_func_8004A29C = func_80048554;
L1_func_8004A2E0 = func_80048598;
L1_func_8004A304 = func_800485BC;
L1_func_8004A338 = func_800485F0;
L1_func_8004A370 = func_80048628;
L1_func_8004A380 = func_80048638;
L1_func_8004A398 = func_80048650;
L1_func_8004A81C = func_800487A4;
L1_func_8004A85C = func_800487E4;
L1_func_8004A8A8 = func_80048830;
PROVIDE(L1_func_8004A9E4 = func_8004886C);
PROVIDE(func_8004886C = L1_func_8004A9E4);
func_80048D94 = L1_func_8004AF0C;
L1_func_8004B028 = func_80048EB0;
L1_func_8004B04C = func_80048ED4;
L1_func_8004B05C = func_80048EE4;
L1_func_8004B06C = func_80048EF4;
L1_func_8004B084 = func_80048F0C;
func_80048F38 = L1_func_8004B194;
L1_func_8004B270 = func_80049014;
L1_func_8004B324 = func_800490C8;
L1_func_8004B334 = func_800490D8;
func_80049160 = L1_func_8004B9FC;
func_80049264 = L1_func_8004BB00;
func_800493D4 = L1_func_8004BC70;
func_8004950C = L1_func_8004BDA8;
L1_func_8004BE84 = func_800495E8;
L1_func_8004BF70 = func_800496D4;
func_80049824 = L1_func_8004C0C0;
PROVIDE(L1_func_8004C368 = func_80049ACC);
PROVIDE(func_80049ACC = L1_func_8004C368);
func_80049BFC = L1_func_8004C498;
L1_func_8004C50C = func_80049C70;
func_80049CBC = L1_func_8004C558;
L1_func_8004C5C8 = func_80049D2C;
L1_func_8004C698 = func_80049DFC;
L1_func_8004C768 = func_80049ECC;
L1_func_8004C824 = func_80049F88;
func_80049F90 = L1_func_8004C82C;
func_8004A0A8 = L1_func_8004C944;
func_8004A1C0 = L1_func_8004CA5C;
func_8004A290 = L1_func_8004CB2C;
func_8004A358 = L1_func_8004CBF4;
func_8004A43C = L1_func_8004CCD8;
func_8004A478 = L1_func_8004CD14;
func_8004A504 = L1_func_8004CDA0;
L1_func_8004CE38 = func_8004A59C;
func_8004A5D8 = L1_func_8004CE74;
func_8004A664 = L1_func_8004CF00;
PROVIDE(L1_func_8004D048 = func_8004A7AC);
PROVIDE(func_8004A7AC = L1_func_8004D048);
func_8004A978 = L1_func_8004D214;
func_8004AA34 = L1_func_8004D2D0;
L1_func_8004D5A8 = func_8004AD0C;
func_8004AE90 = L1_func_8004D72C;
func_8004AED4 = L1_func_8004D770;
func_8004AFA8 = L1_func_8004D844;
func_8004AFF0 = L1_func_8004D88C;
func_8004B0DC = L1_func_8004D978;
L1_func_8004DA60 = func_8004B1C4;
func_8004B350 = L1_func_8004DBCC;
func_8004B520 = L1_func_8004DD9C;
func_8004B77C = L1_func_8004DFF8;
func_8004B800 = L1_func_8004E07C;
func_8004BA88 = L1_func_8004E304;
func_8004BAAC = L1_func_8004E328;
PROVIDE(L1_func_8004E5D8 = func_8004BC58);
PROVIDE(func_8004BC58 = L1_func_8004E5D8);
L1_func_8004E78C = func_8004BE0C;
func_8004BE14 = L1_func_8004E794;
func_8004BF1C = L1_func_8004E89C;
func_8004BFEC = L1_func_8004E96C;
func_8004C02C = L1_func_8004E9AC;
L1_func_8004EA68 = func_8004C0E8;
func_8004C138 = L1_func_8004EAB8;
func_8004C1A0 = L1_func_8004EB20;
func_8004C2F0 = L1_func_8004EC70;
func_8004C5C4 = L1_func_8004EF44;
L1_func_8004F134 = func_8004C7B4;
func_8004C7C8 = L1_func_8004F148;
func_8004C9C8 = L1_func_8004F348;
L1_func_8004F3D8 = func_8004CA58;
PROVIDE(L1_func_8004F3E8 = func_8004CA68);
PROVIDE(func_8004CA68 = L1_func_8004F3E8);
PROVIDE(L1_func_8004F880 = func_8004CF00);
PROVIDE(func_8004CF00 = L1_func_8004F880);
PROVIDE(L1_func_8004FD3C = func_8004D3BC);
PROVIDE(func_8004D3BC = L1_func_8004FD3C);
func_8004D800 = L1_func_80050180;
func_8004DA0C = L1_func_8005038C;
PROVIDE(L1_func_800503D8 = func_8004DA58);
PROVIDE(func_8004DA58 = L1_func_800503D8);
func_8004DFE0 = L1_func_80050960;
func_8004E01C = L1_func_8005099C;
func_8004E064 = L1_func_800509E4;
func_8004E090 = L1_func_80050A10;
PROVIDE(L1_func_80050A70 = func_8004E0F0);
PROVIDE(func_8004E0F0 = L1_func_80050A70);
func_8004F8A0 = L1_func_800523E4;
func_8004FAEC = L1_func_80052630;
func_8004FCC4 = L1_func_80052808;
func_8004FFE8 = L1_func_80052B2C;
L1_func_80052BEC = func_800500A8;
func_8005030C = L1_func_80053004;
func_80050388 = L1_func_80053080;
L1_func_800530F4 = func_800503FC;
func_80050940 = L1_func_80053684;
L1_func_800536F0 = func_800509AC;
L1_func_80053790 = func_80050A4C;
func_80050AC0 = L1_func_80053804;
func_80050C38 = L1_func_8005397C;
func_80050CE8 = L1_func_80053A2C;
func_80050D38 = L1_func_80053A7C;
func_80050E20 = L1_func_80053B64;
L1_func_80053BD0 = func_80050E8C;
func_80050E9C = L1_func_80053BE0;
L1_func_80053DAC = func_80051068;
func_800510A0 = L1_func_80053DE4;
func_80051194 = L1_func_80053ED8;
func_800514DC = L1_func_80054098;
func_80051510 = L1_func_800540CC;
func_8005155C = L1_func_80054118;
func_800515B0 = L1_func_8005416C;
func_800516AC = L1_func_80054268;
func_80051750 = L1_func_8005430C;
func_80051800 = L1_func_800543BC;
func_80051858 = L1_func_80054414;
func_80051A48 = L1_func_80054604;
func_80051AE0 = L1_func_8005469C;
func_80051C08 = L1_func_800547C4;
func_80051C80 = L1_func_8005483C;
func_80051DA8 = L1_func_80054964;
func_80051F0C = L1_func_80054AC8;
func_8005203C = L1_func_80054BF8;
func_800521E8 = L1_func_80054DA4;
func_8005227C = L1_func_80054E38;
func_80052378 = L1_func_80054F34;
func_80052420 = L1_func_80054FDC;
func_800524A4 = L1_func_80055060;
func_800525B0 = L1_func_8005516C;
func_80052648 = L1_func_80055204;
func_800526E0 = L1_func_8005529C;
func_80052740 = L1_func_800552FC;
func_800527A0 = L1_func_8005535C;
func_80052804 = L1_func_800553C0;
func_80052954 = L1_func_80055510;
func_800529DC = L1_func_80055598;
func_80052AB4 = L1_func_80055670;
func_80052C0C = L1_func_800557C8;
PROVIDE(L1_func_800557F4 = func_80052C38);
PROVIDE(func_80052C38 = L1_func_800557F4);
func_80052C58 = L1_func_80055814;
PROVIDE(L1_func_80055878 = func_80052CBC);
PROVIDE(func_80052CBC = L1_func_80055878);
PROVIDE(L1_func_80055BA8 = func_80052FEC);
PROVIDE(func_80052FEC = L1_func_80055BA8);
func_80053268 = L1_func_80055E24;
func_8005339C = L1_func_80055F58;
func_80053498 = L1_func_80056054;
func_80053554 = L1_func_80056110;
PROVIDE(L1_func_80056154 = func_80053598);
PROVIDE(func_80053598 = L1_func_80056154);
func_8005379C = L1_func_80056358;
func_80053800 = L1_func_800563BC;
func_80053888 = L1_func_80056444;
func_800538F0 = L1_func_800564AC;
func_8005397C = L1_func_80056538;
func_800539B4 = L1_func_80056570;
func_80053A20 = L1_func_800565DC;
func_80053A58 = L1_func_80056614;
func_80053B3C = L1_func_800566F8;
func_80053C80 = L1_func_8005683C;
func_80053CD8 = L1_func_80056894;
func_80054160 = L1_func_80056D1C;
func_800543D4 = L1_func_80056F90;
func_800544B8 = L1_func_80057074;
func_8005453C = L1_func_800570F8;
func_800545D8 = L1_func_80057194;
func_800545FC = L1_func_800571B8;
PROVIDE(L1_func_800572F4 = func_80054738);
PROVIDE(func_80054738 = L1_func_800572F4);
func_800547E8 = L1_func_800573A4;
func_80054854 = L1_func_80057410;
func_80054880 = L1_func_8005743C;
func_800548C0 = L1_func_8005747C;
func_80054A40 = L1_func_800575FC;
L1_func_80057648 = func_80054A8C;
PROVIDE(L1_func_80057750 = func_80054B94);
PROVIDE(func_80054B94 = L1_func_80057750);
func_80054EF4 = L1_func_80057AB0;
L1_func_80057AD8 = func_80054F1C;
func_80054F70 = L1_func_80057B2C;
L1_func_80057B94 = func_80054FD8;
L1_func_80057BFC = func_80055040;
func_80055084 = L1_func_80057C40;
PROVIDE(L1_func_80057E80 = func_800552C4);
PROVIDE(func_800552C4 = L1_func_80057E80);
L1_func_80058694 = func_80055AD8;
func_80055CA0 = L1_func_8005885C;
func_80055E9C = L1_func_80058A58;
func_80055F54 = L1_func_80058B10;
func_80055FB0 = L1_func_80058B6C;
func_80056144 = L1_func_80058D00;
func_800561A0 = L1_func_80058D5C;
func_80056240 = L1_func_80058DFC;
PROVIDE(L1_func_80058F28 = func_8005636C);
PROVIDE(func_8005636C = L1_func_80058F28);
func_80056A78 = L1_func_80059634;
func_80057058 = L1_func_80059C14;
PROVIDE(L1_func_80059E4C = func_80057290);
PROVIDE(func_80057290 = L1_func_80059E4C);
func_800581B0 = L1_func_8005AD6C;
L1_func_8005ADB0 = func_800581F4;
PROVIDE(L1_func_8005ADD4 = func_80058218);
PROVIDE(func_80058218 = L1_func_8005ADD4);
PROVIDE(L1_func_8005AEF8 = func_8005833C);
PROVIDE(func_8005833C = L1_func_8005AEF8);
func_8005894C = L1_func_8005B508;
func_800589C8 = L1_func_8005B584;
func_800589F0 = L1_func_8005B5AC;
func_80058B10 = L1_func_8005B6CC;
func_80058BB0 = L1_func_8005B76C;
func_80058C00 = L1_func_8005B7BC;
func_80058CB0 = L1_func_8005B86C;
func_80058DB0 = L1_func_8005B96C;
func_80058E74 = L1_func_8005BA30;
func_80058F2C = L1_func_8005BAE8;
func_800590C4 = L1_func_8005BC80;
func_80059334 = L1_func_8005BEF0;
func_80059550 = L1_func_8005C10C;
PROVIDE(L1_func_8005C214 = func_80059658);
PROVIDE(func_80059658 = L1_func_8005C214);
func_80059780 = L1_func_8005C33C;
L1_func_8005C864 = func_80059CA8;
L1_func_8005C894 = func_80059CD8;
func_80059D08 = L1_func_8005C8C4;
func_80059E64 = L1_func_8005CA20;
L1_func_8005CB38 = func_80059F64;
func_8005A180 = L1_func_8005CED0;
func_8005A278 = L1_func_8005CFC8;
func_8005A560 = L1_func_8005D2B0;
L1_func_8005D58C = func_8005A83C;
func_8005A874 = L1_func_8005D5C4;
func_8005A8E0 = L1_func_8005D630;
L1_func_8005D654 = func_8005A904;
func_8005A944 = L1_func_8005D694;
func_8005AA10 = L1_func_8005D760;
L1_func_8005DA90 = func_8005AD40;
PROVIDE(L1_func_8005DB7C = func_8005AE2C);
PROVIDE(func_8005AE2C = L1_func_8005DB7C);
func_8005AEF0 = L1_func_8005DC40;
L1_func_8005DF40 = func_8005B1F0;
func_8005B22C = L1_func_8005DF7C;
func_8005B2D0 = L1_func_8005E020;
func_8005B4D8 = L1_func_8005E228;
PROVIDE(L1_func_8005E424 = func_8005B6D4);
PROVIDE(func_8005B6D4 = L1_func_8005E424);
func_8005BD8C = L1_func_8005EADC;
func_8005BE1C = L1_func_8005EB6C;
func_8005BF34 = L1_func_8005EC84;
L1_func_8005ED88 = func_8005C038;
func_8005C0A8 = L1_func_8005EE6C;
L1_func_8005F3B0 = func_8005C5E4;
func_8005CB1C = L1_func_8005F93C;
func_8005CC88 = L1_func_8005FAA8;
func_8005D134 = L1_func_8005FF60;
L1_func_80060094 = func_8005D268;
L1_func_800600EC = func_8005D2C0;
func_8005D610 = L1_func_8006043C;
func_8005D684 = L1_func_800604B0;
L1_func_8006060C = func_8005D7E0;
func_8005D7E8 = L1_func_80060614;
func_8005D96C = L1_func_80060798;
func_8005DAB8 = L1_func_800608E4;
func_8005DC94 = L1_func_80060AC0;
L1_func_80060E28 = func_8005DFD0;
L1_func_80061018 = func_8005E174;
PROVIDE(L1_func_80061068 = func_8005E1C4);
PROVIDE(func_8005E1C4 = L1_func_80061068);
func_8005E724 = L1_func_800615C8;
L1_func_80061700 = func_8005E85C;
func_8005E864 = L1_func_80061708;
L1_func_80061DC0 = func_8005ED00;
func_8005EDD4 = L1_func_80061EC4;
L1_func_80061F38 = func_8005EE48;
L1_func_80061FB4 = func_8005EEC4;
func_8005F078 = L1_func_80062300;
func_8005F10C = L1_func_80062394;
func_8005F4FC = L1_func_80062784;
func_8005F8E0 = L1_func_80062B68;
func_8005FCB0 = L1_func_80062F38;
PROVIDE(L1_func_80062FAC = func_8005FD24);
PROVIDE(func_8005FD24 = L1_func_80062FAC);
func_8005FFA8 = L1_func_800632AC;
func_800600AC = L1_func_800633B0;
func_800601BC = L1_func_800634C0;
func_800603B4 = L1_func_800636B8;
func_800604AC = L1_func_800637B0;
L1_func_80063858 = func_80060554;
L1_func_80063ADC = func_800607D8;
func_8006081C = L1_func_80063B20;
func_800609A8 = L1_func_80063CAC;
func_80060A3C = L1_func_80063D40;
L1_func_80063ED4 = func_80060BD0;
L1_func_80063EF8 = func_80060BF4;
func_80060C30 = L1_func_80063F34;
func_80060C80 = L1_func_80063F84;
func_80060E28 = L1_func_8006412C;
func_80060E78 = L1_func_8006417C;
func_80060F18 = L1_func_8006439C;
func_80061058 = L1_func_800644DC;
func_80061198 = L1_func_8006461C;
func_800611DC = L1_func_80064660;
func_800613C8 = L1_func_8006484C;
func_8006158C = L1_func_80064A10;
func_800617A4 = L1_func_80064C28;
L1_func_80064E40 = func_800619BC;
func_80061C30 = L1_func_80065510;
L1_func_80065588 = func_80061CA8;
func_80061CD8 = L1_func_800655B8;
func_80061D34 = L1_func_80065614;
L1_func_800658B4 = func_80061FD4;
func_80062048 = L1_func_80065928;
PROVIDE(L1_func_80065A20 = func_80062140);
PROVIDE(func_80062140 = L1_func_80065A20);
func_800627B8 = L1_func_80066098;
func_800629C8 = L1_func_800662A8;
func_80062BD8 = L1_func_800664B8;
func_80062E24 = L1_func_80066704;
L1_func_8006692C = func_8006304C;
L1_func_80066968 = func_80063088;
func_800630C4 = L1_func_800669A4;
L1_func_80066A60 = func_80063180;
L1_func_80066B14 = func_80063234;
L1_func_80067F18 = func_80063B9C;
func_800643EC = L1_func_800689F0;
L1_func_80069318 = func_80064C80;
L1_func_80069328 = func_80064C90;
L1_func_800693DC = func_80064D04;
func_80064D14 = L1_func_80069478;
L1_func_8006981C = func_80064EE8;
L1_func_80069850 = func_80064F54;
L1_func_800698B8 = func_80064F98;
L1_func_8006B198 = func_800673EC;
L1_func_8006B1DC = func_80067430;
L1_func_8006B230 = func_80067484;
func_800674C8 = L1_func_8006B274;
PROVIDE(L1_func_8006B2C4 = func_80067518);
PROVIDE(func_80067518 = L1_func_8006B2C4);
func_800686E8 = L1_func_8006C494;
func_80068B48 = L1_func_8006C8F4;
PROVIDE(L1_func_8006CB88 = func_80068DDC);
PROVIDE(func_80068DDC = L1_func_8006CB88);
PROVIDE(L1_func_8006CEA4 = func_800690F8);
PROVIDE(func_800690F8 = L1_func_8006CEA4);
func_80069614 = L1_func_8006D3C0;
PROVIDE(L1_func_8006D470 = func_800696C4);
PROVIDE(func_800696C4 = L1_func_8006D470);
func_80069F74 = L1_func_8006DD20;
PROVIDE(L1_func_8006E054 = func_8006A2A8);
PROVIDE(func_8006A2A8 = L1_func_8006E054);
func_8006A874 = L1_func_8006E620;
func_8006AC34 = L1_func_8006E9E0;
func_8006AF10 = L1_func_8006ECBC;
func_8006B0FC = L1_func_8006EEA8;
func_8006B288 = L1_func_8006F034;
PROVIDE(L1_func_8006F168 = func_8006B3BC);
PROVIDE(func_8006B3BC = L1_func_8006F168);
func_8006B900 = L1_func_8006F6AC;
PROVIDE(L1_func_8006F784 = func_8006B9D8);
PROVIDE(func_8006B9D8 = L1_func_8006F784);
func_8006BBF8 = L1_func_8006F9A4;
func_8006BCA8 = L1_func_8006FA54;
func_8006BD58 = L1_func_8006FB04;
func_8006C128 = L1_func_8006FED4;
func_8006C2C4 = L1_func_80070070;
func_8006C520 = L1_func_800702CC;
func_8006C7FC = L1_func_800705A8;
func_8006C944 = L1_func_800706F0;
func_8006D88C = L1_func_80071638;
PROVIDE(L1_func_80072190 = func_8006E3E4);
PROVIDE(func_8006E3E4 = L1_func_80072190);
func_8006E660 = L1_func_8007240C;
PROVIDE(L1_func_800726D0 = func_8006E924);
PROVIDE(func_8006E924 = L1_func_800726D0);
func_8006EF9C = L1_func_80072D48;
func_8006F07C = L1_func_80072E28;
PROVIDE(L1_func_8007369C = func_8006F8F0);
PROVIDE(func_8006F8F0 = L1_func_8007369C);
func_8007063C = L1_func_800743E8;
PROVIDE(L1_func_800746D0 = func_80070924);
PROVIDE(func_80070924 = L1_func_800746D0);
func_8007123C = L1_func_80074FE8;
L1_func_80075290 = func_800751F8;
func_80075228 = L1_func_800752C0;
PROVIDE(L1_func_800752E8 = func_80075250);
PROVIDE(func_80075250 = L1_func_800752E8);
L1_func_800753A4 = func_8007530C;
L1_func_800753F0 = func_80075358;
func_800753C4 = L1_func_8007545C;
func_80075524 = L1_func_800755BC;
func_800755E4 = L1_func_8007567C;
func_80075728 = L1_func_800757C0;
L1_func_800758C0 = func_80075828;
func_80075858 = L1_func_800758F0;
func_80075888 = L1_func_80075920;
func_80075CB0 = L1_func_80075D48;
func_80075E04 = L1_func_80075E9C;
func_80075E88 = L1_func_80075F20;
L1_func_80075FA0 = func_80075F08;
L1_func_80075FE4 = func_80075F4C;
func_80075F7C = L1_func_80076014;
L1_func_800760B4 = func_8007601C;
func_8007606C = L1_func_80076104;
func_800760EC = L1_func_80076184;
func_80076144 = L1_func_800761DC;
L1_func_80077764 = func_80076AD0;
L1_func_800779FC = func_80076D68;
L1_func_80077CCC = func_80077038;
L1_func_80077D50 = func_800770BC;
L1_func_80077FC4 = func_80077330;
L1_func_800781B4 = func_80077520;
L1_func_80078534 = func_800778A0;
L1_func_800785A8 = func_80077914;
L1_func_800787FC = func_80077B68;
L1_func_80078840 = func_80077BAC;
L1_func_800792B8 = func_800786E0;
L1_func_800794A0 = func_80078AD8;
L1_func_800794D4 = func_80078B0C;
L1_func_80079588 = func_80078BC0;
L1_func_800797A8 = func_80078DE0;
L1_func_8007980C = func_80078E30;
L1_func_800798A8 = func_80078EA0;
L1_func_800798D4 = func_80078ECC;
L1_func_80079B94 = func_8007918C;
L1_func_80079C04 = func_800791FC;
L1_func_80079C54 = func_8007924C;
L1_func_80079D84 = func_80079368;
L1_func_80079DB8 = func_8007939C;
L1_func_80079E10 = func_800793F4;
L1_func_80079F84 = func_80079568;
L1_func_8007A040 = func_80079624;
L1_func_8007A17C = func_80079760;
L1_func_8007A1B0 = func_80079794;
L1_func_8007A4E4 = func_80079AF8;
L1_func_8007A554 = func_80079B68;
L1_func_8007A580 = func_80079B94;
L1_func_8007A614 = func_80079C28;
L1_func_8007A694 = func_80079CA8;
L1_func_8007AA94 = func_8007A0A8;
L1_func_8007AC7C = func_8007A290;
L1_func_8007CE30 = func_8007C444;
L1_func_8007D184 = func_8007C798;
L1_func_8007D1E8 = func_8007C7FC;
L1_func_8007D260 = func_8007C874;
L1_func_8007D2B4 = func_8007C8C8;
L1_func_8007D914 = func_8007CF28;
L1_func_8007DA88 = func_8007D09C;
L1_func_8007DE50 = func_8007D464;
L1_func_8007E610 = func_8007DC24;
L1_func_8007E6A4 = func_8007DCB8;
L1_func_8007EB7C = func_8007E190;
L1_func_8007EC78 = func_8007E28C;
L1_func_8007ED98 = func_8007E3AC;
L1_func_8007EE34 = func_8007E448;
L1_func_8007EE64 = func_8007E478;
L1_func_8007EEBC = func_8007E4D0;
L1_func_8007EECC = func_8007E4E0;
L1_func_8007F040 = func_8007E654;
L1_func_8007F0D8 = func_8007E6EC;
L1_func_8007F140 = func_8007E754;
L1_func_8007F25C = func_8007E870;
L1_func_8007F2EC = func_8007E900;
L1_func_8007F34C = func_8007E960;
L1_func_8007F414 = func_8007EA28;
L1_func_8007F4C0 = func_8007EAD4;
L1_func_8007F530 = func_8007EB44;
L1_func_8007F5F0 = func_8007EC04;
L1_func_8007FAE8 = func_8007F0FC;
L1_func_8007FCE0 = func_8007F2F4;
L1_func_8007FF50 = func_8007F564;
L1_func_8007FF70 = func_8007F584;
L1_func_80080008 = func_8007F61C;
L1_func_800800A0 = func_8007F6B4;
L1_func_800800BC = func_8007F6D0;
L1_func_8008013C = func_8007F750;
L1_func_80080154 = func_8007F768;
L1_func_80080234 = func_8007F848;
L1_func_80080464 = func_8007FA78;
L1_func_800806A0 = func_8007FCB4;
L1_func_80080920 = func_8007FF34;
L1_func_80080944 = func_8007FF58;
L1_func_80080958 = func_8007FF6C;
L1_func_80080998 = func_8007FFAC;
L1_func_800809E0 = func_8007FFF4;
L1_func_80080A10 = func_80080024;
L1_func_80080A34 = func_80080048;
L1_func_80080CE4 = func_800802F8;
L1_func_80080F44 = func_80080558;
L1_func_80081094 = func_800806A8;
L1_func_800811D0 = func_800807E4;
L1_func_80081204 = func_80080818;
L1_func_80081348 = func_8008095C;
L1_func_800813E8 = func_800809FC;
L1_func_80081410 = func_80080A24;
L1_func_80081448 = func_80080A5C;
L1_func_80081458 = func_80080A6C;
L1_func_800814CC = func_80080AE0;
L1_func_800815A0 = func_80080BB4;
L1_func_80081A08 = func_8008101C;
L1_func_80081B74 = func_80081188;
L1_func_80081C54 = func_80081268;
L1_func_80081C84 = func_80081298;
L1_func_80081CE4 = func_800812F8;
L1_func_80081D14 = func_80081328;
L1_func_80082638 = func_80081C4C;
L1_func_800828AC = func_80081EC0;
L1_func_8008297C = func_80081F90;
L1_func_80082B64 = func_80082178;
L1_func_80082D00 = func_80082314;
L1_func_80082E04 = func_80082418;
L1_func_80082ED8 = func_800824EC;
L1_func_80082EE8 = func_800824FC;
L1_func_80082EF8 = func_8008250C;
L1_func_80082F04 = func_80082518;
L1_func_80082F24 = func_80082538;
L1_func_80082F44 = func_80082558;
L1_func_80082F64 = func_80082578;
L1_func_80082F78 = func_8008258C;
L1_func_80082F8C = func_800825A0;
L1_func_800830C8 = func_800826DC;
L1_func_800831FC = func_80082810;
L1_func_80083348 = func_8008295C;
L1_func_80083368 = func_8008297C;
L1_func_80083388 = func_8008299C;
L1_func_800833AC = func_800829C0;
L1_func_800833CC = func_800829E0;
L1_func_800834D0 = func_80082AE4;
L1_func_80083F14 = func_80083528;
L1_func_80084134 = func_80083748;
L1_func_80084164 = func_80083778;
L1_func_80084194 = func_800837A8;
L1_func_800841C4 = func_800837D8;
L1_func_80084228 = func_8008383C;
L1_func_80084238 = func_8008384C;
L1_func_80084250 = func_80083864;
L1_func_80084328 = func_8008393C;
L1_func_800844F8 = func_80083B0C;
L1_func_80084640 = func_80083C54;
L1_func_800846E0 = func_80083CF4;
L1_func_80084758 = func_80083D6C;
L1_func_80084E0C = func_80084420;
L1_func_800855BC = func_80084BD0;
L1_func_8008571C = func_80084D30;
L1_func_8008596C = func_80084F80;
L1_func_800859B8 = func_80084FCC;
L1_func_80085B5C = func_80085170;
L1_func_80085BD0 = func_800851E4;
L1_func_800865BC = func_80085BD0;
L1_func_80086688 = func_80085C9C;
L1_func_80086780 = func_80085D94;
L1_func_80086854 = func_80085E68;
L1_func_8008688C = func_80085EA0;
L1_func_800868D4 = func_80085EE8;
L1_func_80086928 = func_80085F3C;
L1_func_80086A40 = func_80086054;
L1_func_80086A6C = func_80086080;
L1_func_80086AD4 = func_800860E8;
L1_func_80086C64 = func_80086278;
L1_func_80086D30 = func_80086344;
L1_func_80086D74 = func_80086388;
L1_func_800870A8 = func_800866BC;
L1_func_80087198 = func_800867AC;
L1_func_800873A8 = func_800869BC;
L1_func_80087620 = func_80086C34;
L1_func_800876B0 = func_80086CC4;
L1_func_800876E4 = func_80086CF8;
L1_func_80088C44 = func_80088258;
L1_func_8008A404 = func_80089A18;
L1_func_8008A904 = func_80089F18;
L1_func_8008C5A4 = func_8008BBB8;
L1_func_8008C5C4 = func_8008BBD8;
L1_func_8008C5D8 = func_8008BBEC;
L1_func_8008C638 = func_8008BC4C;
L1_func_8008CCB8 = func_8008C0CC;
L1_func_8008D2EC = func_8008C700;
L1_func_8008DAAC = func_8008CEC0;
L1_func_8008DB68 = func_8008CF7C;
L1_func_8008DBDC = func_8008CFF0;
L1_func_8008E03C = func_8008D6E0;
L1_func_8008E378 = func_8008DA1C;
L1_func_8008FAE8 = func_8008F18C;
L1_func_80090004 = func_8008F6A8;
L1_func_80090164 = func_8008F808;
L1_func_80090880 = func_8008FF24;
L1_func_80090B00 = func_800901A4;
L1_func_80090CC0 = func_80090364;
L1_func_80090D7C = func_80090420;
L1_func_80090FFC = func_800906A0;
L1_func_80091080 = func_80090724;
L1_func_800910C4 = func_80090768;
L1_func_80091168 = func_8009080C;
L1_func_800911C0 = func_80090864;
L1_func_800911E8 = func_8009088C;
L1_func_80091210 = func_800908B4;
L1_func_80091450 = func_80090AF4;
L1_func_80091480 = func_80090B24;
L1_func_800919DC = func_80091080;
L1_func_80091C5C = func_80091300;
L1_func_80091F24 = func_800915C8;
L1_func_80092330 = func_800919D4;
L1_func_80092404 = func_80091AA8;
L1_func_800924F4 = func_80091B98;
L1_func_800926D4 = func_80091D78;
L1_func_8009283C = func_80091EE0;
L1_func_8009293C = func_80091FE0;
L1_func_80092A34 = func_800920D8;
L1_func_80092F24 = func_800925C8;
L1_func_80092F5C = func_80092600;
L1_func_8009302C = func_800926D0;
L1_func_80093C64 = func_80093308;
L1_func_80093E24 = func_800934C8;
L1_func_80093F24 = func_800935C8;
L1_func_80093F4C = func_800935F0;
L1_func_80094434 = func_80093AD8;
L1_func_80094440 = func_80093AE4;
L1_func_800944C4 = func_80093B68;
L1_func_80094734 = func_80093DD8;
L1_func_8009476C = func_80093E10;
L1_func_80094840 = func_80093EE4;
L1_func_800948E8 = func_80093F8C;
L1_func_80094CE0 = func_80094384;
L1_func_80094D48 = func_800943EC;
L1_func_80094D64 = func_80094408;
L1_func_80094E2C = func_800944D0;
L1_func_80094EC4 = func_80094568;
L1_func_80094F18 = func_800945BC;
L1_func_80094F78 = func_8009461C;
L1_func_80094F98 = func_8009463C;
L1_func_80094FAC = func_80094650;
L1_func_80094FCC = func_80094670;
L1_func_80094FEC = func_80094690;
L1_func_8009500C = func_800946B0;
L1_func_80095104 = func_800947A8;
L1_func_800957F0 = func_80094E94;
L1_func_80095914 = func_80094FB8;
L1_func_80095934 = func_80094FD8;
L1_func_80095954 = func_80094FF8;
L1_func_80095A44 = func_800950E8;
L1_func_80095A64 = func_80095108;
L1_func_80095D7C = func_80095420;
L1_func_80095ECC = func_80095570;
L1_func_80096270 = func_80095914;
L1_func_800963C4 = func_80095A68;
L1_func_80096738 = func_80095DDC;
L1_func_800967BC = func_80095E60;
L1_func_80096BC0 = func_80096264;
L1_func_80096C54 = func_800962F8;
L1_func_80096C9C = func_80096340;
L1_func_80096F50 = func_800965F4;
L1_func_80099EB0 = func_80099554;
L1_func_8009A0A0 = func_80099744;
L1_func_8009A1F0 = func_80099894;
L1_func_8009A3B0 = func_80099A54;
L1_func_8009A9E0 = func_8009A084;
L1_func_8009AB60 = func_8009A204;
L1_func_8009B940 = func_8009AFE4;
L1_func_8009BEAC = func_8009B550;
L1_func_8009BF10 = func_8009B5B4;
L1_func_8009BFC0 = func_8009B664;
L1_func_800AACFC = func_800AA68C;
L1_func_800AAEF8 = func_800AA888;
L1_gPsi = D_800B357C;
L1_g_Args = D_800B355C;
L1_g_CamPosX = D_800B360C;
L1_g_CamPosY = D_800B3610;
L1_g_CamRotX = D_800B35D4;
L1_g_CamTargetX = D_800B35C8;
L1_g_Camera = D_800B35C4;
L1_g_CheatCodeProgress = D_800B3F88;
L1_g_CheatCodes = D_8009C360;
L1_g_CutScene = D_8009C3A0;
L1_g_DebugPageNames = D_8009C4F4;
L1_g_DebugTextX = D_8009C6BC;
L1_g_DebugTextY = D_8009C6BE;
L1_g_DevMenu = D_800D6494;
L1_g_FrameCap = D_800B3F0C;
L1_g_FrameRate = D_8009C450;
L1_g_GodMode = D_8009C3DE;
L1_g_Invincible = D_8009C12C;
L1_g_MenuUpdateFunc = D_800D788C;
L1_g_PadAxes = D_800B42CC;
L1_g_PadAxesPrev = D_800B42D0;
L1_g_PadHeld = D_800B42B4;
L1_g_PadPressed = D_800B42BC;
L1_g_PadPrev = D_800B42C0;
L1_g_Player = D_800B3F70;
L1_g_Projection = D_800B3670;
L1_g_Weapons = D_800B3684;
L1_gteMIMefunc = func_8008BA98;
L1_gte_rotate_z_matrix = func_80092708;
L1_jtbl_800A6F68 = jtbl_800A6404;
L1_jtbl_800A7168 = jtbl_800A6604;
L1_jtbl_800A7380 = jtbl_800A681C;
L1_jtbl_800A74B0 = jtbl_800A694C;
L1_jtbl_800A7764 = jtbl_800A6C00;
L1_jtbl_800A7ED8 = jtbl_800A7394;
L1_jtbl_800A8028 = jtbl_800A74E4;
L1_jtbl_800A8088 = jtbl_800A7544;
L1_jtbl_800A859C = jtbl_800A7A58;
L1_jtbl_800A8AC0 = jtbl_800A7F0C;
L1_jtbl_800A8B20 = jtbl_800A7F6C;
L1_jtbl_800A8BE8 = jtbl_800A8034;
L1_jtbl_800A98E4 = jtbl_800A9218;
L1_jtbl_800A9AEC = jtbl_800A9478;
L1_jtbl_800A9DF8 = jtbl_800A9784;
L1_jtbl_800AA190 = jtbl_800A9B1C;
L1_jtbl_800AA1F0 = jtbl_800A9B7C;
L1_jtbl_800AA270 = jtbl_800A9BFC;
L1_jtbl_800AA2A8 = jtbl_800A9C34;
L1_jtbl_800AA330 = jtbl_800A9CBC;
L1_jtbl_800AA540 = jtbl_800A9ECC;
L1_jtbl_800AA560 = jtbl_800A9EEC;
L1_jtbl_800AA780 = jtbl_800AA10C;
L1_jtbl_800AA860 = jtbl_800AA1EC;
L1_jtbl_800AA880 = jtbl_800AA20C;
L1_malloc3 = func_8008AF48;
L1_memchr = func_8008B208;
L1_memcpy = func_8008DCDC;
L1_memmove = func_80090A7C;
L1_memset = func_8008BA88;
L1_note2pitch = func_8008EA1C;
L1_note2pitch2 = func_8008EA68;
L1_printf = func_8007E4B0;
L1_rand = func_800810A8;
L1_ratan2 = func_8008B608;
L1_rcos = func_800998E4;
L1_rsin = func_80099984;
L1_setRC2wait = func_800946E8;
L1_setjmp = func_80092300;
L1_sin_1 = func_800999C0;
L1_sprintf = func_80081388;
L1_start = func_8002C9C0;
L1_startIntrDMA = func_80092320;
L1_startIntrVSync = func_800921C0;
L1_strcat = func_800834F4;
L1_strcmp = func_8008B248;
L1_strcpy = func_800812B8;
L1_strlen = func_80081288;
L1_strncmp = func_800921B0;
L1_strncpy = func_8008DC8C;
L1_strstr = func_8008B388;
L1_strtok = func_8008B258;
L1_strtol = func_8008B378;
L1_toupper = func_80081178;
L1_vmNoiseOff = func_8008FB64;
L1_vmNoiseOn = func_8008E4AC;
L2_D_800A0425 = D_8009B891;
L2_D_800A0426 = D_8009B892;
L2_D_800A0438 = D_8009B8A4;
L2_D_800A0C92 = D_8009C0FE;
L2_D_800A0CC0 = D_8009C12C;
L2_D_800A0CC4 = D_8009C130;
L2_D_800A0CD4 = D_8009C140;
L2_D_800A0CDC = D_8009C148;
L2_D_800A0EF4 = D_8009C360;
L2_D_800A0F34 = D_8009C3A0;
L2_D_800A0F88 = D_8009C3F4;
L2_D_800A0F8C = D_8009C3F8;
L2_D_800A0FAB = D_8009C417;
L2_D_800A0FD0 = D_8009C43C;
L2_D_800A0FE0 = D_8009C44C;
L2_D_800A0FE4 = D_8009C450;
L2_D_800A101F = D_8009C48B;
L2_D_800A106C = D_8009C4D8;
L2_D_800A11F0 = D_8009C650;
L2_D_800A11FE = D_8009C65E;
L2_D_800A1200 = D_8009C660;
L2_D_800A1204 = D_8009C664;
L2_D_800A1230 = D_8009C690;
L2_D_800A123C = D_8009C69C;
L2_D_800A1240 = D_8009C6A0;
L2_D_800A1248 = D_8009C6A8;
L2_D_800A124C = D_8009C6AC;
L2_D_800A1254 = D_8009C6B4;
L2_D_800A1258 = D_8009C6B8;
L2_D_800A125A = D_8009C6BA;
L2_D_800A125C = D_8009C6BC;
L2_D_800A125E = D_8009C6BE;
L2_D_800A1278 = D_8009C6D8;
L2_D_800A1344 = D_8009C744;
L2_D_800A1346 = D_8009C746;
L2_D_800A1366 = D_8009C766;
L2_D_800A1634 = D_8009C968;
L2_D_800A1640 = D_8009C974;
L2_D_800A167C = D_8009C9B0;
L2_D_800A19A0 = D_8009CBA4;
L2_D_800A1A1C = D_8009CC20;
L2_D_800A1C74 = D_8009CE78;
L2_D_800A1CC4 = D_8009CED0;
L2_D_800A1EEC = D_8009D0F8;
L2_D_800A3E74 = D_8009DAE8;
L2_D_800A3E8C = D_8009DB00;
L2_D_800AC49C = D_800A635C;
L2_D_800AC4AC = D_800A636C;
L2_D_800AC4D4 = D_800A6394;
L2_D_800AC6FC = D_800A65BC;
L2_D_800AC80C = D_800A66CC;
L2_D_800AC820 = D_800A66E0;
L2_D_800ACB1C = D_800A69DC;
L2_D_800ACB40 = D_800A6A00;
L2_D_800ACB4C = D_800A6A0C;
L2_D_800ACB88 = D_800A6A48;
L2_D_800ACB9C = D_800A6A5C;
L2_D_800ACC18 = D_800A6AD8;
L2_D_800ACC2C = D_800A6AEC;
L2_D_800ACC40 = D_800A6B00;
L2_D_800ACC54 = D_800A6B14;
L2_D_800ACC7C = D_800A6B3C;
L2_D_800ACC88 = D_800A6B48;
L2_D_800ACC9C = D_800A6B5C;
L2_D_800ACF24 = D_800A6DD8;
L2_D_800ACF38 = D_800A6DEC;
L2_D_800ACF48 = D_800A6DFC;
L2_D_800ACF5C = D_800A6E10;
L2_D_800ACF70 = D_800A6E24;
L2_D_800ACF94 = D_800A6E48;
L2_D_800ACFCC = D_800A6E80;
L2_D_800AD400 = D_800A727C;
L2_D_800AD428 = D_800A72A4;
L2_D_800AD820 = D_800A769C;
L2_D_800ADA08 = D_800A7884;
L2_D_800ADA50 = D_800A78CC;
L2_D_800ADA58 = D_800A78D4;
L2_D_800ADC24 = D_800A7AA0;
L2_D_800ADE00 = D_800A7BDC;
L2_D_800ADE10 = D_800A7BEC;
L2_D_800ADE20 = D_800A7BFC;
L2_D_800ADE6C = D_800A7C48;
L2_D_800ADE80 = D_800A7C5C;
L2_D_800ADEB8 = D_800A7C94;
L2_D_800AE5A4 = D_800A8294;
L2_D_800AF09C = D_800A8DE8;
L2_D_800AF0A0 = D_800A8DEC;
L2_D_800AF140 = D_800A8E8C;
L2_D_800AF160 = D_800A9140;
L2_D_800AF188 = D_800A9168;
L2_D_800B0F58 = D_800AAED0;
L2_D_800B0FF8 = D_800AAF70;
L2_D_800B0FFC = D_800AAF74;
L2_D_800B1018 = D_800AAF90;
L2_D_800B102C = D_800AAFA4;
L2_D_800B117C = D_800AB214;
L2_D_800B118C = D_800AB224;
L2_D_800B1DC4 = D_800ABE5C;
L2_D_800B1F2C = D_800AC0E8;
L2_D_800B1F30 = D_800AC0EC;
L2_D_800B1FA0 = D_800AC15C;
L2_D_800B4E3C = D_800B2388;
L2_D_800B4E6C = D_800B23B8;
L2_D_800B56B4 = D_800B2C00;
L2_D_800B5738 = D_800B2C84;
L2_D_800B5739 = D_800B2C85;
L2_D_800B5F3C = D_800B3488;
L2_D_800B5F49 = D_800B3495;
L2_D_800B5F4A = D_800B3496;
L2_D_800B5F4B = D_800B3497;
L2_D_800B5F50 = D_800B349C;
L2_D_800B5FB4 = D_800B3500;
L2_D_800B6010 = D_800B355C;
L2_D_800B6014 = D_800B3560;
L2_D_800B6030 = D_800B357C;
L2_D_800B6038 = D_800B3584;
L2_D_800B603C = D_800B3588;
L2_D_800B6054 = D_800B35A0;
L2_D_800B6058 = D_800B35A4;
L2_D_800B605C = D_800B35A8;
L2_D_800B6060 = D_800B35AC;
L2_D_800B6064 = D_800B35B0;
L2_D_800B60C0 = D_800B360C;
L2_D_800B6104 = D_800B3650;
L2_D_800B6120 = D_800B366C;
L2_D_800B6138 = D_800B3684;
L2_D_800B6A94 = D_800B3A20;
L2_D_800B6C78 = D_800B3C04;
L2_D_800B6C94 = D_800B3C20;
L2_D_800B6CA8 = D_800B3C34;
L2_D_800B6D4C = D_800B3CD8;
L2_D_800B6F80 = D_800B3F0C;
L2_D_800B6F88 = D_800B3F14;
L2_D_800B6F8C = D_800B3F18;
L2_D_800B6FC4 = D_800B3F50;
L2_D_800B6FE4 = D_800B3F70;
L2_D_800B6FFC = D_800B3F88;
L2_D_800B70F4 = D_800B4080;
L2_D_800B7114 = D_800B40A0;
L2_D_800B7140 = D_800B40CC;
L2_D_800B7170 = D_800B40FC;
L2_D_800B7284 = D_800B4210;
L2_D_800B72B4 = D_800B4240;
L2_D_800B72B8 = D_800B4244;
L2_D_800B72C0 = D_800B424C;
L2_D_800B72C8 = D_800B4254;
L2_D_800B7318 = D_800B42A4;
L2_D_800B7324 = D_800B42B0;
L2_D_800B7328 = D_800B42B4;
L2_D_800B7330 = D_800B42BC;
L2_D_800B7334 = D_800B42C0;
L2_D_800B7338 = D_800B42C4;
L2_D_800B733C = D_800B42C8;
L2_D_800B7340 = D_800B42CC;
L2_D_800B7344 = D_800B42D0;
L2_D_800BF408 = D_800BC394;
L2_D_800BF46C = D_800BC3F8;
L2_D_800C625C = D_800C50C4;
L2_D_800CD020 = D_800CDD64;
L2_D_800D5318 = D_800D605C;
L2_D_800D55A0 = D_800D62E4;
L2_D_800D55A4 = D_800D62E8;
L2_D_800D55A8 = D_800D62EC;
L2_D_800D5670 = D_800D63B4;
L2_D_800D58E0 = D_800D6624;
L2_D_800D6B48 = D_800D788C;
L2_D_800D6B70 = D_800D78B4;
L2_D_800D6BB8 = D_800D7908;
L2_D_800D6D20 = D_800D7920;
L2_D_800D70B4 = D_800D7CB4;
L2_D_800D8500 = D_800D9100;
L2_D_800D9C5C = D_800DA85C;
L2_D_800D9FE4 = D_800DABE4;
L2_D_800DA034 = D_800DAC34;
L2_D_800DA12C = D_800DAD2C;
L2_D_800DA410 = D_800DB010;
L2_D_800DA894 = D_800DB494;
L2_D_800DA8AC = D_800DB4AC;
L2_D_800DAE20 = D_800DBA20;
L2_D_800DAE24 = D_800DBA24;
L2_D_800DAE44 = D_800DBA44;
L2_D_800DB3D8 = D_800DBFD8;
L2_D_800DB814 = D_800DC354;
L2_D_800DBA48 = D_800DC540;
L2_D_800DBA6C = D_800DC564;
L2_D_800DBA70 = D_800DC568;
L2_D_800DBA98 = D_800DC590;
L2_D_800DCAE0 = D_800DD5D0;
L2_D_800DCD68 = D_800DD858;
L2_D_800E0068 = D_800E0FA4;
L2_D_800E006C = D_800E0FA8;
L2_D_800E0070 = D_800E0FAC;
L2_D_800E0074 = D_800E0FB0;
L2_D_800E0078 = D_800E0FB4;
L2_D_800E007C = D_800E0FB8;
L2_D_800E0080 = D_800E0FBC;
L2_D_800E0084 = D_800E0FC0;
L2_D_800E0088 = D_800E0FC4;
L2_D_800E008C = D_800E0FC8;
L2_D_800E00E4 = D_800E1020;
L2_D_800E00E8 = D_800E1024;
L2_D_800E00EC = D_800E1028;
L2_D_800E01B0 = D_800E10EC;
L2_D_800E01B4 = D_800E10F0;
L2_D_800E01B8 = D_800E10F4;
L2_D_800E01BC = D_800E10F8;
L2_D_800E01C4 = D_800E1100;
L2_D_800E01C8 = D_800E1104;
L2_D_800E01D0 = D_800E110C;
L2_D_800E01D4 = D_800E1110;
L2_D_800E01D8 = D_800E1114;
L2_D_800E01DC = D_800E1118;
L2_D_800E0228 = D_800E1164;
L2_D_800E022C = D_800E1168;
L2_D_800E030C = D_800E1248;
L2_D_800E0310 = D_800E124C;
L2_D_800E04FC = D_800E1438;
L2_D_800E0500 = D_800E143C;
L2_D_800E0504 = D_800E1440;
L2_D_800E1510 = D_800E2448;
L2_D_800E1514 = D_800E244C;
L2_D_800E1554 = D_800E248C;
L2_D_800E1628 = D_800E2560;
L2_D_800E6694 = D_800E5630;
L2_D_800E680C = D_800FB934;
L2_D_800E6810 = D_800FB938;
L2_D_800F4010 = D_80108138;
L2_D_800F4458 = D_801083CC;
L2_D_800F44DC = D_80108450;
L2_D_80100D94 = D_80114D08;
L2_func_8002680C = func_8002680C;
func_800268CC = L2_func_800268CC;
L2_func_80026B00 = func_80026B1C;
L2_func_80026F5C = func_80026F4C;
L2_func_80027274 = func_80027264;
func_80027510 = L2_func_80027520;
func_800288A4 = L2_func_800288B4;
L2_func_800288F4 = func_800288E4;
L2_func_800289D8 = func_800289C8;
L2_func_80028B20 = func_80028B10;
func_80028B78 = L2_func_80028B88;
func_800291F0 = L2_func_80029200;
L2_func_80029378 = func_80029368;
L2_func_80029A30 = func_80029A20;
L2_func_8002A7E4 = func_8002A7D4;
L2_func_8002A8E8 = func_8002A8D8;
func_8002AC7C = L2_func_8002AC8C;
func_8002AFA8 = L2_func_8002AFB8;
func_8002B0C0 = L2_func_8002B0D0;
func_8002B21C = L2_func_8002B22C;
L2_func_8002B464 = func_8002B454;
func_8002BCEC = L2_func_8002BCFC;
func_8002BF9C = L2_func_8002BFAC;
L2_func_8002C330 = func_8002C320;
func_8002C490 = L2_func_8002C4A0;
func_8002C81C = L2_func_8002C82C;
L2_func_8002D39C = func_8002D3A8;
func_8002E2BC = L2_func_8002E24C;
func_8002E314 = L2_func_8002E2A4;
func_8002E36C = L2_func_8002E2FC;
func_8002E3FC = L2_func_8002E38C;
func_8002E574 = L2_func_8002E508;
func_8002E660 = L2_func_8002E5F4;
func_8002E708 = L2_func_8002E69C;
func_8002F278 = L2_func_8002F214;
func_8002F390 = L2_func_8002F32C;
func_8002F3C8 = L2_func_8002F364;
func_8002F648 = L2_func_8002F5E4;
func_8002F710 = L2_func_8002F6AC;
L2_func_8002F6D4 = func_8002F738;
L2_func_8002F814 = func_8002F878;
func_8002FFD0 = L2_func_8002FF60;
func_800304D0 = L2_func_80030454;
func_800304F0 = L2_func_80030474;
func_80030520 = L2_func_800304A4;
L2_func_80030504 = func_80030580;
L2_func_80030704 = func_80030780;
L2_func_800307C0 = func_8003083C;
func_800308BC = L2_func_80030840;
func_80030A34 = L2_func_800309B8;
func_8003107C = L2_func_80031000;
func_80031EA0 = L2_func_80031E68;
L2_func_80031F34 = func_80031F6C;
func_80032460 = L2_func_800324E8;
L2_func_80032684 = func_800325FC;
func_80032784 = L2_func_8003280C;
L2_func_8003292C = func_800328A4;
L2_func_80033254 = func_800331CC;
L2_func_80035C7C = func_80034D5C;
L2_func_800368C8 = func_800359A8;
L2_func_8003815C = func_8003723C;
L2_func_8003838C = func_8003746C;
func_800375B4 = L2_func_800384D4;
L2_func_800387C4 = func_800378A4;
L2_func_80039920 = func_8003832C;
func_8003844C = L2_func_80039A40;
func_800385AC = L2_func_80039BA0;
func_80038668 = L2_func_80039C5C;
func_80038B1C = L2_func_8003A110;
func_80038DD0 = L2_func_8003A3C4;
func_80038F44 = L2_func_8003A538;
L2_func_8003AA8C = func_800394C0;
func_8003A140 = L2_func_8003B70C;
L2_func_8003BC0C = func_8003A640;
L2_func_8003D7E4 = func_8003C110;
func_800404E0 = L2_func_80041990;
func_80040D2C = L2_func_800421C8;
func_8004124C = L2_func_800426E8;
func_80041310 = L2_func_800427AC;
func_800423D8 = L2_func_80043874;
L2_func_80043908 = func_8004246C;
L2_func_80043AFC = func_80042660;
func_80042778 = L2_func_80043C14;
L2_func_80043C4C = func_800427B0;
L2_func_80043E58 = func_800429BC;
func_80044188 = L2_func_80045624;
func_8004428C = L2_func_80045728;
func_80044324 = L2_func_800457C0;
L2_func_80046098 = func_80044B1C;
func_80044BF8 = L2_func_800462CC;
L2_func_800481FC = func_8004692C;
L2_func_8004857C = func_80046BA4;
func_80046BB4 = L2_func_8004858C;
L2_func_800497E4 = func_80047774;
func_80047C10 = L2_func_80049C80;
func_80048554 = L2_func_8004AF34;
func_80048598 = L2_func_8004AF78;
func_800485BC = L2_func_8004AF9C;
func_800485F0 = L2_func_8004AFD0;
func_80048628 = L2_func_8004B008;
func_80048638 = L2_func_8004B018;
func_800487A4 = L2_func_8004B46C;
func_800487E4 = L2_func_8004B4AC;
func_80048830 = L2_func_8004B4F8;
func_80048EB0 = L2_func_8004BC78;
func_80048EE4 = L2_func_8004BCAC;
func_80048EF4 = L2_func_8004BCBC;
func_80048F0C = L2_func_8004BCD4;
L2_func_8004BE84 = func_80048FD8;
func_80049014 = L2_func_8004BEC0;
func_800490D8 = L2_func_8004D48C;
L2_func_8004DC58 = func_80049264;
func_800496D4 = L2_func_8004E1B0;
func_80049C70 = L2_func_8004E88C;
func_80049ECC = L2_func_8004EAE8;
L2_func_8004EDDC = func_8004A1C0;
func_8004A59C = L2_func_8004F24C;
L2_func_8004F288 = func_8004A5D8;
L2_func_8004F314 = func_8004A664;
func_8004AD0C = L2_func_8004F9BC;
L2_func_800501B0 = func_8004B520;
func_8004BB00 = L2_func_80050790;
L2_func_80050AA4 = func_8004BE14;
func_8004C0E8 = L2_func_80050D78;
func_8004C7B4 = L2_func_80051444;
func_800500C8 = L2_func_80054E54;
func_800503FC = L2_func_80055188;
func_8005090C = L2_func_80055698;
func_800509AC = L2_func_80055738;
L2_func_8005590C = func_80050CE8;
func_80050D14 = L2_func_80055938;
func_80050DFC = L2_func_80055A20;
func_80051068 = L2_func_80055C8C;
func_80051354 = L2_func_80055F78;
func_800514A0 = L2_func_80055FFC;
func_80051590 = L2_func_800560EC;
func_80053944 = L2_func_80058570;
func_80054B70 = L2_func_8005979C;
func_80054E68 = L2_func_80059A94;
func_80054F1C = L2_func_80059B48;
func_80054FD8 = L2_func_80059C04;
func_80055040 = L2_func_80059C6C;
L2_func_80059EF0 = func_800552C4;
L2_func_8005AE6C = func_800581B0;
func_800581F4 = L2_func_8005AEB0;
L2_func_8005BA6C = func_80058DB0;
L2_func_8005C964 = func_80059CA8;
L2_func_8005C994 = func_80059CD8;
L2_func_8005C9C4 = func_80059D08;
L2_func_8005CB20 = func_80059E64;
func_8005A83C = L2_func_8005D5CC;
L2_func_8005D670 = func_8005A8E0;
L2_func_8005D6D4 = func_8005A944;
func_8005AD40 = L2_func_8005DAD0;
func_8005B1F0 = L2_func_8005DF80;
func_8005BF64 = L2_func_8005ECF4;
func_8005C038 = L2_func_8005EDC8;
L2_func_8005EF48 = func_8005C1B8;
L2_func_8005F374 = func_8005C5E4;
func_8005C9BC = L2_func_8005F74C;
L2_func_8005F8AC = func_8005CB1C;
L2_func_8005FBBC = func_8005CE2C;
L2_func_800606F8 = func_8005D7E8;
L2_func_800609C8 = func_8005DAB8;
func_8005DFB4 = L2_func_80060EC4;
func_8005DFD0 = L2_func_80060EE0;
L2_func_8006114C = func_8005E1C4;
L2_func_800616AC = func_8005E724;
L2_func_800617EC = func_8005E864;
L2_func_80061A24 = func_8005E908;
L2_func_80061CE8 = func_8005EBCC;
func_8005ED00 = L2_func_80061E1C;
func_8005EE48 = L2_func_80061F64;
L2_func_800622F4 = func_8005F078;
L2_func_80063630 = func_800603B4;
func_80060554 = L2_func_800637D0;
func_800607D8 = L2_func_80063A54;
L2_func_80063A98 = func_8006081C;
func_80060BD0 = L2_func_80063E4C;
L2_func_80063EFC = func_80060C80;
func_800619BC = L2_func_80064C38;
func_80061CA8 = L2_func_80064F24;
func_80061FD4 = L2_func_80065250;
func_80063180 = L2_func_800663FC;
func_80064C80 = L2_func_80069DD8;
L2_func_8006B2F0 = func_800663B8;
func_80067430 = L2_func_8006E97C;
func_80067484 = L2_func_8006E9D0;
L2_func_80072648 = func_8006B0FC;
L2_func_800727D4 = func_8006B288;
func_8007103C = L2_func_80078588;
func_8007108C = L2_func_800785D8;
func_8007530C = L2_func_80078B44;
func_80075358 = L2_func_80078B90;
func_80075808 = L2_func_80079040;
func_80075834 = L2_func_8007906C;
func_80075E74 = L2_func_800796AC;
func_80075F08 = L2_func_80079740;
func_80075F4C = L2_func_80079784;
func_8007601C = L2_func_80079854;
L2_func_8007D6E0 = func_80078BC0;
L2_func_8007E33C = func_80079760;
L2_func_8007E370 = func_80079794;
L2_func_8007F098 = func_8007A504;
L2_func_8007F210 = func_8007A67C;
L2_func_8007F36C = func_8007A7D8;
L2_func_8007F520 = func_8007A98C;
L2_func_8007FF68 = func_8007B3D4;
L2_func_800800D4 = func_8007B540;
L2_func_80080238 = func_8007B6A4;
L2_func_800803A8 = func_8007B814;
L2_func_80080518 = func_8007B984;
L2_func_80080660 = func_8007BACC;
L2_func_800807A0 = func_8007BC0C;
L2_func_80080930 = func_8007BD9C;
L2_func_80080AC8 = func_8007BF34;
L2_func_80080C04 = func_8007C070;
L2_func_80080D44 = func_8007C1B0;
L2_func_80080E8C = func_8007C2F8;
L2_func_80081390 = func_8007C7FC;
L2_func_80083044 = func_8007E4B0;
L2_func_80083064 = func_8007E4D0;
L2_func_80083074 = func_8007E4E0;
L2_func_80083280 = func_8007E6EC;
L2_func_80083494 = func_8007E900;
L2_func_800855E0 = func_80080A4C;
L2_func_800855F0 = func_80080A5C;
L2_func_80085C3C = func_800810A8;
L2_func_80085D5C = func_800811C8;
L2_func_80085E1C = func_80081288;
L2_func_80085E4C = func_800812B8;
L2_func_80085E7C = func_800812E8;
L2_func_80085EDC = func_80081348;
L2_func_80085F1C = func_80081388;
L2_func_80086EA8 = func_80082314;
L2_func_80086FAC = func_80082418;
L2_func_800870CC = func_80082538;
L2_func_80087120 = func_8008258C;
L2_func_80087134 = func_800825A0;
L2_func_800873A4 = func_80082810;
L2_func_80087574 = func_800829E0;
L2_func_80089774 = func_80084BE0;
L2_func_80089AF4 = func_80084F60;
L2_func_80089BB4 = func_80085020;
L2_func_80089D04 = func_80085170;
L2_func_80089D64 = func_800851D0;
L2_func_80089D94 = func_80085200;
L2_func_8008A0C4 = func_80085530;
L2_func_8008A724 = func_80085B90;
L2_func_8008AAD0 = func_80085F3C;
L2_func_8008C0C0 = func_8008752C;
L2_func_8008C48C = func_800878F8;
L2_func_8008C6CC = func_80087B38;
L2_func_8008C90C = func_80087D78;
L2_func_8008CBBC = func_80088028;
L2_func_8008CE0C = func_80088278;
L2_func_8008D02C = func_80088498;
L2_func_8008D33C = func_800887A8;
L2_func_8008D66C = func_80088AD8;
L2_func_8008D92C = func_80088D98;
L2_func_8008DB6C = func_80088FD8;
L2_func_8008DCEC = func_80089158;
L2_func_8008DF2C = func_80089398;
L2_func_8008E09C = func_80089508;
L2_func_8008E28C = func_800896F8;
L2_func_8008E5CC = func_80089A38;
L2_func_8008E7EC = func_80089C58;
L2_func_8008EAFC = func_80089F68;
L2_func_8008ECEC = func_8008A158;
L2_func_8008EEEC = func_8008A358;
L2_func_8008F21C = func_8008A688;
L2_func_8008F49C = func_8008A908;
L2_func_8008F74C = func_8008ABB8;
L2_func_8008FCDC = func_8008B148;
L2_func_8008FDAC = func_8008B218;
L2_func_8008FF2C = func_8008B398;
L2_func_8008FFCC = func_8008B438;
L2_func_8009003C = func_8008B4A8;
L2_func_800900AC = func_8008B518;
L2_func_800912A4 = func_8008C700;
D_1F8003D4 = 0x1F8003D4;
D_1F8003D8 = 0x1F8003D8;
D_1F8003DC = 0x1F8003DC;
L1_D_800AB540_b = L1_D_800AB540;
L1_D_800AB540_c = L1_D_800AB540;
L1_D_8009CE24 = L1_D_8009CE20 + 4;
