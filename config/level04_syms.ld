/* Generated by tools/port_level.py: LEVEL01 names (L1_ prefix) bound to level04's symbols. */
L1_AddPrim = func_8008A1A4;
L1_ApplyBonusCheats = func_8002DF94;
L1_ApplyMatrix = func_8008CE84;
L1_ApplyMatrixLV = func_8007B174;
L1_ApplyMatrixSV = func_8008EF78;
L1_Args_GetFlag115 = func_8002E130;
L1_CALLOC3_OBJ_54 = func_8008C368;
func_8004F7CC = L1_Camera_ResetZoom;
func_8002C240 = L1_CdBin_Disable;
func_8002C284 = L1_CdBin_Enable;
func_8002C3A0 = L1_CdBin_SetLevel;
L1_CdInit = func_8008646C;
L1_CdSearchFile = func_80083FD0;
L1_ChangeClearPAD = func_8009369C;
L1_ChangeClearRCnt = func_800936AC;
func_8002DC0C = L1_Cheat_CheckCodes;
L1_Cheat_DoAction = func_8002D980;
L1_Cheat_ResetCodes = func_8002E0D8;
L1_CloseEvent = func_80081E98;
L1_D_80082604 = func_80083064;
L1_D_80095808 = D_80096268;
L1_D_8009C180 = D_8009CBE0;
L1_D_8009C184 = D_8009CBE4;
L1_D_8009C1EC = D_8009CC4C;
L1_D_8009C1ED = D_8009CC4D;
L1_D_8009C1F0 = D_8009CC50;
L1_D_8009C1F4 = D_8009CC54;
L1_D_8009C1F8 = D_8009CC58;
L1_D_8009C200 = D_8009CC60;
L1_D_8009C204 = D_8009CC64;
L1_D_8009C208 = D_8009CC68;
L1_D_8009C20A = D_8009CC6A;
L1_D_8009C20C = D_8009CC6C;
L1_D_8009CA56 = D_8009D4B6;
L1_D_8009CA58 = D_8009D4B8;
L1_D_8009CA59 = D_8009D4B9;
L1_D_8009CA5A = D_8009D4BA;
L1_D_8009CA5C = D_8009D4BC;
L1_D_8009CA5E = D_8009D4BE;
L1_D_8009CA60 = D_8009D4C0;
L1_D_8009CA64 = D_8009D4C4;
L1_D_8009CA68 = D_8009D4C8;
L1_D_8009CA6C = D_8009D4CC;
L1_D_8009CA70 = D_8009D4D0;
L1_D_8009CA74 = D_8009D4D4;
L1_D_8009CA78 = D_8009D4D8;
L1_D_8009CA7C = D_8009D4DC;
L1_D_8009CA80 = D_8009D4E0;
L1_D_8009CA84 = D_8009D4E4;
L1_D_8009CA8C = D_8009D4EC;
L1_D_8009CA90 = D_8009D4F0;
L1_D_8009CA98 = D_8009D4F8;
L1_D_8009CA9C = D_8009D4FC;
L1_D_8009CAA0 = D_8009D500;
L1_D_8009CAA4 = D_8009D504;
L1_D_8009CAA8 = D_8009D508;
L1_D_8009CAAC = D_8009D50C;
L1_D_8009CAB0 = D_8009D510;
L1_D_8009CABD = D_8009D51D;
L1_D_8009CABE = D_8009D51E;
L1_D_8009CABF = D_8009D51F;
L1_D_8009CAC0 = D_8009D520;
L1_D_8009CAC4 = D_8009D524;
L1_D_8009CACC = D_8009D52C;
L1_D_8009CAD0 = D_8009D530;
L1_D_8009CD00 = D_8009D760;
L1_D_8009CD30 = D_8009D794;
L1_D_8009CD3C = D_8009D7A0;
L1_D_8009CD4C = D_8009D7B0;
L1_D_8009CD50 = D_8009D7B4;
L1_D_8009CD54 = D_8009D7B8;
L1_D_8009CD58 = D_8009D7BC;
L1_D_8009CD5C = D_8009D7C0;
L1_D_8009CD5E = D_8009D7C2;
L1_D_8009CD60 = D_8009D7C4;
L1_D_8009CD62 = D_8009D7C6;
L1_D_8009CD6C = D_8009D7D0;
L1_D_8009CD6E = D_8009D7D2;
L1_D_8009CD80 = D_8009D7E4;
L1_D_8009CD88 = D_8009D7EC;
L1_D_8009CD8C = D_8009D7F0;
L1_D_8009CD98 = D_8009D7FC;
L1_D_8009CDA0 = D_8009D804;
L1_D_8009CDA2 = D_8009D806;
L1_D_8009CDA8 = D_8009D80C;
L1_D_8009CDD0 = D_8009D834;
L1_D_8009CDD4 = D_8009D838;
L1_D_8009CDD8 = D_8009D83C;
L1_D_8009CDDC = D_8009D840;
L1_D_8009CDE4 = D_8009D848;
L1_D_8009CDE5 = D_8009D849;
L1_D_8009CDE6 = D_8009D84A;
L1_D_8009CDE7 = D_8009D84B;
L1_D_8009CDE8 = D_8009D84C;
L1_D_8009CDEC = D_8009D850;
L1_D_8009CDF0 = D_8009D854;
L1_D_8009CE20 = D_8009D884;
L1_D_8009CE28 = D_8009D88C;
L1_D_8009CE38 = D_8009D89C;
L1_D_8009CE44 = D_8009D8A8;
L1_D_8009CEB0 = D_8009D914;
L1_D_8009CEE0 = D_8009D944;
L1_D_8009CF10 = D_8009D974;
L1_D_8009CF14 = D_8009D978;
L1_D_8009CF2C = D_8009D990;
L1_D_8009CF30 = D_8009D994;
L1_D_8009CF34 = D_8009D998;
L1_D_8009CF48 = D_8009D9AC;
L1_D_8009CF4C = D_8009D9B0;
L1_D_8009CF50 = D_8009D9B4;
L1_D_8009CF54 = D_8009D9B8;
L1_D_8009CF68 = D_8009D9C8;
L1_D_8009CF6C = D_8009D9CC;
L1_D_8009CF70 = D_8009D9D0;
L1_D_8009CF74 = D_8009D9D4;
L1_D_8009CF7C = D_8009D9DC;
L1_D_8009CF80 = D_8009D9E0;
L1_D_8009CF8C = D_8009D9EC;
L1_D_8009CF90 = D_8009D9F0;
L1_D_8009CF94 = D_8009D9F4;
L1_D_8009CF98 = D_8009D9F8;
L1_D_8009CF9C = D_8009D9FC;
L1_D_8009CFA8 = D_8009DA08;
L1_D_8009CFB0 = D_8009DA10;
L1_D_8009CFB4 = D_8009DA14;
L1_D_8009CFBB = D_8009DA1B;
L1_D_8009CFBE = D_8009DA1E;
L1_D_8009CFC0 = D_8009DA20;
L1_D_8009CFC4 = D_8009DA24;
L1_D_8009CFCC = D_8009DA2C;
L1_D_8009CFEC = D_8009DA4C;
L1_D_8009CFF0 = D_8009DA50;
L1_D_8009CFF6 = D_8009DA56;
L1_D_8009CFF8 = D_8009DA58;
L1_D_8009CFFC = D_8009DA5C;
L1_D_8009D000 = D_8009DA60;
L1_D_8009D002 = D_8009DA62;
L1_D_8009D004 = D_8009DA64;
L1_D_8009D008 = D_8009DA68;
L1_D_8009D00C = D_8009DA6C;
L1_D_8009D00E = D_8009DA6E;
L1_D_8009D010 = D_8009DA70;
L1_D_8009D014 = D_8009DA74;
L1_D_8009D018 = D_8009DA78;
L1_D_8009D01A = D_8009DA7A;
L1_D_8009D020 = D_8009DA80;
L1_D_8009D03C = D_8009DA9C;
L1_D_8009D040 = D_8009DAA0;
L1_D_8009D09C = D_8009DAFC;
L1_D_8009D0FC = D_8009DB5C;
L1_D_8009D104 = D_8009DB64;
L1_D_8009D106 = D_8009DB66;
L1_D_8009D108 = D_8009DB68;
L1_D_8009D10A = D_8009DB6A;
L1_D_8009D10C = D_8009DB6C;
L1_D_8009D124 = D_8009DB84;
L1_D_8009D130 = D_8009DB90;
L1_D_8009D26C = D_8009DCC8;
L1_D_8009D270 = D_8009DCD0;
L1_D_8009D274 = D_8009DCD8;
L1_D_8009D280 = D_8009DCEC;
L1_D_8009D2A8 = D_8009DCCC;
L1_D_8009D2AC = D_8009DCD4;
L1_D_8009D2B0 = D_8009DCDC;
L1_D_8009D31C = D_8009DD24;
L1_D_8009D320 = D_8009DD28;
L1_D_8009D35C = D_8009DE28;
L1_D_8009D368 = D_8009DE34;
L1_D_8009D36C = D_8009DE38;
L1_D_8009D374 = D_8009DE40;
L1_D_8009D384 = D_8009DE50;
L1_D_8009D394 = D_8009DE60;
L1_D_8009D3A4 = D_8009DE70;
L1_D_8009D3A8 = D_8009DE74;
L1_D_8009D3AC = D_8009DE78;
L1_D_8009D3B0 = D_8009DE7C;
L1_D_8009D3BC = D_8009DE88;
L1_D_8009D3F0 = D_8009DEBC;
L1_D_8009D3F4 = D_8009DEC0;
L1_D_8009D3F8 = D_8009DEC4;
L1_D_8009D3FC = D_8009DEC8;
L1_D_8009D444 = D_8009DF10;
L1_D_8009D5A8 = D_8009E120;
L1_D_8009D5AC = D_8009E124;
L1_D_8009D5F8 = D_8009E180;
L1_D_8009D5FC = D_8009E184;
L1_D_8009D600 = D_8009E188;
L1_D_8009D610 = D_8009E198;
L1_D_8009D620 = D_8009E1A8;
L1_D_8009D660 = D_8009E1E8;
L1_D_8009D7A4 = D_8009E32C;
L1_D_8009D7A8 = D_8009E330;
L1_D_8009D8B8 = D_8009E440;
L1_D_8009D8D4 = D_8009E45C;
L1_D_8009D8E4 = D_8009E464;
L1_D_8009D8E8 = D_8009E468;
L1_D_8009D8F0 = D_8009E470;
L1_D_8009D8F4 = D_8009E474;
L1_D_8009D8F8 = D_8009E478;
L1_D_8009D8FC = D_8009E47C;
L1_D_8009D900 = D_8009E480;
L1_D_8009D904 = D_8009E484;
L1_D_8009D90C = D_8009E48C;
L1_D_8009D910 = D_8009E490;
L1_D_8009D914 = D_8009E494;
L1_D_8009D918 = D_8009E498;
L1_D_8009D91C = D_8009E49C;
L1_D_8009D920 = D_8009E4A0;
L1_D_8009D924 = D_8009E4A4;
L1_D_8009D928 = D_8009E4A8;
L1_D_8009DB50 = D_8009E6BC;
L1_D_8009E480 = D_8009FA68;
L1_D_8009E490 = D_8009FA78;
L1_D_8009E908 = D_8009FE08;
L1_D_8009E9A8 = D_8009FEF8;
L1_D_8009E9B4 = D_8009FF04;
L1_D_8009E9B8 = D_8009FF08;
L1_D_8009E9BC = D_8009FF0C;
L1_D_8009E9C0 = D_8009FF10;
L1_D_8009E9C4 = D_8009FF14;
L1_D_8009E9D8 = D_8009FF28;
L1_D_8009EADC = D_800A01CC;
L1_D_8009EB5C = D_800A024C;
L1_D_8009EB7C = D_800A026C;
L1_D_8009EB88 = D_800A0278;
L1_D_8009EB8C = D_800A027C;
L1_D_8009EE0C = D_800A04FC;
L1_D_8009EE3D = D_800A052D;
L1_D_8009EE8C = D_800A057C;
L1_D_8009EEC4 = D_800A05B4;
L1_D_8009EEC8 = D_800A05B8;
L1_D_8009EED0 = D_800A05C0;
L1_D_8009EED4 = D_800A05C4;
L1_D_8009EED8 = D_800A05C8;
L1_D_8009EEF0 = D_800A05E4;
L1_D_8009EEF4 = D_800A05E8;
L1_D_8009EEF8 = D_800A05EC;
L1_D_8009EF1C = D_800A0610;
L1_D_8009EF94 = D_800A0688;
L1_D_8009EF98 = D_800A068C;
L1_D_8009EF9C = D_800A0690;
L1_D_8009EFA0 = D_800A0694;
L1_D_8009EFA4 = D_800A0698;
L1_D_8009EFA8 = D_800A069C;
L1_D_8009EFC8 = D_800A06BC;
L1_D_8009F008 = D_800A06FC;
L1_D_8009F00C = D_800A0700;
L1_D_8009F010 = D_800A0704;
L1_D_8009F012 = D_800A0706;
L1_D_8009F013 = D_800A0707;
L1_D_8009F014 = D_800A0708;
L1_D_8009F016 = D_800A070A;
L1_D_8009F018 = D_800A070C;
L1_D_8009F01C = D_800A0710;
L1_D_8009F07C = D_800A0770;
L1_D_8009F084 = D_800A0778;
L1_D_8009F090 = D_800A0784;
L1_D_8009F09C = D_800A0790;
L1_D_8009F0BC = D_800A07B0;
L1_D_8009F0D0 = D_800A07C4;
L1_D_8009F0E4 = D_800A07D8;
L1_D_8009F0E6 = D_800A07DA;
L1_D_8009F10C = D_800A0800;
L1_D_8009F114 = D_800A0808;
L1_D_8009F118 = D_800A080C;
L1_D_8009F11C = D_800A0810;
L1_D_8009F120 = D_800A0814;
L1_D_8009F124 = D_800A0818;
L1_D_8009F128 = D_800A081C;
L1_D_8009F12C = D_800A0820;
L1_D_8009F130 = D_800A0824;
L1_D_8009F134 = D_800A0828;
L1_D_8009F138 = D_800A082C;
L1_D_8009F13C = D_800A0830;
L1_D_8009F140 = D_800A0834;
L1_D_8009F144 = D_800A0838;
L1_D_8009F148 = D_800A083C;
L1_D_8009F14C = D_800A0840;
L1_D_8009F150 = D_800A0844;
L1_D_8009F160 = D_800A0854;
L1_D_8009F170 = D_800A0864;
L1_D_8009F178 = D_800A086C;
L1_D_8009F17C = D_800A0870;
L1_D_8009F18C = D_800A0880;
L1_D_8009F190 = D_800A0884;
L1_D_8009F194 = D_800A0888;
L1_D_8009F198 = D_800A088C;
L1_D_8009F1B0 = D_800A08A4;
L1_D_8009F230 = D_800A0924;
L1_D_8009F234 = D_800A0928;
L1_D_8009F248 = D_800A093C;
L1_D_8009F24C = D_800A0940;
L1_D_8009F250 = D_800A0944;
L1_D_8009F254 = D_800A0948;
L1_D_8009F2B8 = D_800A09AC;
L1_D_8009F2BA = D_800A09AE;
L1_D_8009F2BC = D_800A09B0;
L1_D_8009F2E8 = D_800A09DC;
L1_D_8009F2F4 = D_800A09E8;
L1_D_800A0340 = D_800A1A34;
L1_D_800A0344 = D_800A1A38;
L1_D_800A0348 = D_800A1A3C;
L1_D_800A034C = D_800A1A40;
L1_D_800A0350 = D_800A1A44;
L1_D_800A0370 = D_800A1A64;
L1_D_800A4370 = D_800A5A64;
L1_D_800A4374 = D_800A5A68;
L1_D_800A4378 = D_800A5A6C;
L1_D_800A437C = D_800A5A70;
L1_D_800A4380 = D_800A5A74;
L1_D_800A4382 = D_800A5A76;
L1_D_800A4384 = D_800A5A78;
L1_D_800A4390 = D_800A5A84;
L1_D_800A4394 = D_800A5A88;
L1_D_800A43B0 = D_800A5AA4;
L1_D_800A43C8 = D_800A5ABC;
L1_D_800A43CC = D_800A5AC0;
L1_D_800A43D0 = D_800A5AC4;
L1_D_800A43D4 = D_800A5AC8;
L1_D_800A43D8 = D_800A5ACC;
L1_D_800A43DC = D_800A5AD0;
L1_D_800A43E0 = D_800A5AD4;
L1_D_800A43E4 = D_800A5AD8;
L1_D_800A43E8 = D_800A5ADC;
L1_D_800A43EC = D_800A5AE0;
L1_D_800A43F0 = D_800A5AE4;
L1_D_800A43F4 = D_800A5AE8;
L1_D_800A43F8 = D_800A5AEC;
L1_D_800A43FC = D_800A5AF0;
L1_D_800A4400 = D_800A5AF4;
L1_D_800A4404 = D_800A5AF8;
L1_D_800A4408 = D_800A5AFC;
L1_D_800A440C = D_800A5B00;
L1_D_800A4410 = D_800A5B04;
L1_D_800A4414 = D_800A5B08;
L1_D_800A4418 = D_800A5B0C;
L1_D_800A441C = D_800A5B10;
L1_D_800A4420 = D_800A5B14;
L1_D_800A4428 = D_800A5B1C;
L1_D_800A442C = D_800A5B20;
L1_D_800A4430 = D_800A5B24;
L1_D_800A4440 = D_800A5B34;
L1_D_800A4450 = D_800A5B44;
L1_D_800A4460 = D_800A5B54;
L1_D_800A446C = D_800A5B60;
L1_D_800A4470 = D_800A5B64;
L1_D_800A4474 = D_800A5B68;
L1_D_800A4478 = D_800A5B6C;
L1_D_800A447C = D_800A5B70;
L1_D_800A45D0 = D_800A5CC4;
L1_D_800A45D4 = D_800A5CC8;
L1_D_800A45D8 = D_800A5CCC;
L1_D_800A4EA0 = D_800A6594;
L1_D_800A4FD8 = D_800A66CC;
L1_D_800A4FDC = D_800A66D0;
L1_D_800A4FF0 = D_800A66E4;
L1_D_800A5000 = D_800A66F4;
L1_D_800A5010 = D_800A6704;
L1_D_800A56A0 = D_800A6D94;
L1_D_800A5834 = D_800A6F28;
L1_D_800A59D0 = D_800A70C4;
L1_D_800A59D4 = D_800A70C8;
L1_D_800A59D8 = D_800A70CC;
L1_D_800A59DC = D_800A70D0;
L1_D_800A59E0 = D_800A70D4;
L1_D_800A5B60 = D_800A7254;
L1_D_800A5B6C = D_800A7260;
L1_D_800A5B90 = D_800A7284;
L1_D_800A5BA8 = D_800A729C;
L1_D_800A5CB0 = D_800A73A4;
L1_D_800A5CB4 = D_800A73A8;
L1_D_800A5CB8 = D_800A73AC;
L1_D_800A5CBC = D_800A73B0;
L1_D_800A5CC0 = D_800A73B4;
L1_D_800A5CC8 = D_800A73BC;
L1_D_800A5CCC = D_800A73C0;
L1_D_800A5CD0 = D_800A73C4;
L1_D_800A5CD4 = D_800A73C8;
L1_D_800A5CD8 = D_800A73CC;
L1_D_800A5CDC = D_800A73D0;
L1_D_800A5CE0 = D_800A73D4;
L1_D_800A5CE4 = D_800A73D8;
L1_D_800A5CE8 = D_800A73DC;
L1_D_800A5CEC = D_800A73E0;
L1_D_800A5CF0 = D_800A73E4;
L1_D_800A5D00 = D_800A73F4;
L1_D_800A5D04 = D_800A73F8;
L1_D_800A5D08 = D_800A73FC;
L1_D_800A5D18 = D_800A740C;
L1_D_800A5D1C = D_800A7410;
L1_D_800A5D20 = D_800A7414;
L1_D_800A5D24 = D_800A7418;
L1_D_800A5D28 = D_800A741C;
L1_D_800A5D2C = D_800A7420;
L1_D_800A5D34 = D_800A7428;
L1_D_800A5D44 = D_800A7438;
L1_D_800A5D48 = D_800A743C;
L1_D_800A5D4C = D_800A7440;
L1_D_800A5D7A = D_800A746E;
L1_D_800A5D7C = D_800A7470;
L1_D_800A5D80 = D_800A7474;
L1_D_800A5D98 = D_800A748C;
L1_D_800A5D9C = D_800A7490;
L1_D_800A5DA0 = D_800A7494;
L1_D_800A5DA4 = D_800A7498;
L1_D_800A5DA8 = D_800A749C;
L1_D_800A5DAC = D_800A74A0;
L1_D_800A5DB0 = D_800A74A4;
L1_D_800A5DB4 = D_800A74A8;
L1_D_800A5DB5 = D_800A74A9;
L1_D_800A5DBC = D_800A74B0;
L1_D_800A5E3C = D_800A7530;
L1_D_800A5E5C = D_800A7550;
L1_D_800A5EA0 = D_800A7594;
L1_D_800A5EDC = D_800A75D0;
L1_D_800A5F5C = D_800A7650;
L1_D_800A5FDC = D_800A76D0;
L1_D_800A605C = D_800A7750;
L1_D_800A6060 = D_800A7754;
L1_D_800A6064 = D_800A7758;
L1_D_800A6068 = D_800A775C;
L1_D_800A606C = D_800A7760;
L1_D_800A6070 = D_800A7764;
L1_D_800A6074 = D_800A7768;
L1_D_800A6075 = D_800A7769;
L1_D_800A6078 = D_800A776C;
L1_D_800A6090 = D_800A7784;
L1_D_800A6094 = D_800A7788;
L1_D_800A6098 = D_800A778C;
L1_D_800A609C = D_800A7790;
L1_D_800A60A0 = D_800A7794;
L1_D_800A60B0 = D_800A77A4;
L1_D_800A60D0 = D_800A77C4;
L1_D_800A60D4 = D_800A77C8;
L1_D_800A60E0 = D_800A77D4;
L1_D_800A60E4 = D_800A77D8;
L1_D_800A6104 = D_800A77F8;
L1_D_800A6110 = D_800A7804;
L1_D_800A6114 = D_800A7808;
L1_D_800A6118 = D_800A780C;
L1_D_800A611C = D_800A7810;
L1_D_800A6120 = D_800A7814;
L1_D_800A6140 = D_800A7834;
L1_D_800A6170 = D_800A7864;
L1_D_800A6174 = D_800A7868;
L1_D_800A6178 = D_800A786C;
L1_D_800A6180 = D_800A7874;
L1_D_800A6198 = D_800A788C;
L1_D_800A62A0 = D_800A7994;
L1_D_800A66A0 = D_800A7D94;
L1_D_800A6EB0 = D_800A85A4;
L1_D_800A6ED0 = D_800A85C4;
L1_D_800A6EF8 = D_800A85EC;
L1_D_800A6F00 = D_800A85F4;
L1_D_800A6F1C = D_800A8610;
L1_D_800A7048 = D_800A873C;
L1_D_800A7060 = D_800A8754;
L1_D_800A70A0 = D_800A8794;
L1_D_800A70C8 = D_800A87BC;
L1_D_800A70D4 = D_800A87C8;
L1_D_800A70F8 = D_800A87EC;
L1_D_800A7190 = D_800A8884;
L1_D_800A71EC = D_800A88E0;
L1_D_800A71F0 = D_800A88E4;
L1_D_800A71F4 = D_800A88E8;
L1_D_800A71F8 = D_800A88EC;
L1_D_800A7214 = D_800A8908;
L1_D_800A7260 = D_800A8954;
L1_D_800A7290 = D_800A8984;
L1_D_800A72E8 = D_800A89DC;
L1_D_800A7300 = D_800A89F4;
L1_D_800A7310 = D_800A8A04;
L1_D_800A7320 = D_800A8A14;
L1_D_800A7324 = D_800A8A18;
L1_D_800A7330 = D_800A8A24;
L1_D_800A7344 = D_800A8A38;
L1_D_800A735C = D_800A8A50;
L1_D_800A73BC = D_800A8AB0;
L1_D_800A73D8 = D_800A8ACC;
L1_D_800A7418 = D_800A8B0C;
L1_D_800A7424 = D_800A8B18;
L1_D_800A7474 = D_800A8B68;
L1_D_800A747C = D_800A8B70;
L1_D_800A7498 = D_800A8B8C;
L1_D_800A74D4 = D_800A8BC8;
L1_D_800A74E0 = D_800A8BD4;
L1_D_800A7510 = D_800A8C04;
L1_D_800A75D0 = D_800A8CC4;
L1_D_800A7678 = D_800A8D6C;
L1_D_800A76A0 = D_800A8D94;
L1_D_800A76E4 = D_800A8DD8;
L1_D_800A76F8 = D_800A8DEC;
L1_D_800A770C = D_800A8E00;
L1_D_800A7714 = D_800A8E08;
L1_D_800A7728 = D_800A8E1C;
L1_D_800A773C = D_800A8E30;
L1_D_800A7750 = D_800A8E44;
L1_D_800A775C = D_800A8E50;
L1_D_800A7778 = D_800A8E6C;
L1_D_800A7784 = D_800A8E78;
L1_D_800A77B4 = D_800A8EA8;
L1_D_800A77CC = D_800A8EC0;
L1_D_800A79F0 = D_800A9104;
L1_D_800A7A0C = D_800A9120;
L1_D_800A7A24 = D_800A9138;
L1_D_800A7A30 = D_800A9144;
L1_D_800A7CF0 = D_800A9484;
L1_D_800A7D08 = D_800A949C;
L1_D_800A7D20 = D_800A94B4;
L1_D_800A7D44 = D_800A94D8;
L1_D_800A7D64 = D_800A94F8;
L1_D_800A7D74 = D_800A9508;
L1_D_800A7D90 = D_800A9524;
L1_D_800A7DC0 = D_800A9554;
L1_D_800A7DE8 = D_800A957C;
L1_D_800A7DF4 = D_800A9588;
L1_D_800A7E14 = D_800A95A8;
L1_D_800A7E34 = D_800A95C8;
L1_D_800A7E50 = D_800A95E4;
L1_D_800A7E74 = D_800A9608;
L1_D_800A7E90 = D_800A9624;
L1_D_800A7EC4 = D_800A9658;
L1_D_800A7EFC = D_800A9690;
L1_D_800A7F1C = D_800A96B0;
L1_D_800A7F2C = D_800A96C0;
L1_D_800A7F5C = D_800A96F0;
L1_D_800A7FF8 = D_800A978C;
L1_D_800A8000 = D_800A9794;
L1_D_800A80A4 = D_800A9838;
L1_D_800A80B0 = D_800A9844;
L1_D_800A80BC = D_800A9850;
L1_D_800A80C8 = D_800A985C;
L1_D_800A811C = D_800A98B0;
L1_D_800A81F8 = D_800A998C;
L1_D_800A8210 = D_800A99A4;
L1_D_800A8224 = D_800A99B8;
L1_D_800A8238 = D_800A99CC;
L1_D_800A824C = D_800A99E0;
L1_D_800A8260 = D_800A99F4;
L1_D_800A8274 = D_800A9A08;
L1_D_800A8280 = D_800A9A14;
L1_D_800A828C = D_800A9A20;
L1_D_800A82B4 = D_800A9A48;
L1_D_800A82DC = D_800A9A70;
L1_D_800A8304 = D_800A9A98;
L1_D_800A8308 = D_800A9A9C;
L1_D_800A8310 = D_800A9AA4;
L1_D_800A8318 = D_800A9AAC;
L1_D_800A8320 = D_800A9AB4;
L1_D_800A832C = D_800A9AC0;
L1_D_800A8340 = D_800A9AD4;
L1_D_800A8370 = D_800A9B04;
L1_D_800A8390 = D_800A9B24;
L1_D_800A83B0 = D_800A9B44;
L1_D_800A83BC = D_800A9B50;
L1_D_800A83C8 = D_800A9B5C;
L1_D_800A83D4 = D_800A9B68;
L1_D_800A83E0 = D_800A9B74;
L1_D_800A83E8 = D_800A9B7C;
L1_D_800A83F0 = D_800A9B84;
L1_D_800A8400 = D_800A9B94;
L1_D_800A8410 = D_800A9BA4;
L1_D_800A8418 = D_800A9BAC;
L1_D_800A8420 = D_800A9BB4;
L1_D_800A842C = D_800A9BC0;
L1_D_800A8444 = D_800A9BD8;
L1_D_800A844C = D_800A9BE0;
L1_D_800A8458 = D_800A9BEC;
L1_D_800A8460 = D_800A9BF4;
L1_D_800A8464 = D_800A9BF8;
L1_D_800A8468 = D_800A9BFC;
L1_D_800A8478 = D_800A9C0C;
L1_D_800A8484 = D_800A9C18;
L1_D_800A8490 = D_800A9C24;
L1_D_800A849C = D_800A9C30;
L1_D_800A84A8 = D_800A9C3C;
L1_D_800A84B4 = D_800A9C48;
L1_D_800A84B8 = D_800A9C4C;
L1_D_800A84D0 = D_800A9C64;
L1_D_800A84D8 = D_800A9C6C;
L1_D_800A84E4 = D_800A9C78;
L1_D_800A84F0 = D_800A9C84;
L1_D_800A84FC = D_800A9C90;
L1_D_800A850C = D_800A9CA0;
L1_D_800A851C = D_800A9CB0;
L1_D_800A8528 = D_800A9CBC;
L1_D_800A8534 = D_800A9CC8;
L1_D_800A8544 = D_800A9CD8;
L1_D_800A85C4 = D_800A9D58;
L1_D_800A85D4 = D_800A9D68;
L1_D_800A85F8 = D_800A9D8C;
L1_D_800A86C0 = D_800A9E84;
L1_D_800A86CC = D_800A9E90;
L1_D_800A8764 = D_800A9F0C;
L1_D_800A87EC = D_800A9F94;
L1_D_800A87F8 = D_800A9FA0;
L1_D_800A8808 = D_800A9FB0;
L1_D_800A880C = D_800A9FB4;
L1_D_800A8820 = D_800A9FC8;
L1_D_800A8858 = D_800AA000;
L1_D_800A887C = D_800AA024;
L1_D_800A8884 = D_800AA02C;
L1_D_800A8894 = D_800AA03C;
L1_D_800A88A4 = D_800AA04C;
L1_D_800A88D0 = D_800AA078;
L1_D_800A89A4 = D_800AA16C;
L1_D_800A89F0 = D_800AA1B8;
L1_D_800A8A2C = D_800AA1F4;
L1_D_800A8AA8 = D_800AA270;
L1_D_800A8C08 = D_800AA3D0;
L1_D_800A8C28 = D_800AA3F0;
L1_D_800A8C48 = D_800AA410;
L1_D_800A8D14 = D_800AA4DC;
L1_D_800A8D44 = D_800AA4FC;
L1_D_800A8D58 = D_800AA510;
L1_D_800A8FAC = D_800AA6C0;
L1_D_800A9390 = D_800AAAA4;
L1_D_800A9488 = D_800AAB60;
L1_D_800A9498 = D_800AAB70;
L1_D_800A9794 = D_800AB25C;
L1_D_800A97BC = D_800AB284;
L1_D_800A98C8 = D_800AB354;
L1_D_800A99D0 = D_800AB4C8;
L1_D_800A99EC = D_800AB4E4;
L1_D_800A9A08 = D_800AB500;
L1_D_800A9A60 = D_800AB558;
L1_D_800A9A84 = D_800AB57C;
L1_D_800A9AA8 = D_800AB5A0;
L1_D_800A9B6C = D_800AB664;
L1_D_800A9B78 = D_800AB670;
L1_D_800A9BE8 = D_800AB6E0;
L1_D_800A9C08 = D_800AB700;
L1_D_800A9C78 = D_800AB770;
L1_D_800A9C8C = D_800AB784;
L1_D_800A9CA0 = D_800AB798;
L1_D_800A9CAC = D_800AB7A4;
L1_D_800A9CC0 = D_800AB7B8;
L1_D_800A9CC4 = D_800AB7BC;
L1_D_800A9CDC = D_800AB7D4;
L1_D_800A9D00 = D_800AB7F8;
L1_D_800A9D18 = D_800AB810;
L1_D_800A9D30 = D_800AB828;
L1_D_800A9D44 = D_800AB83C;
L1_D_800A9D78 = D_800AB870;
L1_D_800A9D90 = D_800AB888;
L1_D_800A9EB0 = D_800AB9A8;
L1_D_800A9EC8 = D_800AB9C0;
L1_D_800A9EE0 = D_800AB9D8;
L1_D_800A9F10 = D_800ABA08;
L1_D_800A9F2C = D_800ABA24;
L1_D_800A9F44 = D_800ABA3C;
L1_D_800A9F60 = D_800ABA58;
L1_D_800A9F80 = D_800ABA78;
L1_D_800A9F8C = D_800ABA84;
L1_D_800A9F9C = D_800ABA94;
L1_D_800A9FC8 = D_800ABAC0;
L1_D_800A9FD0 = D_800ABAC8;
L1_D_800AA000 = D_800ABAF8;
L1_D_800AA024 = D_800ABB1C;
L1_D_800AA044 = D_800ABB3C;
L1_D_800AA058 = D_800ABB50;
L1_D_800AA07C = D_800ABB74;
L1_D_800AA09C = D_800ABB94;
L1_D_800AA0B8 = D_800ABBB0;
L1_D_800AA0BC = D_800ABBB4;
L1_D_800AA0BE = D_800ABBB6;
L1_D_800AA0C0 = D_800ABBB8;
L1_D_800AA0DC = D_800ABBD4;
L1_D_800AA110 = D_800ABC08;
L1_D_800AA154 = D_800ABC4C;
L1_D_800AA170 = D_800ABC68;
L1_D_800AA1B0 = D_800ABCA8;
L1_D_800AA1D0 = D_800ABCC8;
L1_D_800AA3C0 = D_800ABEB8;
L1_D_800AA3E8 = D_800ABEE0;
L1_D_800AA410 = D_800ABF08;
L1_D_800AA438 = D_800ABF30;
L1_D_800AA444 = D_800ABF3C;
L1_D_800AA46C = D_800ABF64;
L1_D_800AA494 = D_800ABF8C;
L1_D_800AA4C0 = D_800ABFB8;
L1_D_800AA4F0 = D_800ABFE8;
L1_D_800AA518 = D_800AC010;
L1_D_800AA580 = D_800AC078;
L1_D_800AA590 = D_800AC088;
L1_D_800AA5A0 = D_800AC098;
L1_D_800AA5B4 = D_800AC0AC;
L1_D_800AA70C = D_800AC204;
L1_D_800AA71C = D_800AC214;
L1_D_800AA738 = D_800AC230;
L1_D_800AA744 = D_800AC23C;
L1_D_800AA760 = D_800AC258;
L1_D_800AA774 = D_800AC26C;
L1_D_800AA794 = D_800AC28C;
L1_D_800AA79C = D_800AC294;
L1_D_800AA7A8 = D_800AC2A0;
L1_D_800AA7B0 = D_800AC2A8;
L1_D_800AA7C0 = D_800AC2B8;
L1_D_800AA800 = D_800AC2F8;
L1_D_800AA80C = D_800AC304;
L1_D_800AA818 = D_800AC310;
L1_D_800AA830 = D_800AC328;
L1_D_800AA84C = D_800AC344;
L1_D_800AA8A0 = D_800AC398;
L1_D_800AA8C8 = D_800AC3C0;
L1_D_800AA8E0 = D_800AC3D8;
L1_D_800AA8E8 = D_800AC3E0;
L1_D_800AA8F0 = D_800AC3E8;
L1_D_800AB540 = D_800AD038;
L1_D_800AB5E0 = D_800AD0D8;
L1_D_800AB5E4 = D_800AD0DC;
L1_D_800AB5E8 = D_800AD0E0;
L1_D_800AB5EC = D_800AD0E4;
L1_D_800AB5F0 = D_800AD0E8;
L1_D_800AB5F4 = D_800AD0EC;
L1_D_800AB5F8 = D_800AD0F0;
L1_D_800AB5FC = D_800AD0F4;
L1_D_800AB604 = D_800AD0FC;
L1_D_800AB608 = D_800AD100;
L1_D_800AB60C = D_800AD104;
L1_D_800AB610 = D_800AD108;
L1_D_800AB618 = D_800AD110;
L1_D_800AB744 = D_800AD2C0;
L1_D_800AB754 = D_800AD2D0;
L1_D_800AC284 = D_800ADE00;
L1_D_800AC384 = D_800ADF00;
L1_D_800AC38C = D_800ADF08;
L1_D_800AC4C8 = D_800AE0C4;
L1_D_800AC4D0 = D_800AE0CC;
L1_D_800AC4D8 = D_800AE0D4;
L1_D_800AC4DC = D_800AE0D8;
L1_D_800AC4E0 = D_800AE0DC;
L1_D_800AC4E4 = D_800AE0E0;
L1_D_800AC4E8 = D_800AE0E4;
L1_D_800AC4EC = D_800AE0E8;
L1_D_800AC54C = D_800AE148;
L1_D_800AC550 = D_800AE14C;
L1_D_800AE940 = D_800B1FCC;
L1_D_800AE9B8 = D_800B2044;
L1_D_800AE9C0 = D_800B204C;
L1_D_800AEB1A = D_800B21A6;
L1_D_800AEC38 = D_800B22C4;
L1_D_800AEDA0 = D_800B242C;
L1_D_800AEDA4 = D_800B2430;
L1_D_800AEDA8 = D_800B2434;
L1_D_800AEDAC = D_800B2438;
L1_D_800AEDB0 = D_800B243C;
L1_D_800AEDB4 = D_800B2440;
L1_D_800AEDB8 = D_800B2444;
L1_D_800AEDBC = D_800B2448;
L1_D_800AEDD4 = D_800B2460;
L1_D_800AEDD8 = D_800B2464;
L1_D_800AEDDC = D_800B2468;
L1_D_800AEDE0 = D_800B246C;
L1_D_800AEDE4 = D_800B2470;
L1_D_800AEDE8 = D_800B2474;
L1_D_800AEDEC = D_800B2478;
L1_D_800AEDF0 = D_800B247C;
L1_D_800AEE10 = D_800B249C;
L1_D_800AEE14 = D_800B24A0;
L1_D_800AF620 = D_800B2CAC;
L1_D_800AF624 = D_800B2CB0;
L1_D_800AF6A4 = D_800B2D30;
L1_D_800AF6A5 = D_800B2D31;
L1_D_800AF6A8 = D_800B2D34;
L1_D_800AFEA8 = D_800B3534;
L1_D_800AFEAC = D_800B3538;
L1_D_800AFEB0 = D_800B353C;
L1_D_800AFEB5 = D_800B3541;
L1_D_800AFEB6 = D_800B3542;
L1_D_800AFEB7 = D_800B3543;
L1_D_800AFEB8 = D_800B3544;
L1_D_800AFEB9 = D_800B3545;
L1_D_800AFEBC = D_800B3548;
L1_D_800AFEC0 = D_800B354C;
L1_D_800AFEC8 = D_800B3554;
L1_D_800AFF2C = D_800B35B8;
L1_D_800AFF48 = D_800B35D4;
L1_D_800AFF4C = D_800B35D8;
L1_D_800AFF58 = D_800B35E4;
L1_D_800AFF5C = D_800B35E8;
L1_D_800AFF60 = D_800B35EC;
L1_D_800AFF64 = D_800B35F0;
L1_D_800AFF68 = D_800B35F4;
L1_D_800AFF70 = D_800B35FC;
L1_D_800AFF78 = D_800B3604;
L1_D_800AFF80 = D_800B360C;
L1_D_800AFF84 = D_800B3610;
L1_D_800AFF88 = D_800B3614;
L1_D_800AFF8C = D_800B3618;
L1_D_800AFF94 = D_800B3620;
L1_D_800AFF98 = D_800B3624;
L1_D_800AFFA4 = D_800B3630;
L1_D_800AFFA8 = D_800B3634;
L1_D_800AFFAC = D_800B3638;
L1_D_800AFFB0 = D_800B363C;
L1_D_800AFFB4 = D_800B3640;
L1_D_800AFFC0 = D_800B364C;
L1_D_800AFFC4 = D_800B3650;
L1_D_800AFFC8 = D_800B3654;
L1_D_800AFFCC = D_800B3658;
L1_D_800B0014 = D_800B36A0;
L1_D_800B0018 = D_800B36A4;
L1_D_800B0064 = D_800B36F0;
L1_D_800B0066 = D_800B36F2;
L1_D_800B0068 = D_800B36F4;
L1_D_800B0070 = D_800B36FC;
L1_D_800B0084 = D_800B3710;
L1_D_800B008C = D_800B3718;
L1_D_800B0094 = D_800B3720;
L1_D_800B00A0 = D_800B372C;
L1_D_800B0108 = D_800B3794;
L1_D_800B05AC = D_800B3E60;
L1_D_800B05B0 = D_800B3E64;
L1_D_800B077C = D_800B4030;
L1_D_800B0794 = D_800B4048;
L1_D_800B07A4 = D_800B4058;
L1_D_800B07A8 = D_800B405C;
L1_D_800B07AC = D_800B4060;
L1_D_800B07B0 = D_800B4064;
L1_D_800B07B4 = D_800B4068;
L1_D_800B07B8 = D_800B406C;
L1_D_800B07BC = D_800B4070;
L1_D_800B07C0 = D_800B4074;
L1_D_800B07C4 = D_800B4078;
L1_D_800B0804 = D_800B40B8;
L1_D_800B0808 = D_800B40BC;
L1_D_800B0848 = D_800B40FC;
L1_D_800B0868 = D_800B411C;
L1_D_800B086C = D_800B4120;
L1_D_800B087C = D_800B4130;
L1_D_800B0A94 = D_800B4348;
L1_D_800B0A98 = D_800B434C;
L1_D_800B0AA0 = D_800B4354;
L1_D_800B0AA4 = D_800B4358;
L1_D_800B0AA8 = D_800B435C;
L1_D_800B0AB4 = D_800B4368;
L1_D_800B0AB8 = D_800B436C;
L1_D_800B0AC0 = D_800B4374;
L1_D_800B0AC8 = D_800B437C;
L1_D_800B0ACC = D_800B4380;
L1_D_800B0AD0 = D_800B4384;
L1_D_800B0AD4 = D_800B4388;
L1_D_800B0ADC = D_800B4390;
L1_D_800B0AE0 = D_800B4394;
L1_D_800B0AE4 = D_800B4398;
L1_D_800B0AE8 = D_800B439C;
L1_D_800B0AEC = D_800B43A0;
L1_D_800B0AFC = D_800B43B0;
L1_D_800B0B10 = D_800B43C4;
L1_D_800B0B14 = D_800B43C8;
L1_D_800B0B54 = D_800B4408;
L1_D_800B0B58 = D_800B440C;
L1_D_800B0B64 = D_800B4418;
L1_D_800B0B68 = D_800B441C;
L1_D_800B0B6A = D_800B441E;
L1_D_800B0B6C = D_800B4420;
L1_D_800B0B70 = D_800B4424;
L1_D_800B0B72 = D_800B4426;
L1_D_800B0B78 = D_800B442C;
L1_D_800B0B80 = D_800B4434;
L1_D_800B0B84 = D_800B4438;
L1_D_800B0B88 = D_800B443C;
L1_D_800B0B8C = D_800B4440;
L1_D_800B0B9C = D_800B4450;
L1_D_800B0BA0 = D_800B4454;
L1_D_800B0BB4 = D_800B4468;
L1_D_800B0BB8 = D_800B446C;
L1_D_800B0BBC = D_800B4470;
L1_D_800B0BC0 = D_800B4474;
L1_D_800B0C10 = D_800B44C4;
L1_D_800B0C30 = D_800B44E4;
L1_D_800B0C38 = D_800B44EC;
L1_D_800B0C58 = D_800B450C;
L1_D_800B0C5C = D_800B4510;
L1_D_800B0C60 = D_800B4514;
L1_D_800B0C64 = D_800B4518;
L1_D_800B0C68 = D_800B451C;
L1_D_800B0C6C = D_800B4520;
L1_D_800B0C74 = D_800B4528;
L1_D_800B0C84 = D_800B4538;
L1_D_800B0C8C = D_800B4540;
L1_D_800B0C94 = D_800B4548;
L1_D_800B0C98 = D_800B454C;
L1_D_800B0C9C = D_800B4550;
L1_D_800B0CA0 = D_800B4554;
L1_D_800B0CA4 = D_800B4558;
L1_D_800B0CA8 = D_800B455C;
L1_D_800B0CAC = D_800B4560;
L1_D_800B0CB0 = D_800B4564;
L1_D_800B0CC4 = D_800B4578;
L1_D_800B0D50 = D_800B4604;
L1_D_800B0D94 = D_800B4648;
L1_D_800B0D9C = D_800B4650;
L1_D_800B0DA0 = D_800B4654;
L1_D_800B0DA4 = D_800B4658;
L1_D_800B0DA8 = D_800B465C;
L1_D_800B0DAC = D_800B4660;
L1_D_800B0DB0 = D_800B4664;
L1_D_800B0DB4 = D_800B4668;
L1_D_800B0DB8 = D_800B466C;
L1_D_800B0DBC = D_800B4670;
L1_D_800B0DC0 = D_800B4674;
L1_D_800B0DC4 = D_800B4678;
L1_D_800B0DC8 = D_800B467C;
L1_D_800B0DCC = D_800B4680;
L1_D_800B0DD4 = D_800B4688;
L1_D_800B0DD8 = D_800B468C;
L1_D_800B0DDC = D_800B4690;
L1_D_800B0DE4 = D_800B4698;
L1_D_800B0E34 = D_800B46E8;
L1_D_800B0E36 = D_800B46EA;
L1_D_800B0E40 = D_800B46F4;
L1_D_800B0E48 = D_800B46FC;
L1_D_800B0E54 = D_800B4708;
L1_D_800B0E58 = D_800B470C;
L1_D_800B0E5E = D_800B4712;
L1_D_800B0E5F = D_800B4713;
L1_D_800B0E8C = D_800B4740;
L1_D_800B0EA0 = D_800B4754;
L1_D_800B0EFC = D_800B47B0;
L1_D_800B8EFC = D_800BC7B0;
L1_D_800B8F24 = D_800BC7D8;
L1_D_800B8F28 = D_800BC7DC;
L1_D_800B8F68 = D_800BC81C;
L1_D_800B8F88 = D_800BC83C;
L1_D_800B8FB0 = D_800BC864;
L1_D_800B8FB4 = D_800BC868;
L1_D_800C1C54 = D_800C5508;
L1_D_800CA8F4 = D_800CE1A8;
L1_D_800D28F4 = D_800D61A8;
L1_D_800D2AF4 = D_800D63A8;
L1_D_800D2AF8 = D_800D63AC;
L1_D_800D2AFC = D_800D63B0;
L1_D_800D2BC4 = D_800D6478;
L1_D_800D2BE8 = D_800D649C;
L1_D_800D2BEC = D_800D64A0;
L1_D_800D2BF0 = D_800D64A4;
L1_D_800D2D30 = D_800D65E4;
L1_D_800D2E70 = D_800D6724;
L1_D_800D2E74 = D_800D6728;
L1_D_800D2E84 = D_800D6738;
L1_D_800D2E90 = D_800D6744;
L1_D_800D2F48 = D_800D67FC;
L1_D_800D2F68 = D_800D681C;
L1_D_800D2F8C = D_800D6840;
L1_D_800D2F90 = D_800D6844;
L1_D_800D2F94 = D_800D6848;
L1_D_800D2FA4 = D_800D6858;
L1_D_800D2FAC = D_800D6860;
L1_D_800D2FB0 = D_800D6864;
L1_D_800D2FC0 = D_800D6874;
L1_D_800D2FC4 = D_800D6878;
L1_D_800D2FF4 = D_800D68A8;
L1_D_800D305C = D_800D6910;
L1_D_800D3068 = D_800D691C;
L1_D_800D308C = D_800D6940;
L1_D_800D30C0 = D_800D6974;
L1_D_800D30D4 = D_800D6988;
L1_D_800D30D8 = D_800D698C;
L1_D_800D31B8 = D_800D6A6C;
L1_D_800D31C0 = D_800D6A74;
L1_D_800D31D0 = D_800D6A84;
L1_D_800D3238 = D_800D6AEC;
L1_D_800D3288 = D_800D6B3C;
L1_D_800D3FA8 = D_800D785C;
L1_D_800D3FAC = D_800D7860;
L1_D_800D3FB0 = D_800D7864;
L1_D_800D3FD4 = D_800D7888;
L1_D_800D3FD8 = D_800D788C;
L1_D_800D3FE0 = D_800D7894;
L1_D_800D3FE4 = D_800D7898;
L1_D_800D3FEC = D_800D78A0;
L1_D_800D3FF0 = D_800D78A4;
L1_D_800D4050 = D_800D7904;
L1_D_800D4058 = D_800D790C;
L1_D_800D4068 = D_800D791C;
L1_D_800D406C = D_800D7920;
L1_D_800D4070 = D_800D7924;
L1_D_800D4074 = D_800D7928;
L1_D_800D4080 = D_800D7934;
L1_D_800D40D8 = D_800D798C;
L1_D_800D40F8 = D_800D79AC;
L1_D_800D40FC = D_800D79B0;
L1_D_800D4100 = D_800D79B4;
L1_D_800D4104 = D_800D79B8;
L1_D_800D4108 = D_800D79BC;
L1_D_800D410C = D_800D79C0;
L1_D_800D4110 = D_800D79C4;
L1_D_800D4114 = D_800D79C8;
L1_D_800D4250 = D_800D7B04;
L1_D_800D4384 = D_800D7C38;
L1_D_800D4385 = D_800D7C39;
L1_D_800D4386 = D_800D7C3A;
L1_D_800D4387 = D_800D7C3B;
L1_D_800D4388 = D_800D7C3C;
L1_D_800D4389 = D_800D7C3D;
L1_D_800D438A = D_800D7C3E;
L1_D_800D438B = D_800D7C3F;
L1_D_800D438C = D_800D7C40;
L1_D_800D438D = D_800D7C41;
L1_D_800D438E = D_800D7C42;
L1_D_800D438F = D_800D7C43;
L1_D_800D4390 = D_800D7C44;
L1_D_800D43A8 = D_800D7C5C;
L1_D_800D43AC = D_800D7C60;
L1_D_800D43C0 = D_800D7C74;
L1_D_800D43CC = D_800D7C80;
L1_D_800D43D0 = D_800D7C84;
L1_D_800D43E4 = D_800D7C98;
L1_D_800D43F0 = D_800D7CA4;
L1_D_800D43F4 = D_800D7CA8;
L1_D_800D43F8 = D_800D7CAC;
L1_D_800D4400 = D_800D7CB4;
L1_D_800D4410 = D_800D7CC4;
L1_D_800D4424 = D_800D7CD8;
L1_D_800D4440 = D_800D7CF4;
L1_D_800D4444 = D_800D7CF8;
L1_D_800D4450 = D_800D7D1C;
L1_D_800D4454 = D_800D7D20;
L1_D_800D4458 = D_800D7D24;
L1_D_800D445C = D_800D7D28;
L1_D_800D4464 = D_800D7D30;
L1_D_800D4468 = D_800D7D34;
L1_D_800D4484 = D_800D7D5C;
L1_D_800D4564 = D_800D7E3C;
L1_D_800D45C4 = D_800D7E9C;
L1_D_800D45F4 = D_800D7ECC;
L1_D_800D4688 = D_800D7F60;
L1_D_800D46D8 = D_800D7FB0;
L1_D_800D4958 = D_800D8230;
L1_D_800D4984 = D_800D825C;
L1_D_800D5DA4 = D_800D967C;
L1_D_800D5E80 = D_800D9758;
L1_D_800D5ED0 = D_800D97A8;
L1_D_800D5ED8 = D_800D97B0;
L1_D_800D5EF0 = D_800D97C8;
L1_D_800D5F40 = D_800D9818;
L1_D_800D5F48 = D_800D9820;
L1_D_800D74F8 = D_800DADD0;
L1_D_800D74FC = D_800DADD4;
L1_D_800D7500 = D_800DADD8;
L1_D_800D7550 = D_800DAE28;
L1_D_800D7554 = D_800DAE2C;
L1_D_800D7588 = D_800DAE60;
L1_D_800D77B8 = D_800DB090;
L1_D_800D77E8 = D_800DB0C0;
L1_D_800D7838 = D_800DB110;
L1_D_800D7888 = D_800DB160;
L1_D_800D78D8 = D_800DB1B0;
L1_D_800D7930 = D_800DB208;
L1_D_800D7980 = D_800DB258;
L1_D_800D79D0 = D_800DB2A8;
L1_D_800D79D4 = D_800DB2AC;
L1_D_800D7A1C = D_800DB2F4;
L1_D_800D7A20 = D_800DB2F8;
L1_D_800D7AB8 = D_800DB390;
L1_D_800D7B08 = D_800DB3E0;
L1_D_800D7BE8 = D_800DB4C0;
L1_D_800D7BF0 = D_800DB4C8;
L1_D_800D7C24 = D_800DB4FC;
L1_D_800D7C64 = D_800DB53C;
L1_D_800D7CB4 = D_800DB58C;
L1_D_800D7D08 = D_800DB5E0;
L1_D_800D7DF8 = D_800DB6D0;
L1_D_800D7DFC = D_800DB6D4;
L1_D_800D7EEC = D_800DB7C4;
L1_D_800D811C = D_800DB9F4;
L1_D_800D8138 = D_800DBA10;
L1_D_800D8150 = D_800DBA28;
L1_D_800D8154 = D_800DBA2C;
L1_D_800D861C = D_800DBEF4;
L1_D_800D8620 = D_800DBEF8;
L1_D_800D8624 = D_800DBEFC;
L1_D_800D8674 = D_800DBF4C;
L1_D_800D86C4 = D_800DBF9C;
L1_D_800D86C8 = D_800DBFA0;
L1_D_800D86DC = D_800DBFB4;
L1_D_800D86E0 = D_800DBFB8;
L1_D_800D86E4 = D_800DBFBC;
L1_D_800D86E8 = D_800DBFC0;
L1_D_800D8BE8 = D_800DC4C0;
L1_D_800D8C7C = D_800DC554;
L1_D_800D8C90 = D_800DC568;
L1_D_800D8C94 = D_800DC56C;
L1_D_800D8E74 = D_800DC74C;
L1_D_800D8E8C = D_800DC764;
L1_D_800D8EA4 = D_800DC77C;
L1_D_800D8EA8 = D_800DC780;
L1_D_800D8EE8 = D_800DC7C0;
L1_D_800D8FE8 = D_800DC8C0;
L1_D_800D8FF8 = D_800DC8D0;
L1_D_800D90C0 = D_800DC998;
L1_D_800D911C = D_800DC9F4;
L1_D_800D91E4 = D_800DCABC;
L1_D_800D91E7 = D_800DCABF;
L1_D_800D91E8 = D_800DCAC0;
L1_D_800D91F0 = D_800DCAC8;
L1_D_800D91F8 = D_800DCAD0;
L1_D_800D91FC = D_800DCAD4;
L1_D_800D9200 = D_800DCAD8;
L1_D_800D9208 = D_800DCAE0;
L1_D_800D920C = D_800DCAE4;
L1_D_800D9210 = D_800DCAE8;
L1_D_800D9214 = D_800DCAEC;
L1_D_800D9218 = D_800DCAF0;
L1_D_800D9232 = D_800DCB0A;
L1_D_800D9268 = D_800DCB48;
L1_D_800D9278 = D_800DCB58;
L1_D_800DA270 = D_800DDB50;
L1_D_800DA5C0 = D_800DDEA0;
L1_D_800DA5C4 = D_800DDEA4;
L1_D_800DB884 = D_800DF164;
L1_D_800DCB44 = D_800E0A64;
L1_D_800DCB4C = D_800E0A6C;
L1_D_800DD7F4 = D_800E1714;
L1_D_800DDC44 = D_800E1718;
L1_D_800DDC48 = D_800E171C;
L1_D_800DDC4C = D_800E1720;
L1_D_800DDC50 = D_800E1724;
L1_D_800DDC54 = D_800E1728;
L1_D_800DDC58 = D_800E172C;
L1_D_800DDC5C = D_800E1730;
L1_D_800DDC60 = D_800E1734;
L1_D_800DDC64 = D_800E1738;
L1_D_800DDC68 = D_800E173C;
L1_D_800DDC6C = D_800E1740;
L1_D_800DDCC0 = D_800E1794;
L1_D_800DDCC4 = D_800E1798;
L1_D_800DDCC8 = D_800E179C;
L1_D_800DDCCC = D_800E17A0;
L1_D_800DDD8C = D_800E1860;
L1_D_800DDD90 = D_800E1864;
L1_D_800DDD94 = D_800E1868;
L1_D_800DDD98 = D_800E186C;
L1_D_800DDDA0 = D_800E1874;
L1_D_800DDDA4 = D_800E1878;
L1_D_800DDDA8 = D_800E187C;
L1_D_800DDDAC = D_800E1880;
L1_D_800DDDB0 = D_800E1884;
L1_D_800DDDB4 = D_800E1888;
L1_D_800DDDB8 = D_800E188C;
L1_D_800DDDBC = D_800E1890;
L1_D_800DDDCC = D_800E18A0;
L1_D_800DDDDC = D_800E18B0;
L1_D_800DDDEC = D_800E18C0;
L1_D_800DDE04 = D_800E18D8;
L1_D_800DDE08 = D_800E18DC;
L1_D_800DDE10 = D_800E18E4;
L1_D_800DDE30 = D_800E1904;
L1_D_800DDE34 = D_800E1908;
L1_D_800DDEE0 = D_800E19B4;
L1_D_800DDEE4 = D_800E19B8;
L1_D_800DDEE8 = D_800E19BC;
L1_D_800DDEEC = D_800E19C0;
L1_D_800DDEF0 = D_800E19C4;
L1_D_800DDF08 = D_800E19DC;
L1_D_800DDF24 = D_800E19F8;
L1_D_800DDFEC = D_800E1AC0;
L1_D_800DE000 = D_800E1AD4;
L1_D_800DE004 = D_800E1AD8;
L1_D_800DE018 = D_800E1AEC;
L1_D_800DE0C4 = D_800E1B98;
L1_D_800DE0C8 = D_800E1B9C;
L1_D_800DE0D4 = D_800E1BA8;
L1_D_800DE0D8 = D_800E1BAC;
L1_D_800DE0DC = D_800E1BB0;
L1_D_800DE0E0 = D_800E1BB4;
L1_D_800DE0E4 = D_800E1BB8;
L1_D_800DE0E8 = D_800E1BC0;
L1_D_800DE8E8 = D_800E23C0;
L1_D_800DF0E8 = D_800E2BC0;
L1_D_800DF0EC = D_800E2BC4;
L1_D_800DF0F0 = D_800E2BC8;
L1_D_800DF0F8 = D_800E2BD0;
L1_D_800DF10C = D_800E2BE4;
L1_D_800DF12C = D_800E2C04;
L1_D_800DF1F4 = D_800E2CCC;
L1_D_800DF200 = D_800E2CD8;
L1_D_800DF540 = D_800E3018;
L1_D_800DF5B8 = D_800E3090;
L1_D_800DF684 = D_800E315C;
L1_D_800E02B4 = D_800E3D8C;
L1_D_800E23D4 = D_800E67B8;
L1_D_800E23E8 = D_800E67D4;
L1_D_800E2438 = D_800E6810;
L1_D_800E2448 = D_800E6820;
L1_D_800E2DA8 = D_800E7180;
L1_D_800E2DBC = D_800E7194;
L1_D_800E2DE0 = D_800E71B8;
L1_D_800E2DE4 = D_800E71BC;
L1_D_800E2DF4 = D_800E71CC;
L1_D_800E2E44 = D_800E721C;
L1_D_800E2E48 = D_800E7220;
L1_D_800E2E4C = D_800E7224;
L1_D_800E2F2C = D_800E7304;
L1_D_800E2F38 = D_800E7310;
L1_D_800E2F3C = D_800E7314;
L1_D_800E2F54 = D_800E732C;
L1_D_800E2F58 = D_800E7330;
L1_D_800E2F5C = D_800E7334;
L1_D_800F0F5C = D_800F4B34;
L1_D_800F0F80 = D_800F4B58;
L1_D_800F1180 = D_800F4E30;
L1_D_800F11A0 = D_800F4E50;
L1_D_800F11D0 = D_800F4E80;
L1_D_800F11F0 = D_800F4EA0;
L1_D_800F128C = D_800F4F3C;
L1_D_800F1294 = D_800F4F44;
L1_D_800F12D4 = D_800F4F84;
L1_D_800F12EC = D_800F4F9C;
L1_D_800F12F4 = D_800F4FA4;
L1_D_800F1314 = D_800F4FC4;
L1_D_800F1354 = D_800F5004;
L1_D_800F136C = D_800F501C;
L1_D_800F1374 = D_800F5024;
L1_D_800F138C = D_800F503C;
L1_D_800F1398 = D_800F5048;
L1_D_800F13A8 = D_800F5058;
L1_D_800F1DCC = D_800F5A7C;
L1_D_800F25D8 = D_800F6288;
L1_D_800F2FBC = D_800F6C6C;
L1_D_800F3848 = D_800F74F8;
L1_D_800F3B48 = D_800F77F8;
L1_D_800F3E98 = D_800F7B48;
L1_D_800F40DC = D_800F7D8C;
L1_D_800F40E0 = D_800F7D90;
L1_D_800F40F8 = D_800F7DA8;
L1_D_800F40FC = D_800F7DAC;
L1_D_800F4114 = D_800F7DC4;
L1_D_800F413C = D_800F7DEC;
L1_D_800F415C = D_800F7E0C;
L1_D_800F4264 = D_800F7F14;
L1_D_800F4268 = D_800F7F18;
L1_D_800F426C = D_800F7F1C;
L1_D_800F4270 = D_800F7F20;
L1_D_800F5A64 = D_800F9714;
L1_D_800F5A65 = D_800F9715;
L1_D_800F5A66 = D_800F9716;
L1_D_800F5A68 = D_800F9718;
L1_D_800F5A6C = D_800F971C;
L1_D_800F6040 = D_800F9CF0;
L1_D_800F6064 = D_800F9D14;
L1_D_800F6068 = D_800F9D18;
L1_D_800F606C = D_800F9D1C;
L1_D_800F6070 = D_800F9D20;
L1_D_800F7664 = D_800FB314;
L1_D_800F7E64 = D_800FBB14;
L1_D_800F7EC4 = D_800FBB74;
L1_D_800F7EC8 = D_800FBB78;
L1_D_800F7EC9 = D_800FBB79;
L1_D_800F7ECA = D_800FBB7A;
L1_D_800F7ECC = D_800FBB7C;
L1_D_800F7ECE = D_800FBB7E;
L1_D_800F7ED0 = D_800FBB80;
L1_D_800F7ED2 = D_800FBB82;
L1_D_800F7EE4 = D_800FBB94;
L1_D_800F7EE8 = D_800FBB98;
L1_D_800F7EEC = D_800FBB9C;
L1_D_800F7EF4 = D_800FBBA4;
L1_D_800F7EF8 = D_800FBBA8;
L1_D_800F7EFC = D_800FBBAC;
L1_D_800F7F00 = D_800FBBB0;
L1_D_800F7F04 = D_800FBBB4;
L1_D_800F7F08 = D_800FBBB8;
L1_D_800F7F10 = D_800FBBC0;
L1_D_800F7F1C = D_800FBBCC;
L1_D_800F7F64 = D_800FBC14;
L1_D_800F7F68 = D_800FBC18;
L1_D_800F7F6C = D_800FBC1C;
L1_D_800F7F70 = D_800FBC20;
L1_D_800F7F74 = D_800FBC24;
L1_D_800F7F81 = D_800FBC31;
L1_D_800F7F84 = D_800FBC34;
L1_D_800F7FCC = D_800FBC7C;
L1_D_800F8014 = D_800FBCC4;
L1_D_800F81F4 = D_800FBEA4;
L1_D_800F81F8 = D_800FBEA8;
L1_D_800F8204 = D_800FBEB4;
L1_D_800F8208 = D_800FBEB8;
L1_D_800F8214 = D_800FBEC4;
L1_D_800F8614 = D_800FC2C4;
L1_D_800FC614 = D_801002C4;
L1_D_800FC616 = D_801002C6;
L1_D_800FC624 = D_801002D4;
L1_D_800FC628 = D_801002D8;
L1_D_800FC62C = D_801002DC;
L1_D_800FC630 = D_801002E0;
L1_D_800FC640 = D_801002F0;
L1_D_800FC644 = D_801002F4;
L1_D_800FC648 = D_801002F8;
L1_D_800FC650 = D_80100300;
L1_D_800FC654 = D_80100304;
L1_D_800FC658 = D_80100308;
L1_D_800FC65C = D_8010030C;
L1_D_800FC660 = D_80100310;
L1_D_800FC664 = D_80100314;
L1_D_800FC670 = D_80100320;
L1_D_800FC67C = D_8010032C;
L1_D_800FC6A0 = D_80100350;
L1_D_800FC6B0 = D_80100360;
L1_D_800FC6C0 = D_80100370;
L1_D_800FC780 = D_80100430;
L1_D_800FC784 = D_80100434;
L1_D_800FC788 = D_80100438;
L1_D_800FC790 = D_80100440;
L1_D_800FC794 = D_80100444;
L1_D_800FCF94 = D_80100C44;
L1_D_800FCF98 = D_80100C48;
L1_D_800FCF9C = D_80100C4C;
L1_D_800FCFA0 = D_80100C50;
L1_D_800FCFA4 = D_80100C54;
L1_D_800FCFA8 = D_80100C58;
L1_D_800FCFAC = D_80100C5C;
L1_D_800FCFB0 = D_80100C60;
L1_D_800FCFB4 = D_80100C64;
L1_D_800FD038 = D_80100CE8;
L1_D_800FD0B8 = D_80100D68;
L1_D_800FD0F8 = D_80100DA8;
L1_D_800FD138 = D_80100DE8;
L1_D_800FD178 = D_80100E28;
L1_D_800FD17C = D_80100E2C;
L1_D_800FD190 = D_80100E40;
L1_D_800FD191 = D_80100E41;
L1_D_800FD195 = D_80100E45;
L1_D_800FD197 = D_80100E47;
L1_D_800FD19A = D_80100E4A;
L1_D_800FD19B = D_80100E4B;
L1_D_800FD19F = D_80100E4F;
L1_D_800FD1A1 = D_80100E51;
L1_D_800FD1A2 = D_80100E52;
L1_D_800FD1A4 = D_80100E54;
L1_D_800FD1A6 = D_80100E54 + 0x2;
L1_D_800FD1A8 = D_80100E58;
L1_D_800FD1AC = D_80100E5C;
L1_D_800FD1BC = D_80100E6C;
L1_D_800FD1C0 = D_80100E70;
L1_D_800FD1C4 = D_80100E74;
L1_D_800FD1C8 = D_80100E78;
L1_D_800FD208 = D_80100EB8;
L1_D_800FD248 = D_80100EF8;
L1_D_800FD24C = D_80100EFC;
L1_D_800FD254 = D_80100F04;
L1_D_800FD258 = D_80100F08;
L1_D_800FD25C = D_80100F0C;
L1_D_800FD260 = D_80100F10;
L1_D_800FD264 = D_80100F14;
L1_D_800FD266 = D_80100F16;
L1_D_800FD268 = D_80100F18;
L1_D_800FD26A = D_80100F1A;
L1_D_800FD26C = D_80100F1C;
L1_D_800FD3E4 = D_80101094;
L1_D_800FD3E8 = D_80101098;
L1_D_800FD400 = D_801010B0;
L1_D_800FD440 = D_801010F0;
L1_D_800FD442 = D_801010F2;
L1_D_800FD444 = D_801010F4;
L1_D_800FD446 = D_801010F6;
L1_D_800FD448 = D_801010F8;
L1_D_800FD44A = D_801010FA;
L1_D_800FD44C = D_801010FC;
L1_D_800FD44E = D_801010FE;
L1_D_800FD450 = D_80101100;
L1_D_800FD452 = D_80101102;
L1_D_800FD454 = D_80101104;
L1_D_800FD456 = D_80101106;
L1_D_800FD458 = D_80101108;
L1_D_800FD45A = D_8010110A;
L1_D_800FD45D = D_8010110D;
L1_D_800FD45E = D_8010110E;
L1_D_800FD460 = D_80101110;
L1_D_800FD462 = D_80101112;
L1_D_800FD464 = D_80101114;
L1_D_800FD466 = D_80101116;
L1_D_800FD46A = D_8010111A;
L1_D_800FD46C = D_8010111C;
L1_D_800FD46E = D_8010111E;
L1_D_800FD470 = D_80101120;
L1_D_800FD472 = D_80101122;
L1_D_800FD476 = D_80101126;
L1_D_800FD824 = D_801014D4;
L1_D_800FD980 = D_80101630;
L1_D_800FD984 = D_80101634;
L1_D_800FD988 = D_80101638;
L1_D_800FD98C = D_8010163C;
L1_D_800FD990 = D_80101640;
L1_D_800FD994 = D_80101644;
L1_D_800FD998 = D_80101648;
L1_D_800FD99C = D_8010164C;
L1_D_800FD9A0 = D_80101650;
L1_D_800FD9A4 = D_80101654;
L1_D_800FD9AC = D_8010165C;
L1_D_800FD9C0 = D_80101670;
L1_D_800FD9C8 = D_80101678;
L1_D_800FD9D0 = D_80101680;
L1_D_800FD9D8 = D_80101688;
L1_D_800FD9DC = D_8010168C;
L1_D_800FD9E0 = D_80101690;
L1_D_800FD9F4 = D_801016A4;
L1_D_800FDA04 = D_801016B4;
L1_D_800FDA08 = D_801016B8;
L1_D_800FDA0C = D_801016BC;
L1_D_800FDA24 = D_801016D4;
L1_D_800FDB2C = D_801017DC;
L1_DebugPage_ArtProfile = func_80040F20;
func_80041218 = L1_DebugPage_Camera;
L1_DebugPage_ContourMask = func_80075CE0;
L1_DebugPage_FPWeapon = func_80079F3C;
L1_DebugPage_Framerate = func_80040F5C;
L1_DebugPage_Loadpoint = func_80031DBC;
func_80040FA8 = L1_DebugPage_ObjectCount;
L1_DebugPage_Profile = func_80040EE4;
func_8002FC20 = L1_DebugScreen_DrawPage;
L1_DeliverEvent = func_800946B4;
func_80032C78 = L1_DevMenu_Draw;
func_80032A20 = L1_DevMenu_HandleInput;
func_80032E40 = L1_DevMenu_Init;
L1_DisableEvent = func_8009B660;
L1_EVENT_OBJ_11C = func_80086588;
L1_EVENT_OBJ_90 = func_800864FC;
L1_EVENT_OBJ_CC = func_80086538;
L1_EVENT_OBJ_F4 = func_80086560;
L1_EnableEvent = func_8007F7E8;
L1_FlushCache = func_8009B970;
L1_FntFlush = func_8008865C;
L1_FntLoad = func_80088304;
L1_FntOpen = func_800883A4;
L1_FntPrint = func_80088978;
L1_GPU_cw = func_8008F098;
L1_GS_001_OBJ_1F8 = func_800853D4;
L1_GS_001_OBJ_74 = func_80085250;
L1_GS_107_OBJ_4B8 = func_80077798;
L1_GS_107_OBJ_51C = func_800777FC;
L1_GetClut = func_80082714;
L1_GetTPage = func_80082794;
func_8002F63C = L1_Gfx_Init;
L1_GsClearOt = func_80089AE4;
L1_GsDefDispBuff = func_8008ADC4;
L1_GsGetActiveBuff = func_8008574C;
L1_GsGetHeadpUnit = func_8008EDD0;
L1_GsGetLs = func_8007AC74;
L1_GsGetLsUnit = func_8008D53C;
L1_GsGetLwUnit = func_8008D80C;
L1_GsGetTimInfo = func_8008C964;
L1_GsInit3D = func_8008AD44;
L1_GsInitGraph = func_800851DC;
L1_GsInitGraph2 = func_8008536C;
L1_GsInitVcount = func_8008664C;
L1_GsLinkAnim = func_8008EA64;
L1_GsLinkObject4 = func_8008668C;
L1_GsMapCoordUnit = func_8008E06C;
L1_GsMapModelingData = func_8008C2A4;
L1_GsMapUnit = func_8008E0EC;
L1_GsScanAnim = func_8008E9BC;
L1_GsScanUnit = func_8008EC18;
L1_GsSetAmbient = func_8008EF48;
L1_GsSetDrawBuffClip = func_80093A0C;
L1_GsSetDrawBuffOffset = func_8008575C;
L1_GsSetFlatLight = func_800772E0;
L1_GsSetRefView2 = func_8008592C;
L1_GsSortClear = func_800855F4;
L1_GsSortObject4 = func_8007BF90;
L1_GsSortOt = func_80088204;
L1_GsSortUnit = func_8008D368;
L1_GsSwapDispBuff = func_80089B44;
L1_GsTMDdivF3NL = func_8008B3B4;
L1_GsTMDdivG3NL = func_8008B5A4;
L1_GsTMDdivNF3 = func_8008A954;
L1_GsTMDdivNG3 = func_8008AB44;
L1_GsTMDdivTF3L = func_8008B7A4;
L1_GsTMDdivTF3LFG = func_80089BF4;
L1_GsTMDdivTF3NL = func_800891C4;
L1_GsTMDdivTG3NL = func_80089474;
L1_GsTMDdivTNF3 = func_8008BD54;
L1_GsTMDdivTNG3 = func_8008C004;
L1_GsTMDfastF3GL = func_800896C4;
L1_GsTMDfastF3GLFG = func_8008AE84;
L1_GsTMDfastF3GNL = func_8008A424;
L1_GsTMDfastF3L = func_8007D5FC;
L1_GsTMDfastF3LFG = func_8007D744;
L1_GsTMDfastF3NL = func_8007D4BC;
L1_GsTMDfastG3GL = func_800898E4;
L1_GsTMDfastG3GLFG = func_8008B0A4;
L1_GsTMDfastG3GNL = func_8008A7E4;
L1_GsTMDfastG3L = func_8007D058;
L1_GsTMDfastG3LFG = func_8007D1E8;
L1_GsTMDfastG3NL = func_8007CF18;
L1_GsTMDfastNF3 = func_8007D380;
L1_GsTMDfastNG3 = func_8007CDD0;
L1_GsTMDfastTF3L = func_8007CAF0;
L1_GsTMDfastTF3LFG = func_8007CC60;
L1_GsTMDfastTF3NL = func_8007C98C;
L1_GsTMDfastTG3L = func_8007BC24;
L1_GsTMDfastTG3LFG = func_8007BDD8;
L1_GsTMDfastTG3NL = func_8007BAC8;
L1_GsTMDfastTNF3 = func_8007C820;
L1_GsTMDfastTNG3 = func_8007B950;
L1_GsU_00000008 = func_80099F30;
L1_GsU_00000009 = func_8009A0B0;
L1_GsU_0000000c = func_800995F0;
L1_GsU_0000000d = func_800997B0;
L1_GsU_0000000f = func_80099980;
L1_GsU_00000209 = func_8009A240;
L1_GsU_0000020d = func_80099B60;
L1_GsU_00200009 = func_8009A3E0;
L1_GsU_0020000d = func_80099D50;
L1_GsU_01000000 = func_80098650;
L1_GsU_0100000c = func_800981B0;
L1_GsU_0100000d = func_80098420;
L1_GsU_02000000 = func_80098070;
L1_GsU_02000001 = func_80098100;
L1_GsU_03000000 = D_80098780;
L1_GsU_03000001 = func_80098EC0;
L1_GsU_03000010 = func_800990A0;
L1_GsU_03000011 = func_80099290;
L1_Gssub_make_matrix = func_8008CD74;
L1_HookEntryInt = func_800936CC;
L1_INTR_DMA_OBJ_1CC = func_800938A8;
L1_INTR_DMA_OBJ_278 = func_80093954;
L1_INTR_DMA_OBJ_4C = func_80093728;
L1_INTR_VB_OBJ_58 = func_800935D4;
L1_INTR_VB_OBJ_C4 = func_80093640;
L1_INTR_VB_OBJ_F0 = func_8009366C;
L1_ISO9660_OBJ_2D8 = func_800842A8;
L1_ISO9660_OBJ_2F8 = func_800842C8;
L1_ISO9660_OBJ_5BC = func_8008458C;
L1_ISO9660_OBJ_660 = func_80084630;
L1_ISO9660_OBJ_8FC = func_800848CC;
L1_InitGeom = func_8008817C;
L1_InitHeap3 = func_8008C244;
L1_LoadClut = func_8008C884;
L1_LoadClut2 = func_8008C8F4;
L1_LoadTPage = func_80096284;
func_80076024 = L1_Math_Abs;
func_80076060 = L1_Math_Max;
func_80076114 = L1_Math_Max3;
func_800760AC = L1_Math_Min3;
L1_Menu_ResetState = func_80029038;
L1_MulMatrix = func_8007B2D4;
L1_MulMatrix2 = func_8007B3E4;
L1_OpenEvent = func_8007F90C;
L1_PADIF_OBJ_120 = func_80095C84;
L1_PADIF_OBJ_1CC = func_80095D30;
L1_PADIF_OBJ_290 = func_80095DF4;
L1_PADIF_OBJ_48 = func_80095BAC;
L1_PADPORTD_OBJ_160 = func_80086ADC;
L1_PADPORTD_OBJ_1C8 = func_80086B44;
L1_PADPORTD_OBJ_2BC = func_80086C38;
L1_PADPORTD_OBJ_2CC = func_80086C48;
L1_PADPORTD_OBJ_388 = func_80086D04;
L1_PADPORTD_OBJ_604 = func_80086F80;
L1_PADPORTD_OBJ_63C = func_80086FB8;
L1_PADSEQD_OBJ_144 = func_80094B08;
L1_PADSEQD_OBJ_34 = func_800949F8;
L1_PADSEQD_OBJ_488 = func_80094E4C;
L1_PATCHGTE_OBJ_DC = D_80096280;
L1_PCcreat = func_8008572C;
L1_PClseek = func_80084950;
L1_PCopen = func_80083FB0;
L1_PCread = func_80083878;
L1_PadInitDirect = func_8008697C;
func_80044A84 = L1_Pad_StickToSpeed;
func_8002F1D0 = L1_Pad_Update;
func_800418A4 = L1_PauseMenu_Open;
L1_PopMatrix = func_800779B4;
L1_PushMatrix = func_80077910;
L1_ResetEntryInt = func_800939AC;
func_80042284 = L1_RestartPrompt_Open;
L1_ReturnFromException = func_8009399C;
L1_RotAverage3 = func_80096DC4;
L1_RotAverageNclip3 = func_80096D34;
L1_RotAverageNclipColorCol3 = func_80097740;
L1_RotAverageNclipColorDpq3 = func_800963D4;
L1_RotAverageNclipColorDpq3_1 = func_8009682C;
L1_RotMatrix = func_8008E49C;
L1_RotMatrixY = func_8008CBD4;
L1_RotMatrixYXZ = func_8008E72C;
L1_RotMatrixYXZ_gte = func_8008D168;
L1_RotTrans = func_8008F068;
L1_ScaleMatrix = func_8008EE08;
L1_SetBackColor = func_8009A580;
L1_SetColorMatrix = func_800778E0;
L1_SetDefDispEnv = func_8008B374;
L1_SetDefDrawEnv = func_8008B2A4;
L1_SetDrawMode = func_80082614;
L1_SetDumpFnt = func_800882C4;
L1_SetFarColor = func_8009AC80;
L1_SetLightMatrix = func_8008F028;
L1_SetLineF4 = func_800825F4;
L1_SetRotMatrix = func_8008EFD8;
L1_SetTransMatrix = func_8008F008;
L1_SpuClearReverbWorkArea = func_800946E4;
L1_SpuFree = func_80094904;
L1_SpuGetVoiceEnvelope = func_8009A8F0;
L1_SpuInitMalloc = func_8009B990;
L1_SpuIsTransferCompleted = func_80097900;
L1_SpuMalloc = func_80097DA0;
L1_SpuRead = func_800978A0;
L1_SpuSetCommonAttr = func_80090F60;
L1_SpuSetKey = func_8009A940;
L1_SpuSetNoiseClock = func_8009AB30;
L1_SpuSetTransferMode = func_80097810;
L1_SpuSetTransferStartAddr = func_80097840;
L1_SpuSetVoiceAttr = func_80093E44;
L1_SpuStart = func_80091DC0;
L1_SquareRoot0 = func_80077850;
L1_SquareRoot12 = func_8008CF74;
L1_SsEnd = func_800868CC;
L1_SsPitchFromNote = func_8008FE8C;
L1_SsSeqCalledTbyT = func_80094444;
L1_SsSetSerialAttr = func_80082504;
L1_SsSetSerialVol = func_80082358;
L1_SsSetTickMode = func_8008602C;
L1_SsUtAllKeyOff = func_80085ECC;
L1_SsVabClose = func_8008681C;
L1_SsVabOpenHead = func_8008C7E4;
L1_SsVabTransBody = func_8008C594;
L1_SsVabTransCompleted = func_8008C664;
L1_SsVoKeyOn = func_80081FB0;
L1_SysDeqIntRP = func_80095A84;
L1_SysEnqIntRP = func_80095A94;
L1_TestEvent = func_8009B980;
L1_TransposeMatrix = func_8008CE44;
L1_VSYNC_OBJ_178 = func_80084AFC;
L1_VS_VH2_OBJ_34 = func_8008C818;
L1_VSync = func_80084984;
func_80075D50 = L1_Vec_Dot;
func_80075DCC = L1_Vec_ProjectXZ;
func_80075E74 = L1_Vec_Scale;
L1_WaitEvent = func_8009B650;
L1__SN_read = func_80091EC8;
L1__SN_write = func_80093AAC;
L1__SpuInit = func_80091CD8;
L1__SpuSetAnyVoice = func_8009B9F0;
L1__SsGetSeqData = func_8009BFF0;
L1__SsInit = func_8008F0A8;
L1__SsReadDeltaValue = func_8009CB30;
L1__SsSeqGetEof = func_8009BDAC;
L1__SsSeqPlay = func_8009BCB0;
L1__SsSndCrescendo = func_8009AF10;
L1__SsSndNextSep = func_8009CA30;
L1__SsSndPause = func_8009B340;
L1__SsSndPlay = func_8009AEE0;
L1__SsSndReplay = func_8009B3E0;
L1__SsSndTempo = func_8009B120;
L1__SsVmAlloc = func_80090CB0;
L1__SsVmDoAllocate = func_8008F698;
L1__SsVmFlush = func_8008F208;
L1__SsVmInit = func_8009A5A0;
L1__SsVmKeyOffNow = func_80090488;
L1__SsVmKeyOnNow = func_8008FFB8;
L1__SsVmSelectToneAndVag = func_8009AB80;
L1__SsVmVSetUp = func_8008F148;
L1__dirFailAuto = func_80094D6C;
L1__gp = D_800AC3D8;
L1__padInitDirSeq = func_800949C4;
L1__patch_gte = func_800961A4;
L1__spu_gcSPU = func_8009B670;
L1_bzero = func_80094E84;
L1_calloc3 = func_8008C314;
L1_chkRC2wait = func_80095AC4;
L1_exit = func_80082734;
L1_free3 = func_8008C444;
func_8002DD04 = L1_func_8002DD6C;
L1_func_8002E0E8 = func_8002E080;
L1_func_8002E190 = func_8002E128;
func_8002E148 = L1_func_8002E1B0;
func_8002E2B0 = L1_func_8002E318;
L1_func_8002E3A0 = func_8002E338;
L1_func_8002E410 = func_8002E3A8;
L1_func_8002E430 = func_8002E3C8;
L1_func_8002E48C = func_8002E424;
L1_func_8002E4B4 = func_8002E44C;
L1_func_8002E4D4 = func_8002E46C;
func_8002E474 = L1_func_8002E4DC;
L1_func_8002E534 = func_8002E4CC;
func_8002E55C = L1_func_8002E5C4;
PROVIDE(L1_func_8002E798 = func_8002E730);
PROVIDE(func_8002E730 = L1_func_8002E798);
L1_func_8002F0A4 = func_8002F03C;
L1_func_8002F114 = func_8002F0AC;
L1_func_8002F1BC = func_8002F154;
L1_func_8002F1F4 = func_8002F18C;
func_8002F4FC = L1_func_8002F564;
func_8002F5BC = L1_func_8002F624;
L1_func_8002F7CC = func_8002F764;
L1_func_8002FE04 = func_8002FD7C;
PROVIDE(L1_func_8002FFD8 = func_8002FF50);
PROVIDE(func_8002FF50 = L1_func_8002FFD8);
func_80030090 = L1_func_80030118;
func_80030224 = L1_func_800302AC;
L1_func_80030304 = func_8003027C;
L1_func_80030324 = func_8003029C;
func_800302AC = L1_func_80030334;
func_8003032C = L1_func_800303B4;
PROVIDE(L1_func_8003052C = func_800304A4);
PROVIDE(func_800304A4 = L1_func_8003052C);
L1_func_800305B4 = func_8003052C;
L1_func_80030610 = func_80030588;
func_800305E8 = L1_func_80030670;
L1_func_800306A8 = func_80030620;
L1_func_800306F0 = func_80030668;
func_80030710 = L1_func_80030798;
L1_func_80030868 = func_800307E0;
PROVIDE(L1_func_80030994 = func_8003090C);
PROVIDE(func_8003090C = L1_func_80030994);
func_80030A7C = L1_func_80030B04;
func_80030C80 = L1_func_80030D08;
func_80030D18 = L1_func_80030DA0;
L1_func_80030EB0 = func_80030E28;
func_80030E98 = L1_func_80030F20;
func_80030F20 = L1_func_80030FA8;
func_8003102C = L1_func_800310B4;
L1_func_80031678 = func_800315F0;
L1_func_80031F18 = func_80032038;
L1_func_80031F28 = func_80032048;
L1_func_80031F54 = func_80032074;
L1_func_80032024 = func_80032144;
func_80032194 = L1_func_80032074;
func_80032310 = L1_func_800321F0;
func_800325B0 = L1_func_8003246C;
L1_func_800324C0 = func_80032604;
func_80032614 = L1_func_800324D0;
L1_func_80032648 = func_8003278C;
func_80032868 = L1_func_80032724;
func_800328AC = L1_func_80032768;
L1_func_80032880 = func_800329C4;
func_80032F90 = L1_func_80032E4C;
PROVIDE(L1_func_80032EFC = func_80033040);
PROVIDE(func_80033040 = L1_func_80032EFC);
func_800331D4 = L1_func_80033090;
func_800333E8 = L1_func_800332A4;
func_80033514 = L1_func_80033348;
func_800335A0 = L1_func_800333D4;
func_800335EC = L1_func_800334F4;
L1_func_80033F38 = func_80034400;
func_80034EDC = L1_func_800349F8;
func_80035514 = L1_func_80035030;
L1_func_800350F0 = func_800355D4;
PROVIDE(L1_func_800352B8 = func_8003576C);
PROVIDE(func_8003576C = L1_func_800352B8);
func_80035E18 = L1_func_80035964;
func_80035EA0 = L1_func_800359EC;
func_80036070 = L1_func_80035BBC;
func_8003629C = L1_func_80035DE8;
func_800363B8 = L1_func_80035F04;
func_80036670 = L1_func_800361BC;
func_800367DC = L1_func_80036328;
func_80036A68 = L1_func_800365B4;
func_80036B24 = L1_func_80036670;
L1_func_800368A8 = func_80036D5C;
L1_func_80036938 = func_80036DEC;
func_800372AC = L1_func_80036E10;
L1_func_800373FC = func_80037898;
func_80037BC0 = L1_func_80037768;
func_80037C4C = L1_func_800377F4;
func_80037D54 = L1_func_800378FC;
func_80037E7C = L1_func_80037A24;
func_80037F24 = L1_func_80037ACC;
L1_func_80037B6C = func_80037FC4;
func_800384E0 = L1_func_800380DC;
PROVIDE(L1_func_800381CC = func_800385D0);
PROVIDE(func_800385D0 = L1_func_800381CC);
func_80038808 = L1_func_80038404;
func_80038B34 = L1_func_8003872C;
func_80038DF4 = L1_func_80038984;
func_800390F0 = L1_func_80038C04;
func_80039178 = L1_func_80038C8C;
L1_func_800390F8 = func_800395E4;
PROVIDE(L1_func_800391B0 = func_8003969C);
PROVIDE(func_8003969C = L1_func_800391B0);
L1_func_800393AC = func_80039898;
func_800398D0 = L1_func_800393E4;
L1_func_80039520 = func_80039A0C;
L1_func_800395E8 = func_80039AD4;
func_80039C6C = L1_func_800397A8;
PROVIDE(L1_func_8003982C = func_80039CF0);
PROVIDE(func_80039CF0 = L1_func_8003982C);
func_80039EF8 = L1_func_80039A34;
PROVIDE(L1_func_80039A9C = func_80039F60);
PROVIDE(func_80039F60 = L1_func_80039A9C);
PROVIDE(L1_func_8003A51C = func_8003A9E0);
PROVIDE(func_8003A9E0 = L1_func_8003A51C);
PROVIDE(L1_func_8003A68C = func_8003AB50);
PROVIDE(func_8003AB50 = L1_func_8003A68C);
L1_func_8003A71C = func_8003ABE0;
func_8003AD5C = L1_func_8003A898;
func_8003AED8 = L1_func_8003AA14;
PROVIDE(L1_func_8003AC1C = func_8003B0E0);
PROVIDE(func_8003B0E0 = L1_func_8003AC1C);
func_8003B9B8 = L1_func_8003B4F4;
PROVIDE(L1_func_8003B53C = func_8003BA00);
PROVIDE(func_8003BA00 = L1_func_8003B53C);
L1_func_8003B750 = func_8003BC14;
PROVIDE(L1_func_8003B808 = func_8003BCCC);
PROVIDE(func_8003BCCC = L1_func_8003B808);
func_8003BE04 = L1_func_8003B940;
func_8003C15C = L1_func_8003BC98;
func_8003C32C = L1_func_8003BE68;
L1_func_8003BFB8 = func_8003C47C;
func_8003C6C8 = L1_func_8003C1BC;
func_8003CBBC = L1_func_8003C6B0;
func_8003CBF0 = L1_func_8003C6E4;
func_8003CD98 = L1_func_8003C88C;
func_8003CDB0 = L1_func_8003C8A4;
func_8003CED0 = L1_func_8003C9C4;
L1_func_8003CA4C = func_8003CF58;
func_8003CFC8 = L1_func_8003CABC;
L1_func_8003CC8C = func_8003D198;
PROVIDE(L1_func_8003D76C = func_8003DC08);
PROVIDE(func_8003DC08 = L1_func_8003D76C);
func_8003E2F4 = L1_func_8003DE58;
func_8003E5F4 = L1_func_8003E158;
func_8003E930 = L1_func_8003E494;
PROVIDE(L1_func_8003E5A0 = func_8003EA3C);
PROVIDE(func_8003EA3C = L1_func_8003E5A0);
func_8003EEC0 = L1_func_8003EA24;
func_8003EF9C = L1_func_8003EB00;
PROVIDE(L1_func_8003EC44 = func_8003F0E0);
PROVIDE(func_8003F0E0 = L1_func_8003EC44);
func_8003FC04 = L1_func_8003F768;
L1_func_8003FC60 = func_800400FC;
func_80040168 = L1_func_8003FCE4;
func_80040420 = L1_func_8003FF9C;
L1_func_8004009C = func_80040520;
PROVIDE(L1_func_80040778 = func_80040A60);
PROVIDE(func_80040A60 = L1_func_80040778);
func_80040C60 = L1_func_80040978;
func_80040D90 = L1_func_80040AA8;
L1_func_8004105C = func_80041344;
func_800414A4 = L1_func_800411BC;
L1_func_8004133C = func_80041624;
L1_func_800414AC = func_80041794;
L1_func_80041578 = func_80041860;
L1_func_800417C4 = func_80041AAC;
L1_func_800419CC = func_80041D78;
func_80041DE4 = L1_func_80041A38;
L1_func_80041BA0 = func_80041F4C;
func_80041FD4 = L1_func_80041C28;
L1_func_80041CF0 = func_8004209C;
func_80042168 = L1_func_80041DBC;
func_80042224 = L1_func_80041E78;
L1_func_80042020 = func_800423CC;
func_80042538 = L1_func_8004218C;
L1_func_800425E4 = func_80042990;
func_800435AC = L1_func_80043200;
L1_func_800433A8 = func_80043754;
L1_func_80043EE0 = func_8004428C;
func_80044C2C = L1_func_800448F4;
L1_func_80044B3C = func_80044E5C;
L1_func_80044BAC = func_80044ECC;
L1_func_80044BBC = func_80044EDC;
PROVIDE(L1_func_80044BCC = func_80044EEC);
PROVIDE(func_80044EEC = L1_func_80044BCC);
func_800453A4 = L1_func_80045084;
func_8004546C = L1_func_8004514C;
func_80045664 = L1_func_80045344;
func_800459EC = L1_func_800456D0;
PROVIDE(L1_func_80045A28 = func_80045D44);
PROVIDE(func_80045D44 = L1_func_80045A28);
L1_func_8004626C = func_80046588;
PROVIDE(L1_func_800463C8 = func_800466E4);
PROVIDE(func_800466E4 = L1_func_800463C8);
func_80047634 = L1_func_80047318;
PROVIDE(L1_func_800474AC = func_800477C8);
PROVIDE(func_800477C8 = L1_func_800474AC);
func_800478D8 = L1_func_800475BC;
L1_func_800477C0 = func_80047ADC;
L1_func_8004782C = func_80047B48;
L1_func_8004783C = func_80047B58;
L1_func_800478C8 = func_80047BE4;
func_80047D20 = L1_func_80047A04;
func_80047E6C = L1_func_80047B50;
func_800480D8 = L1_func_80047DBC;
L1_func_80047ECC = func_800481E8;
func_800486F8 = L1_func_800483D8;
func_8004873C = L1_func_8004841C;
PROVIDE(L1_func_80048794 = func_80048AB4);
PROVIDE(func_80048AB4 = L1_func_80048794);
func_80048E6C = L1_func_80048B4C;
func_80049104 = L1_func_80048DE4;
func_80049180 = L1_func_80048E60;
L1_func_80048FE8 = func_80049308;
L1_func_8004900C = func_8004932C;
func_800496E0 = L1_func_800493C0;
func_80049790 = L1_func_80049470;
func_80049A5C = L1_func_8004973C;
func_80049C04 = L1_func_800498E4;
func_80049DA8 = L1_func_80049A88;
L1_func_80049B7C = func_80049E9C;
func_80049EA4 = L1_func_80049B84;
L1_func_8004A29C = func_8004A5BC;
L1_func_8004A304 = func_8004A624;
L1_func_8004A338 = func_8004A658;
L1_func_8004A380 = func_8004A6A0;
L1_func_8004A398 = func_8004A6B8;
L1_func_8004A81C = func_8004AAF4;
L1_func_8004A85C = func_8004AB34;
L1_func_8004A8A8 = func_8004AB80;
func_8004ABBC = L1_func_8004A8E4;
PROVIDE(L1_func_8004A9E4 = func_8004ACBC);
PROVIDE(func_8004ACBC = L1_func_8004A9E4);
func_8004B1E4 = L1_func_8004AF0C;
L1_func_8004B028 = func_8004B300;
L1_func_8004B04C = func_8004B324;
L1_func_8004B05C = func_8004B334;
L1_func_8004B06C = func_8004B344;
L1_func_8004B084 = func_8004B35C;
func_8004B388 = L1_func_8004B0B0;
func_8004B46C = L1_func_8004B194;
L1_func_8004B270 = func_8004B548;
L1_func_8004B324 = func_8004B5FC;
L1_func_8004B334 = func_8004CB58;
func_8004CBE0 = L1_func_8004B3BC;
func_8004CDB0 = L1_func_8004B58C;
func_8004D220 = L1_func_8004B9FC;
func_8004D324 = L1_func_8004BB00;
func_8004D494 = L1_func_8004BC70;
func_8004D5CC = L1_func_8004BDA8;
L1_func_8004BE84 = func_8004D6A8;
L1_func_8004BF70 = func_8004D794;
func_8004D8E4 = L1_func_8004C0C0;
PROVIDE(L1_func_8004C368 = func_8004DB8C);
PROVIDE(func_8004DB8C = L1_func_8004C368);
func_8004DCBC = L1_func_8004C498;
L1_func_8004C50C = func_8004DD30;
func_8004DD7C = L1_func_8004C558;
L1_func_8004C5C8 = func_8004DDEC;
L1_func_8004C698 = func_8004DEBC;
L1_func_8004C768 = func_8004DF8C;
L1_func_8004C824 = func_8004E048;
func_8004E050 = L1_func_8004C82C;
func_8004E168 = L1_func_8004C944;
func_8004E280 = L1_func_8004CA5C;
func_8004E350 = L1_func_8004CB2C;
func_8004E418 = L1_func_8004CBF4;
func_8004E4FC = L1_func_8004CCD8;
func_8004E538 = L1_func_8004CD14;
func_8004E5C4 = L1_func_8004CDA0;
L1_func_8004CE38 = func_8004E65C;
func_8004E698 = L1_func_8004CE74;
func_8004E724 = L1_func_8004CF00;
L1_func_8004D048 = func_8004E86C;
func_8004EA38 = L1_func_8004D214;
func_8004EAF4 = L1_func_8004D2D0;
L1_func_8004D5A8 = func_8004EDCC;
func_8004EF50 = L1_func_8004D72C;
func_8004EF94 = L1_func_8004D770;
func_8004F068 = L1_func_8004D844;
func_8004F0B0 = L1_func_8004D88C;
func_8004F19C = L1_func_8004D978;
func_8004F284 = L1_func_8004DA60;
func_8004F3F0 = L1_func_8004DBCC;
func_8004F5C0 = L1_func_8004DD9C;
func_8004F81C = L1_func_8004DFF8;
func_8004F8A0 = L1_func_8004E07C;
func_8004FB28 = L1_func_8004E304;
func_8004FB4C = L1_func_8004E328;
L1_func_8004E37C = func_8004FBA0;
PROVIDE(L1_func_8004E5D8 = func_8004FCF8);
PROVIDE(func_8004FCF8 = L1_func_8004E5D8);
L1_func_8004E78C = func_8004FEAC;
func_8004FEB4 = L1_func_8004E794;
func_8004FFBC = L1_func_8004E89C;
func_8005008C = L1_func_8004E96C;
func_800500CC = L1_func_8004E9AC;
L1_func_8004EA68 = func_80050188;
func_800501D8 = L1_func_8004EAB8;
func_80050240 = L1_func_8004EB20;
func_80050390 = L1_func_8004EC70;
func_80050664 = L1_func_8004EF44;
L1_func_8004F134 = func_80050854;
func_80050868 = L1_func_8004F148;
func_80050A68 = L1_func_8004F348;
L1_func_8004F3D8 = func_80050AF8;
PROVIDE(L1_func_8004F3E8 = func_80050B08);
PROVIDE(func_80050B08 = L1_func_8004F3E8);
PROVIDE(L1_func_8004F880 = func_80050FA0);
PROVIDE(func_80050FA0 = L1_func_8004F880);
PROVIDE(L1_func_8004FD3C = func_8005145C);
PROVIDE(func_8005145C = L1_func_8004FD3C);
func_800518A0 = L1_func_80050180;
func_80051AAC = L1_func_8005038C;
PROVIDE(L1_func_800503D8 = func_80051AF8);
PROVIDE(func_80051AF8 = L1_func_800503D8);
func_80052080 = L1_func_80050960;
func_800520BC = L1_func_8005099C;
func_80052104 = L1_func_800509E4;
func_80052130 = L1_func_80050A10;
PROVIDE(L1_func_80050A70 = func_80052190);
PROVIDE(func_80052190 = L1_func_80050A70);
func_80052E48 = L1_func_80051728;
func_80053A10 = L1_func_800523E4;
func_80053C5C = L1_func_80052630;
func_80053E34 = L1_func_80052808;
func_80054158 = L1_func_80052B2C;
L1_func_80052BEC = func_80054218;
func_8005447C = L1_func_80053004;
func_800544F8 = L1_func_80053080;
L1_func_800530F4 = func_8005456C;
func_80054AB0 = L1_func_80053684;
L1_func_800536F0 = func_80054B1C;
L1_func_80053790 = func_80054BBC;
func_80054C30 = L1_func_80053804;
func_80054DA8 = L1_func_8005397C;
func_80054E58 = L1_func_80053A2C;
func_80054EA8 = L1_func_80053A7C;
func_80054F90 = L1_func_80053B64;
L1_func_80053BD0 = func_80054FFC;
func_8005500C = L1_func_80053BE0;
L1_func_80053DAC = func_800551D8;
func_80055210 = L1_func_80053DE4;
func_80055304 = L1_func_80053ED8;
func_800555BC = L1_func_80054098;
func_800555F0 = L1_func_800540CC;
func_8005563C = L1_func_80054118;
func_80055690 = L1_func_8005416C;
func_8005578C = L1_func_80054268;
func_80055830 = L1_func_8005430C;
func_800558E0 = L1_func_800543BC;
L1_func_80054414 = func_80055938;
func_80055B68 = L1_func_80054604;
func_80055C00 = L1_func_8005469C;
func_80055D28 = L1_func_800547C4;
func_80055DA0 = L1_func_8005483C;
func_80055EC8 = L1_func_80054964;
func_8005602C = L1_func_80054AC8;
func_8005615C = L1_func_80054BF8;
func_80056308 = L1_func_80054DA4;
func_8005639C = L1_func_80054E38;
func_80056498 = L1_func_80054F34;
func_80056540 = L1_func_80054FDC;
func_800565C4 = L1_func_80055060;
func_800566D0 = L1_func_8005516C;
func_80056768 = L1_func_80055204;
func_80056800 = L1_func_8005529C;
func_80056860 = L1_func_800552FC;
func_800568C0 = L1_func_8005535C;
func_80056924 = L1_func_800553C0;
func_80056A74 = L1_func_80055510;
func_80056AFC = L1_func_80055598;
func_80056BD4 = L1_func_80055670;
func_80056D2C = L1_func_800557C8;
PROVIDE(L1_func_800557F4 = func_80056D58);
PROVIDE(func_80056D58 = L1_func_800557F4);
func_80056D78 = L1_func_80055814;
PROVIDE(L1_func_80055878 = func_80056DDC);
PROVIDE(func_80056DDC = L1_func_80055878);
PROVIDE(L1_func_80055BA8 = func_8005710C);
PROVIDE(func_8005710C = L1_func_80055BA8);
func_80057388 = L1_func_80055E24;
func_800574BC = L1_func_80055F58;
func_800575B8 = L1_func_80056054;
func_80057674 = L1_func_80056110;
PROVIDE(L1_func_80056154 = func_800576B8);
PROVIDE(func_800576B8 = L1_func_80056154);
func_800578BC = L1_func_80056358;
func_80057920 = L1_func_800563BC;
func_800579A8 = L1_func_80056444;
func_80057A10 = L1_func_800564AC;
func_80057A9C = L1_func_80056538;
func_80057AD4 = L1_func_80056570;
func_80057B40 = L1_func_800565DC;
func_80057B78 = L1_func_80056614;
func_80057C5C = L1_func_800566F8;
func_80057DA0 = L1_func_8005683C;
func_80057DF8 = L1_func_80056894;
func_80058280 = L1_func_80056D1C;
func_800584F4 = L1_func_80056F90;
func_800585D8 = L1_func_80057074;
func_8005865C = L1_func_800570F8;
func_800586F8 = L1_func_80057194;
func_8005871C = L1_func_800571B8;
PROVIDE(L1_func_800572F4 = func_80058858);
PROVIDE(func_80058858 = L1_func_800572F4);
func_80058908 = L1_func_800573A4;
func_80058974 = L1_func_80057410;
func_800589A0 = L1_func_8005743C;
func_800589E0 = L1_func_8005747C;
func_80058B60 = L1_func_800575FC;
L1_func_80057648 = func_80058BAC;
PROVIDE(L1_func_80057750 = func_80058CB4);
PROVIDE(func_80058CB4 = L1_func_80057750);
func_80059014 = L1_func_80057AB0;
L1_func_80057AD8 = func_8005903C;
func_80059090 = L1_func_80057B2C;
L1_func_80057B94 = func_800590F8;
L1_func_80057BFC = func_80059160;
L1_func_80057C40 = func_800591A4;
L1_func_80058694 = func_80059BF8;
func_80059DC0 = L1_func_8005885C;
func_80059FBC = L1_func_80058A58;
func_8005A074 = L1_func_80058B10;
func_8005A0D0 = L1_func_80058B6C;
L1_func_80058D00 = func_8005A264;
func_8005A2C0 = L1_func_80058D5C;
func_8005A360 = L1_func_8005AD6C;
L1_func_8005ADB0 = func_8005A3A4;
PROVIDE(L1_func_8005ADD4 = func_8005A3C8);
PROVIDE(func_8005A3C8 = L1_func_8005ADD4);
PROVIDE(L1_func_8005AEF8 = func_8005A4EC);
PROVIDE(func_8005A4EC = L1_func_8005AEF8);
func_8005AAFC = L1_func_8005B508;
func_8005AB78 = L1_func_8005B584;
func_8005ABA0 = L1_func_8005B5AC;
func_8005ACC0 = L1_func_8005B6CC;
func_8005AD60 = L1_func_8005B76C;
func_8005ADB0 = L1_func_8005B7BC;
func_8005AE60 = L1_func_8005B86C;
func_8005AF60 = L1_func_8005B96C;
func_8005B024 = L1_func_8005BA30;
func_8005B0DC = L1_func_8005BAE8;
func_8005B274 = L1_func_8005BC80;
func_8005B4E4 = L1_func_8005BEF0;
func_8005B700 = L1_func_8005C10C;
PROVIDE(L1_func_8005C214 = func_8005B808);
PROVIDE(func_8005B808 = L1_func_8005C214);
func_8005B930 = L1_func_8005C33C;
L1_func_8005C864 = func_8005BE58;
L1_func_8005C894 = func_8005BE88;
func_8005BEB8 = L1_func_8005C8C4;
func_8005C014 = L1_func_8005CA20;
L1_func_8005CB38 = func_8005C12C;
func_8005C3FC = L1_func_8005CED0;
func_8005C4F4 = L1_func_8005CFC8;
func_8005C7DC = L1_func_8005D2B0;
L1_func_8005D58C = func_8005CAB8;
func_8005CAF0 = L1_func_8005D5C4;
func_8005CB5C = L1_func_8005D630;
func_8005CC8C = L1_func_8005D760;
L1_func_8005DA90 = func_8005CFBC;
PROVIDE(L1_func_8005DB7C = func_8005D0A8);
PROVIDE(func_8005D0A8 = L1_func_8005DB7C);
func_8005D16C = L1_func_8005DC40;
L1_func_8005DF40 = func_8005D46C;
func_8005D4A8 = L1_func_8005DF7C;
func_8005D54C = L1_func_8005E020;
func_8005D754 = L1_func_8005E228;
PROVIDE(L1_func_8005E424 = func_8005D950);
PROVIDE(func_8005D950 = L1_func_8005E424);
func_8005E008 = L1_func_8005EADC;
func_8005E098 = L1_func_8005EB6C;
func_8005E2F8 = L1_func_8005EC84;
L1_func_8005ED88 = func_8005E3FC;
func_8005E46C = L1_func_8005EE6C;
L1_func_8005F3B0 = func_8005E9A8;
func_8005EEE0 = L1_func_8005F93C;
func_8005F04C = L1_func_8005FAA8;
L1_func_8005FF60 = func_8005F4F8;
L1_func_80060094 = func_8005F628;
func_8005F9D0 = L1_func_8006043C;
func_8005FBC8 = L1_func_800604B0;
L1_func_8006060C = func_8005FD24;
func_8005FD2C = L1_func_80060614;
func_8005FEB0 = L1_func_80060798;
func_8005FFFC = L1_func_800608E4;
func_800601D8 = L1_func_80060AC0;
L1_func_80060E28 = func_80060514;
L1_func_80061018 = func_800606B8;
PROVIDE(L1_func_80061068 = func_8006074C);
PROVIDE(func_8006074C = L1_func_80061068);
func_80060CAC = L1_func_800615C8;
L1_func_80061700 = func_80060DE4;
func_80060DEC = L1_func_80061708;
L1_func_80061DC0 = func_8006141C;
func_80061520 = L1_func_80061EC4;
func_8006195C = L1_func_80062300;
L1_func_80062394 = func_800619F0;
func_80061DE0 = L1_func_80062784;
func_800621C4 = L1_func_80062B68;
func_80062594 = L1_func_80062F38;
PROVIDE(L1_func_80062FAC = func_80062608);
PROVIDE(func_80062608 = L1_func_80062FAC);
func_8006288C = L1_func_800632AC;
func_80062990 = L1_func_800633B0;
func_80062AA0 = L1_func_800634C0;
func_80062C98 = L1_func_800636B8;
func_80062D90 = L1_func_800637B0;
L1_func_80063858 = func_80062E38;
L1_func_80063ADC = func_800630BC;
func_80063100 = L1_func_80063B20;
func_8006328C = L1_func_80063CAC;
func_80063320 = L1_func_80063D40;
L1_func_80063ED4 = func_800634B4;
L1_func_80063EF8 = func_800634D8;
func_80063514 = L1_func_80063F34;
func_80063564 = L1_func_80063F84;
func_8006370C = L1_func_8006412C;
func_8006375C = L1_func_8006417C;
func_800637FC = L1_func_8006439C;
func_8006393C = L1_func_800644DC;
func_80063A7C = L1_func_8006461C;
func_80063AC0 = L1_func_80064660;
func_80063CAC = L1_func_8006484C;
func_80063E70 = L1_func_80064A10;
func_80064088 = L1_func_80064C28;
L1_func_80064E40 = func_800642A0;
func_80064514 = L1_func_80065510;
L1_func_80065588 = func_8006458C;
func_800645BC = L1_func_800655B8;
func_80064618 = L1_func_80065614;
L1_func_800658B4 = func_800648B8;
func_8006492C = L1_func_80065928;
PROVIDE(L1_func_80065A20 = func_80064A24);
PROVIDE(func_80064A24 = L1_func_80065A20);
func_8006509C = L1_func_80066098;
func_800652AC = L1_func_800662A8;
func_800654BC = L1_func_800664B8;
func_80065708 = L1_func_80066704;
L1_func_8006692C = func_80065930;
L1_func_80066968 = func_8006596C;
func_800659A8 = L1_func_800669A4;
L1_func_80066A60 = func_80065A64;
L1_func_80066B14 = func_80066064;
L1_func_80067F18 = func_80067DCC;
func_80068A64 = L1_func_800689F0;
L1_func_80069318 = func_80069A48;
L1_func_80069328 = func_80069A58;
L1_func_800693DC = func_80069ACC;
func_80069B28 = L1_func_80069478;
L1_func_800698B8 = func_8006A2A0;
L1_func_8006B198 = func_8006C090;
L1_func_8006B1DC = func_8006C0D4;
L1_func_8006B230 = func_8006C128;
func_8006C16C = L1_func_8006B274;
PROVIDE(L1_func_8006B2C4 = func_8006C1BC);
PROVIDE(func_8006C1BC = L1_func_8006B2C4);
func_8006D38C = L1_func_8006C494;
func_8006D7EC = L1_func_8006C8F4;
PROVIDE(L1_func_8006CB88 = func_8006DA80);
PROVIDE(func_8006DA80 = L1_func_8006CB88);
PROVIDE(L1_func_8006CEA4 = func_8006DD9C);
PROVIDE(func_8006DD9C = L1_func_8006CEA4);
func_8006E2B8 = L1_func_8006D3C0;
PROVIDE(L1_func_8006D470 = func_8006E368);
PROVIDE(func_8006E368 = L1_func_8006D470);
func_8006EC18 = L1_func_8006DD20;
PROVIDE(L1_func_8006E054 = func_8006EF4C);
PROVIDE(func_8006EF4C = L1_func_8006E054);
func_8006F518 = L1_func_8006E620;
func_8006F8D8 = L1_func_8006E9E0;
func_8006FBB4 = L1_func_8006ECBC;
func_8006FDA0 = L1_func_8006EEA8;
func_8006FF2C = L1_func_8006F034;
PROVIDE(L1_func_8006F168 = func_80070060);
PROVIDE(func_80070060 = L1_func_8006F168);
func_800705A4 = L1_func_8006F6AC;
PROVIDE(L1_func_8006F784 = func_8007067C);
PROVIDE(func_8007067C = L1_func_8006F784);
func_8007089C = L1_func_8006F9A4;
func_8007094C = L1_func_8006FA54;
func_800709FC = L1_func_8006FB04;
func_80070DCC = L1_func_8006FED4;
func_80070F68 = L1_func_80070070;
func_800711C4 = L1_func_800702CC;
func_800714A0 = L1_func_800705A8;
func_800715E8 = L1_func_800706F0;
func_80072530 = L1_func_80071638;
PROVIDE(L1_func_80072190 = func_80073088);
PROVIDE(func_80073088 = L1_func_80072190);
func_80073304 = L1_func_8007240C;
PROVIDE(L1_func_800726D0 = func_800735C8);
PROVIDE(func_800735C8 = L1_func_800726D0);
func_80073C40 = L1_func_80072D48;
func_80073D20 = L1_func_80072E28;
PROVIDE(L1_func_8007369C = func_80074594);
PROVIDE(func_80074594 = L1_func_8007369C);
func_800752E0 = L1_func_800743E8;
PROVIDE(L1_func_800746D0 = func_800755C8);
PROVIDE(func_800755C8 = L1_func_800746D0);
func_80075EE0 = L1_func_80074FE8;
L1_func_80075290 = func_80076188;
func_800761B8 = L1_func_800752C0;
PROVIDE(L1_func_800752E8 = func_800761E0);
PROVIDE(func_800761E0 = L1_func_800752E8);
L1_func_800753A4 = func_8007629C;
L1_func_800753F0 = func_800762E8;
func_80076354 = L1_func_8007545C;
func_800764B4 = L1_func_800755BC;
func_80076574 = L1_func_8007567C;
func_800766B8 = L1_func_800757C0;
L1_func_800758C0 = func_800767B8;
func_800767E8 = L1_func_800758F0;
func_80076818 = L1_func_80075920;
func_80076C40 = L1_func_80075D48;
func_80076D94 = L1_func_80075E9C;
func_80076E18 = L1_func_80075F20;
L1_func_80075FA0 = func_80076E98;
L1_func_80075FE4 = func_80076EDC;
func_80076F0C = L1_func_80076014;
L1_func_800760B4 = func_80076FAC;
func_80076FFC = L1_func_80076104;
func_8007707C = L1_func_80076184;
L1_func_800761DC = func_800770D4;
L1_func_80077764 = func_80077A60;
L1_func_800779FC = func_80077CF8;
L1_func_80077CCC = func_80077FC8;
L1_func_80077D50 = func_8007804C;
L1_func_80077FC4 = func_800782C0;
L1_func_800781B4 = func_800784B0;
L1_func_80078534 = func_80078830;
L1_func_800785A8 = func_800788A4;
L1_func_800787FC = func_80078AF8;
L1_func_80078840 = func_80078B3C;
L1_func_800788E0 = func_80078BDC;
L1_func_800792B8 = func_800799B4;
L1_func_800794A0 = func_80079EF0;
L1_func_800794D4 = func_80079F24;
L1_func_80079588 = func_80079FD8;
L1_func_800797A8 = func_8007A1F8;
L1_func_8007980C = func_8007A248;
L1_func_800798A8 = func_8007A2B8;
L1_func_800798D4 = func_8007A2E4;
L1_func_80079B94 = func_8007A5A4;
L1_func_80079C04 = func_8007A614;
L1_func_80079C54 = func_8007A664;
L1_func_80079DB8 = func_8007A7E0;
L1_func_80079E10 = func_8007A838;
L1_func_80079F84 = func_8007A9AC;
L1_func_8007A040 = func_8007AAA0;
L1_func_8007A17C = func_8007ABDC;
L1_func_8007A1B0 = func_8007AC10;
L1_func_8007A1FC = func_8007AC5C;
L1_func_8007A4E4 = func_8007AF44;
L1_func_8007A554 = func_8007AFB4;
L1_func_8007A580 = func_8007AFE0;
L1_func_8007A614 = func_8007B074;
L1_func_8007A694 = func_8007B0F4;
L1_func_8007AA94 = func_8007B4F4;
L1_func_8007AC7C = func_8007B6DC;
L1_func_8007CE30 = func_8007D890;
L1_func_8007D184 = func_8007DBE4;
L1_func_8007D1E8 = func_8007DC48;
L1_func_8007D260 = func_8007DCC0;
L1_func_8007D2B4 = func_8007DD14;
L1_func_8007D914 = func_8007E374;
L1_func_8007DA88 = func_8007E4E8;
L1_func_8007DE50 = func_8007E8B0;
L1_func_8007E610 = func_8007F070;
L1_func_8007E6A4 = func_8007F104;
L1_func_8007EB7C = func_8007F5DC;
L1_func_8007EC78 = func_8007F6D8;
L1_func_8007ED98 = func_8007F7F8;
L1_func_8007EE34 = func_8007F894;
L1_func_8007EE64 = func_8007F8C4;
L1_func_8007EEBC = func_8007F91C;
L1_func_8007EECC = func_8007F92C;
L1_func_8007F040 = func_8007FAA0;
L1_func_8007F0D8 = func_8007FB38;
L1_func_8007F140 = func_8007FBA0;
L1_func_8007F25C = func_8007FCBC;
L1_func_8007F2EC = func_8007FD4C;
L1_func_8007F34C = func_8007FDAC;
L1_func_8007F414 = func_8007FE74;
L1_func_8007F4C0 = func_8007FF20;
L1_func_8007F530 = func_8007FF90;
L1_func_8007F5F0 = func_80080050;
L1_func_8007FAE8 = func_80080548;
L1_func_8007FCE0 = func_80080740;
L1_func_8007FF50 = func_800809B0;
L1_func_8007FF70 = func_800809D0;
L1_func_80080008 = func_80080A68;
L1_func_800800A0 = func_80080B00;
L1_func_800800BC = func_80080B1C;
L1_func_8008013C = func_80080B9C;
L1_func_80080154 = func_80080BB4;
L1_func_80080234 = func_80080C94;
L1_func_80080464 = func_80080EC4;
L1_func_800806A0 = func_80081100;
L1_func_80080920 = func_80081380;
L1_func_80080944 = func_800813A4;
L1_func_80080958 = func_800813B8;
L1_func_80080998 = func_800813F8;
L1_func_800809E0 = func_80081440;
L1_func_80080A10 = func_80081470;
L1_func_80080A34 = func_80081494;
L1_func_80080CE4 = func_80081744;
L1_func_80080F44 = func_800819A4;
L1_func_80081094 = func_80081AF4;
L1_func_800811D0 = func_80081C30;
L1_func_80081204 = func_80081C64;
L1_func_80081348 = func_80081DA8;
L1_func_800813E8 = func_80081E48;
L1_func_80081410 = func_80081E70;
L1_func_80081448 = func_80081EA8;
L1_func_80081458 = func_80081EB8;
L1_func_800814CC = func_80081F2C;
L1_func_800815A0 = func_80082000;
L1_func_80081A08 = func_80082468;
L1_func_80081B74 = func_800825D4;
L1_func_80081C54 = func_800826B4;
L1_func_80081C84 = func_800826E4;
L1_func_80081CE4 = func_80082744;
L1_func_80081D14 = func_80082774;
L1_func_80082638 = func_80083098;
L1_func_800828AC = func_8008330C;
L1_func_8008297C = func_800833DC;
L1_func_80082B64 = func_800835C4;
L1_func_80082D00 = func_80083760;
L1_func_80082E04 = func_80083864;
L1_func_80082ED8 = func_80083938;
L1_func_80082EE8 = func_80083948;
L1_func_80082EF8 = func_80083958;
L1_func_80082F04 = func_80083964;
L1_func_80082F24 = func_80083984;
L1_func_80082F44 = func_800839A4;
L1_func_80082F64 = func_800839C4;
L1_func_80082F78 = func_800839D8;
L1_func_80082F8C = func_800839EC;
L1_func_800830C8 = func_80083B28;
L1_func_800831FC = func_80083C5C;
L1_func_80083348 = func_80083DA8;
L1_func_80083368 = func_80083DC8;
L1_func_80083388 = func_80083DE8;
L1_func_800833AC = func_80083E0C;
L1_func_800833CC = func_80083E2C;
L1_func_800834D0 = func_80083F30;
L1_func_80083F14 = func_80084974;
L1_func_80084134 = func_80084B94;
L1_func_80084164 = func_80084BC4;
L1_func_80084194 = func_80084BF4;
L1_func_800841C4 = func_80084C24;
L1_func_800841F8 = func_80084C58;
L1_func_80084228 = func_80084C88;
L1_func_80084238 = func_80084C98;
L1_func_80084250 = func_80084CB0;
L1_func_80084328 = func_80084D88;
L1_func_800844F8 = func_80084F58;
L1_func_80084640 = func_800850A0;
L1_func_800846E0 = func_80085140;
L1_func_80084758 = func_800851B8;
L1_func_80084E0C = func_8008586C;
L1_func_800855BC = func_8008601C;
L1_func_8008571C = func_8008617C;
L1_func_8008596C = func_800863CC;
L1_func_800859B8 = func_80086418;
L1_func_80085B5C = func_800865BC;
L1_func_80085BD0 = func_80086630;
L1_func_800865BC = func_8008701C;
L1_func_80086688 = func_800870E8;
L1_func_80086780 = func_800871E0;
L1_func_80086854 = func_800872B4;
L1_func_8008688C = func_800872EC;
L1_func_800868D4 = func_80087334;
L1_func_80086928 = func_80087388;
L1_func_80086A40 = func_800874A0;
L1_func_80086A6C = func_800874CC;
L1_func_80086AD4 = func_80087534;
L1_func_80086C64 = func_800876C4;
L1_func_80086D30 = func_80087790;
L1_func_80086D74 = func_800877D4;
L1_func_800870A8 = func_80087B08;
L1_func_80087198 = func_80087BF8;
L1_func_800873A8 = func_80087E08;
L1_func_80087620 = func_80088080;
L1_func_800876B0 = func_80088110;
L1_func_800876E4 = func_80088144;
L1_func_80088C44 = func_800896A4;
L1_func_8008A404 = func_8008AE64;
L1_func_8008A904 = func_8008B364;
L1_func_8008C5A4 = func_8008D014;
L1_func_8008C5C4 = func_8008D034;
L1_func_8008C5D8 = func_8008D048;
L1_func_8008C638 = func_8008D0A8;
L1_func_8008CCB8 = func_8008D498;
L1_func_8008D2EC = func_8008DACC;
L1_func_8008DAAC = func_8008E28C;
L1_func_8008DB68 = func_8008E348;
L1_func_8008DBDC = func_8008E3BC;
L1_func_8008E03C = func_8008EAAC;
L1_func_8008E378 = func_8008EDE8;
L1_func_8008FAE8 = func_80090548;
L1_func_80090004 = func_80090A64;
L1_func_80090164 = func_80090BC4;
L1_func_80090880 = func_800912E0;
L1_func_80090B00 = func_80091560;
L1_func_80090CC0 = func_80091720;
L1_func_80090D7C = func_800917DC;
L1_func_80090FFC = func_80091A5C;
L1_func_80091080 = func_80091AE0;
L1_func_800910C4 = func_80091B24;
L1_func_80091168 = func_80091BC8;
L1_func_800911C0 = func_80091C20;
L1_func_800911E8 = func_80091C48;
L1_func_80091210 = func_80091C70;
L1_func_80091450 = func_80091EB0;
L1_func_80091480 = func_80091EE0;
L1_func_800919DC = func_8009243C;
L1_func_80091C5C = func_800926BC;
L1_func_80091F24 = func_80092984;
L1_func_80092330 = func_80092D90;
L1_func_80092404 = func_80092E64;
L1_func_800924F4 = func_80092F54;
L1_func_800926D4 = func_80093134;
L1_func_8009283C = func_8009329C;
L1_func_8009293C = func_8009339C;
L1_func_80092A34 = func_80093494;
L1_func_80092F24 = func_80093984;
L1_func_80092F5C = func_800939BC;
L1_func_8009302C = func_80093A8C;
L1_func_80093C64 = func_800946C4;
L1_func_80093E24 = func_80094884;
L1_func_80093F24 = func_80094984;
L1_func_80093F4C = func_800949AC;
L1_func_80094434 = func_80094E94;
L1_func_80094440 = func_80094EA0;
L1_func_800944C4 = func_80094F24;
L1_func_80094734 = func_80095194;
L1_func_8009476C = func_800951CC;
L1_func_80094840 = func_800952A0;
L1_func_800948E8 = func_80095348;
L1_func_80094CE0 = func_80095740;
L1_func_80094D48 = func_800957A8;
L1_func_80094D64 = func_800957C4;
L1_func_80094E2C = func_8009588C;
L1_func_80094EC4 = func_80095924;
L1_func_80094F18 = func_80095978;
L1_func_80094F78 = func_800959D8;
L1_func_80094F98 = func_800959F8;
L1_func_80094FAC = func_80095A0C;
L1_func_80094FCC = func_80095A2C;
L1_func_80094FEC = func_80095A4C;
L1_func_8009500C = func_80095A6C;
L1_func_80095104 = func_80095B64;
L1_func_800957F0 = func_80096250;
L1_func_80095914 = func_80096374;
L1_func_80095934 = func_80096394;
L1_func_80095954 = func_800963B4;
L1_func_80095A44 = func_800964A4;
L1_func_80095A64 = func_800964C4;
L1_func_80095D7C = func_800967DC;
L1_func_80095ECC = func_8009692C;
L1_func_80096270 = func_80096CD0;
L1_func_800963C4 = func_80096E24;
L1_func_80096738 = func_80097198;
L1_func_800967BC = func_8009721C;
L1_func_80096BC0 = func_80097620;
L1_func_80096C54 = func_800976B4;
L1_func_80096C9C = func_800976FC;
L1_func_80096F50 = func_800979B0;
L1_func_80099EB0 = func_8009A910;
L1_func_8009A0A0 = func_8009AB00;
L1_func_8009A1F0 = func_8009AC50;
L1_func_8009A3B0 = func_8009AE10;
L1_func_8009A9E0 = func_8009B440;
L1_func_8009AB60 = func_8009B5C0;
L1_func_8009B940 = func_8009C3A0;
L1_func_8009BEAC = func_8009C90C;
L1_func_8009BF10 = func_8009C970;
L1_func_8009BFC0 = func_8009CA20;
L1_func_800AACFC = func_800AC7F4;
L1_func_800AAEF8 = func_800AC9F0;
L1_gPsi = D_800B3628;
L1_g_Args = D_800B3608;
L1_g_CamPosX = D_800B36B8;
L1_g_CamPosY = D_800B36BC;
L1_g_CamRotX = D_800B3680;
L1_g_CamTargetX = D_800B3674;
L1_g_Camera = D_800B3670;
L1_g_CheatCodeProgress = D_800B43CC;
L1_g_CheatCodes = D_8009D71C;
L1_g_CutScene = D_8009D75C;
L1_g_DebugPageNames = D_8009D8B4;
L1_g_DebugTextX = D_8009DA7C;
L1_g_DebugTextY = D_8009DA7E;
L1_g_DevMenu = D_800D68D8;
L1_g_FrameCap = D_800B4350;
L1_g_FrameRate = D_8009D810;
L1_g_GodMode = D_8009D79E;
L1_g_Invincible = D_8009D4E8;
L1_g_MenuUpdateFunc = D_800D7CD0;
L1_g_PadAxes = D_800B4710;
L1_g_PadAxesPrev = D_800B4714;
L1_g_PadHeld = D_800B46F8;
L1_g_PadPressed = D_800B4700;
L1_g_PadPrev = D_800B4704;
L1_g_Player = D_800B43B4;
L1_g_Projection = D_800B371C;
L1_g_Weapons = D_800B3730;
L1_gteMIMefunc = func_8008CEF4;
L1_gte_rotate_z_matrix = func_80093AC4;
L1_jtbl_800A6F68 = jtbl_800A865C;
L1_jtbl_800A7168 = jtbl_800A885C;
L1_jtbl_800A74B0 = jtbl_800A8BA4;
L1_jtbl_800A7764 = jtbl_800A8E58;
L1_jtbl_800A7ED8 = jtbl_800A966C;
L1_jtbl_800A8028 = jtbl_800A97BC;
L1_jtbl_800A8088 = jtbl_800A981C;
L1_jtbl_800A859C = jtbl_800A9D30;
L1_jtbl_800A8AC0 = jtbl_800AA288;
L1_jtbl_800A8B20 = jtbl_800AA2E8;
L1_jtbl_800A8BE8 = jtbl_800AA3B0;
L1_jtbl_800A98E4 = jtbl_800AB370;
L1_jtbl_800A9AEC = jtbl_800AB5E4;
L1_jtbl_800A9DF8 = jtbl_800AB8F0;
L1_jtbl_800AA190 = jtbl_800ABC88;
L1_jtbl_800AA1F0 = jtbl_800ABCE8;
L1_jtbl_800AA270 = jtbl_800ABD68;
L1_jtbl_800AA2A8 = jtbl_800ABDA0;
L1_jtbl_800AA330 = jtbl_800ABE28;
L1_jtbl_800AA540 = jtbl_800AC038;
L1_jtbl_800AA560 = jtbl_800AC058;
L1_jtbl_800AA780 = jtbl_800AC278;
L1_jtbl_800AA860 = jtbl_800AC358;
L1_jtbl_800AA880 = jtbl_800AC378;
L1_malloc3 = func_8008C394;
L1_memchr = func_8008C654;
L1_memcpy = func_8008CEE4;
L1_memmove = func_80091E38;
L1_memset = func_8008CED4;
L1_note2pitch = func_8008FDD8;
L1_note2pitch2 = func_8008FE24;
L1_printf = func_8007F8FC;
L1_rand = func_800824F4;
L1_ratan2 = func_8008CA54;
L1_rcos = func_8009ACA0;
L1_rsin = func_8009AD40;
L1_setRC2wait = func_80095AA4;
L1_setjmp = func_800936BC;
L1_sin_1 = func_8009AD7C;
L1_sprintf = func_800827D4;
L1_start = func_8002C808;
L1_startIntrDMA = func_800936DC;
L1_startIntrVSync = func_8009357C;
L1_strcat = func_80084940;
L1_strcmp = func_8008C694;
L1_strcpy = func_80082704;
L1_strlen = func_800826D4;
L1_strncmp = func_8009356C;
L1_strncpy = func_8008F058;
L1_strstr = func_8008C7D4;
L1_strtok = func_8008C6A4;
L1_strtol = func_8008C7C4;
L1_toupper = func_800825C4;
L1_vmNoiseOff = func_80090F20;
L1_vmNoiseOn = func_8008F868;
L1_func_80029684 = func_80029684;
L2_D_800A03C0 = D_8009CBE8;
L2_D_800A0425 = D_8009CC4D;
L2_D_800A0426 = D_8009CC4E;
L2_D_800A0438 = D_8009CC60;
L2_D_800A0C92 = D_8009D4BA;
L2_D_800A0CC0 = D_8009D4E8;
L2_D_800A0CC4 = D_8009D4EC;
L2_D_800A0CD4 = D_8009D4FC;
L2_D_800A0CDC = D_8009D504;
L2_D_800A0CF7 = D_8009D51F;
L2_D_800A0EF4 = D_8009D71C;
L2_D_800A0F34 = D_8009D75C;
L2_D_800A0F8C = D_8009D7B8;
L2_D_800A0F9C = D_8009D7C8;
L2_D_800A0FAB = D_8009D7D7;
L2_D_800A0FD0 = D_8009D7FC;
L2_D_800A0FE0 = D_8009D80C;
L2_D_800A0FE4 = D_8009D810;
L2_D_800A101F = D_8009D84B;
L2_D_800A106C = D_8009D898;
L2_D_800A11F0 = D_8009DA10;
L2_D_800A11FE = D_8009DA1E;
L2_D_800A1200 = D_8009DA20;
L2_D_800A1204 = D_8009DA24;
L2_D_800A1230 = D_8009DA50;
L2_D_800A123C = D_8009DA5C;
L2_D_800A1240 = D_8009DA60;
L2_D_800A1242 = D_8009DA62;
L2_D_800A1244 = D_8009DA64;
L2_D_800A1248 = D_8009DA68;
L2_D_800A124C = D_8009DA6C;
L2_D_800A1254 = D_8009DA74;
L2_D_800A1258 = D_8009DA78;
L2_D_800A125A = D_8009DA7A;
L2_D_800A125C = D_8009DA7C;
L2_D_800A125E = D_8009DA7E;
L2_D_800A1278 = D_8009DA98;
L2_D_800A12CC = D_8009DAEC;
L2_D_800A12D0 = D_8009DAF0;
L2_D_800A12D4 = D_8009DAF4;
L2_D_800A1344 = D_8009DB64;
L2_D_800A1346 = D_8009DB66;
L2_D_800A1366 = D_8009DB86;
L2_D_800A14A8 = D_8009DCC8;
L2_D_800A1634 = D_8009DE28;
L2_D_800A1640 = D_8009DE34;
L2_D_800A167C = D_8009DE70;
L2_D_800A19A0 = D_8009E16C;
L2_D_800A1A1C = D_8009E1E8;
L2_D_800A1C74 = D_8009E440;
L2_D_800A1CC4 = D_8009E490;
L2_D_800A1EEC = D_8009E6B8;
L2_D_800A3E74 = D_8009FF14;
L2_D_800A3E8C = D_8009FF2C;
L2_D_800A3F0C = D_800A002C;
L2_D_800AC49C = D_800A85B4;
L2_D_800AC4AC = D_800A85C4;
L2_D_800AC4D4 = D_800A85EC;
L2_D_800AC6FC = D_800A8814;
L2_D_800AC80C = D_800A8924;
L2_D_800AC820 = D_800A8938;
L2_D_800ACB1C = D_800A8C34;
L2_D_800ACB40 = D_800A8C58;
L2_D_800ACB4C = D_800A8C64;
L2_D_800ACB88 = D_800A8CA0;
L2_D_800ACB9C = D_800A8CB4;
L2_D_800ACC18 = D_800A8D30;
L2_D_800ACC2C = D_800A8D44;
L2_D_800ACC40 = D_800A8D58;
L2_D_800ACC54 = D_800A8D6C;
L2_D_800ACC7C = D_800A8D94;
L2_D_800ACC88 = D_800A8DA0;
L2_D_800ACC9C = D_800A8DB4;
L2_D_800ACF24 = D_800A905C;
L2_D_800ACF38 = D_800A9070;
L2_D_800ACF48 = D_800A9080;
L2_D_800ACF5C = D_800A9094;
L2_D_800ACF70 = D_800A90A8;
L2_D_800ACF94 = D_800A90CC;
L2_D_800ACFCC = D_800A9104;
L2_D_800AD400 = D_800A9554;
L2_D_800AD428 = D_800A957C;
L2_D_800AD820 = D_800A9974;
L2_D_800ADA08 = D_800A9B5C;
L2_D_800ADA50 = D_800A9BA4;
L2_D_800ADA58 = D_800A9BAC;
L2_D_800ADC24 = D_800A9D78;
L2_D_800ADE00 = D_800A9F48;
L2_D_800ADE10 = D_800A9F58;
L2_D_800ADE20 = D_800A9F68;
L2_D_800ADE6C = D_800A9FB4;
L2_D_800ADE80 = D_800A9FC8;
L2_D_800ADEB8 = D_800AA000;
L2_D_800AE5A4 = D_800AA6F8;
L2_D_800AE8D8 = D_800AAA2C;
L2_D_800AE8EC = D_800AAA40;
L2_D_800AE914 = D_800AAA68;
L2_D_800AE968 = D_800AAABC;
L2_D_800AF09C = D_800AB1D4;
L2_D_800AF0A0 = D_800AB1D8;
L2_D_800AF140 = D_800AB278;
L2_D_800AF160 = D_800AB298;
L2_D_800AF188 = D_800AB2C0;
L2_D_800AF198 = D_800AB2D0;
L2_D_800AF1B0 = D_800AB2E8;
L2_D_800B0F58 = D_800AD038;
L2_D_800B0FF8 = D_800AD0D8;
L2_D_800B0FFC = D_800AD0DC;
L2_D_800B1018 = D_800AD0F8;
L2_D_800B102C = D_800AD10C;
L2_D_800B117C = D_800AD2C0;
L2_D_800B118C = D_800AD2D0;
L2_D_800B1DC4 = D_800ADF08;
L2_D_800B1F2C = D_800AE0D4;
L2_D_800B1F30 = D_800AE0D8;
L2_D_800B1FA0 = D_800AE148;
L2_D_800B4E3C = D_800B2434;
L2_D_800B4E6C = D_800B2464;
L2_D_800B56B4 = D_800B2CAC;
L2_D_800B5738 = D_800B2D30;
L2_D_800B5739 = D_800B2D31;
L2_D_800B5F3C = D_800B3534;
L2_D_800B5F49 = D_800B3541;
L2_D_800B5F4A = D_800B3542;
L2_D_800B5F4B = D_800B3543;
L2_D_800B5F50 = D_800B3548;
L2_D_800B5FB4 = D_800B35AC;
L2_D_800B6010 = D_800B3608;
L2_D_800B6014 = D_800B360C;
L2_D_800B6030 = D_800B3628;
L2_D_800B6038 = D_800B3630;
L2_D_800B603C = D_800B3634;
L2_D_800B6054 = D_800B364C;
L2_D_800B6058 = D_800B3650;
L2_D_800B605C = D_800B3654;
L2_D_800B6060 = D_800B3658;
L2_D_800B6064 = D_800B365C;
L2_D_800B60C0 = D_800B36B8;
L2_D_800B6104 = D_800B36FC;
L2_D_800B6120 = D_800B3718;
L2_D_800B6138 = D_800B3730;
L2_D_800B6A94 = D_800B3E64;
L2_D_800B6C78 = D_800B4048;
L2_D_800B6C8C = D_800B405C;
L2_D_800B6C94 = D_800B4064;
L2_D_800B6CA8 = D_800B4078;
L2_D_800B6D4C = D_800B411C;
L2_D_800B6F80 = D_800B4350;
L2_D_800B6F88 = D_800B4358;
L2_D_800B6F8C = D_800B435C;
L2_D_800B6FC4 = D_800B4394;
L2_D_800B6FE4 = D_800B43B4;
L2_D_800B6FFC = D_800B43CC;
L2_D_800B70F4 = D_800B44C4;
L2_D_800B7114 = D_800B44E4;
L2_D_800B7140 = D_800B4510;
L2_D_800B7160 = D_800B4530;
L2_D_800B7170 = D_800B4540;
L2_D_800B7284 = D_800B4654;
L2_D_800B7288 = D_800B4658;
L2_D_800B72A4 = D_800B4674;
L2_D_800B72B4 = D_800B4684;
L2_D_800B72B8 = D_800B4688;
L2_D_800B72C8 = D_800B4698;
L2_D_800B7318 = D_800B46E8;
L2_D_800B7324 = D_800B46F4;
L2_D_800B7328 = D_800B46F8;
L2_D_800B7330 = D_800B4700;
L2_D_800B7334 = D_800B4704;
L2_D_800B7338 = D_800B4708;
L2_D_800B733C = D_800B470C;
L2_D_800B7340 = D_800B4710;
L2_D_800B7344 = D_800B4714;
L2_D_800BF408 = D_800BC7D8;
L2_D_800BF46C = D_800BC83C;
L2_D_800C625C = D_800C5508;
L2_D_800CD020 = D_800CE1A8;
L2_D_800D5318 = D_800D64A0;
L2_D_800D55A0 = D_800D6728;
L2_D_800D55A4 = D_800D672C;
L2_D_800D55A8 = D_800D6730;
L2_D_800D5670 = D_800D67F8;
L2_D_800D58E0 = D_800D6A68;
L2_D_800D6978 = D_800D7B00;
L2_D_800D6B48 = D_800D7CD0;
L2_D_800D6B70 = D_800D7CF8;
L2_D_800D6BB8 = D_800D7D34;
L2_D_800D6D20 = D_800D7E9C;
L2_D_800D6D54 = D_800D7ED0;
L2_D_800D6D6C = D_800D7EE8;
L2_D_800D6D84 = D_800D7F00;
L2_D_800D6D9C = D_800D7F18;
L2_D_800D70B4 = D_800D8230;
L2_D_800D8500 = D_800D967C;
L2_D_800D869C = D_800D9818;
L2_D_800D9C5C = D_800DADD8;
L2_D_800D9FE4 = D_800DB160;
L2_D_800DA034 = D_800DB1B0;
L2_D_800DA084 = D_800DB200;
L2_D_800DA088 = D_800DB204;
L2_D_800DA12C = D_800DB2A8;
L2_D_800DA20C = D_800DB388;
L2_D_800DA210 = D_800DB38C;
L2_D_800DA348 = D_800DB4C4;
L2_D_800DA410 = D_800DB58C;
L2_D_800DA894 = D_800DBA10;
L2_D_800DA8AC = D_800DBA28;
L2_D_800DAE20 = D_800DBF9C;
L2_D_800DAE24 = D_800DBFA0;
L2_D_800DAE44 = D_800DBFC0;
L2_D_800DB3D8 = D_800DC554;
L2_D_800DB814 = D_800DC8D0;
L2_D_800DBA48 = D_800DCABC;
L2_D_800DBA6C = D_800DCAE0;
L2_D_800DBA70 = D_800DCAE4;
L2_D_800DBA98 = D_800DCB0C;
L2_D_800DCAE0 = D_800DDB50;
L2_D_800DCD68 = D_800DDDD8;
L2_D_800E0068 = D_800E1718;
L2_D_800E006C = D_800E171C;
L2_D_800E0070 = D_800E1720;
L2_D_800E0074 = D_800E1724;
L2_D_800E0078 = D_800E1728;
L2_D_800E007C = D_800E172C;
L2_D_800E0080 = D_800E1730;
L2_D_800E0084 = D_800E1734;
L2_D_800E0088 = D_800E1738;
L2_D_800E008C = D_800E173C;
L2_D_800E00E4 = D_800E1794;
L2_D_800E00E8 = D_800E1798;
L2_D_800E00EC = D_800E179C;
L2_D_800E01B0 = D_800E1860;
L2_D_800E01B4 = D_800E1864;
L2_D_800E01B8 = D_800E1868;
L2_D_800E01BC = D_800E186C;
L2_D_800E01C4 = D_800E1874;
L2_D_800E01C8 = D_800E1878;
L2_D_800E01D0 = D_800E1880;
L2_D_800E01D4 = D_800E1884;
L2_D_800E01DC = D_800E188C;
L2_D_800E0228 = D_800E18D8;
L2_D_800E022C = D_800E18DC;
L2_D_800E030C = D_800E19BC;
L2_D_800E0310 = D_800E19C0;
L2_D_800E04FC = D_800E1BAC;
L2_D_800E0500 = D_800E1BB0;
L2_D_800E0504 = D_800E1BB4;
L2_D_800E1510 = D_800E2BC0;
L2_D_800E1514 = D_800E2BC4;
L2_D_800E1554 = D_800E2C04;
L2_D_800E1628 = D_800E2CD8;
L2_D_800E6694 = D_800E71B8;
L2_D_800E680C = D_800E7330;
L2_D_800E6810 = D_800E7334;
L2_D_800F4010 = D_800F4B34;
L2_D_800F415C = D_800F4C80;
L2_D_800F4160 = D_800F4C84;
L2_D_800F4458 = D_800F4EA0;
L2_D_800F44DC = D_800F4F24;
L2_D_80100D94 = D_801017DC;
L2_func_8002680C = func_8002680C;
func_800268CC = L2_func_800268CC;
func_80026B00 = L2_func_80026B00;
func_80026C14 = L2_func_80026C14;
func_80026C38 = L2_func_80026C38;
L2_func_80026C90 = func_80026C90;
L2_func_80026F5C = func_80026F30;
func_800286EC = L2_func_800288B4;
L2_func_800288F4 = func_8002872C;
L2_func_800289D8 = func_80028810;
L2_func_80028B20 = func_80028958;
func_800289C0 = L2_func_80028B88;
func_80029038 = L2_func_80029200;
L2_func_80029378 = func_800291B0;
L2_func_80029A30 = func_80029868;
L2_func_8002A7E4 = func_8002A61C;
L2_func_8002A8E8 = func_8002A720;
func_8002AAC4 = L2_func_8002AC8C;
func_8002ADF0 = L2_func_8002AFB8;
func_8002AF08 = L2_func_8002B0D0;
func_8002B064 = L2_func_8002B22C;
L2_func_8002B268 = func_8002B0A0;
L2_func_8002B464 = func_8002B29C;
func_8002BB34 = L2_func_8002BCFC;
func_8002BDE4 = L2_func_8002BFAC;
L2_func_8002C330 = func_8002C168;
func_8002C2D8 = L2_func_8002C4A0;
func_8002C664 = L2_func_8002C82C;
L2_func_8002D39C = func_8002D1D4;
L2_func_8002D6AC = func_8002D4E4;
func_8002E080 = L2_func_8002E24C;
func_8002E0D8 = L2_func_8002E2A4;
func_8002E130 = L2_func_8002E2FC;
func_8002E1C0 = L2_func_8002E38C;
func_8002E338 = L2_func_8002E508;
func_8002E3C8 = L2_func_8002E598;
func_8002E424 = L2_func_8002E5F4;
func_8002E4CC = L2_func_8002E69C;
func_8002F03C = L2_func_8002F214;
func_8002F0AC = L2_func_8002F284;
func_8002F154 = L2_func_8002F32C;
func_8002F18C = L2_func_8002F364;
func_8002F40C = L2_func_8002F5E4;
L2_func_8002F68C = func_8002F4B4;
func_8002F4D4 = L2_func_8002F6AC;
L2_func_8002F6D4 = func_8002F4FC;
L2_func_8002F814 = func_8002F63C;
func_8002FD7C = L2_func_8002FF60;
func_8003027C = L2_func_80030454;
func_8003029C = L2_func_80030474;
func_800302CC = L2_func_800304A4;
L2_func_80030504 = func_8003032C;
L2_func_80030704 = func_8003052C;
L2_func_800307C0 = func_800305E8;
func_80030668 = L2_func_80030840;
func_800307E0 = L2_func_800309B8;
func_80030E28 = L2_func_80031000;
func_80031DBC = L2_func_80031E68;
L2_func_80031F34 = func_80031E88;
func_80032468 = L2_func_800324E8;
L2_func_80032684 = func_80032604;
func_8003278C = L2_func_8003280C;
L2_func_8003292C = func_800328AC;
L2_func_80033254 = func_800331D4;
func_80033460 = L2_func_800334E0;
L2_func_80035C7C = func_8003576C;
L2_func_800368C8 = func_800363B8;
L2_func_8003815C = func_80037C4C;
L2_func_8003838C = func_80037E7C;
func_80037FC4 = L2_func_800384D4;
L2_func_800387C4 = func_800382B4;
func_80038CF0 = L2_func_800393F8;
func_80038DC4 = L2_func_800398F0;
L2_func_80039920 = func_80038DF4;
func_80038F14 = L2_func_80039A40;
func_80039074 = L2_func_80039BA0;
func_80039130 = L2_func_80039C5C;
func_800395E4 = L2_func_8003A110;
func_80039898 = L2_func_8003A3C4;
L2_func_8003A3FC = func_800398D0;
func_80039A0C = L2_func_8003A538;
func_80039AD4 = L2_func_8003A600;
L2_func_8003AA8C = func_80039F60;
func_8003ABE0 = L2_func_8003B70C;
L2_func_8003BC0C = func_8003B0E0;
L2_func_8003D7E4 = func_8003CDB0;
func_800400FC = L2_func_80040B30;
func_80040F5C = L2_func_80041990;
func_80041624 = L2_func_80042058;
func_80041794 = L2_func_800421C8;
func_80041CB4 = L2_func_800426E8;
func_80041D78 = L2_func_800427AC;
func_80042E40 = L2_func_80043874;
L2_func_80043908 = func_80042ED4;
L2_func_80043AFC = func_800430C8;
func_800431E0 = L2_func_80043C14;
L2_func_80043C4C = func_80043218;
L2_func_80043E58 = func_80043424;
func_80044BF0 = L2_func_80045624;
func_80044CF4 = L2_func_80045728;
func_80044D8C = L2_func_800457C0;
func_80044E94 = L2_func_800458C8;
func_80045454 = L2_func_80045E88;
L2_func_80046098 = func_80045664;
L2_func_80046174 = func_80045740;
func_80045898 = L2_func_800462CC;
L2_func_80046638 = func_80045C04;
L2_func_800466D8 = func_80045CA4;
L2_func_800481FC = func_800477C8;
L2_func_8004857C = func_80047B48;
func_80047B58 = L2_func_8004858C;
func_80047BE4 = L2_func_80048618;
func_80048090 = L2_func_80048AC4;
L2_func_80048B04 = func_800480D0;
L2_func_80048F5C = func_800484D0;
L2_func_800497E4 = func_80048E6C;
func_80049308 = L2_func_80049C80;
L2_func_80049EB8 = func_80049540;
L2_func_8004A9F8 = func_8004A080;
func_8004A5BC = L2_func_8004AF34;
func_8004A600 = L2_func_8004AF78;
func_8004A624 = L2_func_8004AF9C;
func_8004A658 = L2_func_8004AFD0;
func_8004A690 = L2_func_8004B008;
func_8004A6A0 = L2_func_8004B018;
func_8004AAF4 = L2_func_8004B46C;
func_8004AB34 = L2_func_8004B4AC;
func_8004AB80 = L2_func_8004B4F8;
func_8004B300 = L2_func_8004BC78;
func_8004B334 = L2_func_8004BCAC;
func_8004B344 = L2_func_8004BCBC;
func_8004B35C = L2_func_8004BCD4;
L2_func_8004BDD8 = func_8004B460;
L2_func_8004BE84 = func_8004B50C;
func_8004B548 = L2_func_8004BEC0;
func_8004BBFC = L2_func_8004C530;
func_8004C2C0 = L2_func_8004CBF4;
func_8004C390 = L2_func_8004CCC4;
func_8004C584 = L2_func_8004CEB8;
func_8004C840 = L2_func_8004D174;
func_8004CB58 = L2_func_8004D48C;
L2_func_8004DC58 = func_8004D324;
func_8004D6A8 = L2_func_8004E0C4;
func_8004D794 = L2_func_8004E1B0;
func_8004DD30 = L2_func_8004E88C;
func_8004DF8C = L2_func_8004EAE8;
L2_func_8004EDDC = func_8004E280;
func_8004E65C = L2_func_8004F24C;
L2_func_8004F288 = func_8004E698;
L2_func_8004F314 = func_8004E724;
func_8004EDCC = L2_func_8004F9BC;
func_8004FBA0 = L2_func_80050790;
L2_func_80050AA4 = func_8004FEB4;
func_80050188 = L2_func_80050D78;
func_80050854 = L2_func_80051444;
func_80054238 = L2_func_80054E54;
func_8005456C = L2_func_80055188;
func_80054A7C = L2_func_80055698;
func_80054B1C = L2_func_80055738;
L2_func_8005590C = func_80054E58;
func_80054E84 = L2_func_80055938;
func_80054F6C = L2_func_80055A20;
func_800551D8 = L2_func_80055C8C;
func_800554C4 = L2_func_80055F78;
func_80055670 = L2_func_800560EC;
func_80057A64 = L2_func_80058570;
func_80058C90 = L2_func_8005979C;
func_80058F88 = L2_func_80059A94;
func_8005903C = L2_func_80059B48;
func_800590F8 = L2_func_80059C04;
func_80059160 = L2_func_80059C6C;
L2_func_80059EF0 = func_800593E4;
L2_func_8005AE6C = func_8005A360;
func_8005A3A4 = L2_func_8005AEB0;
L2_func_8005BA6C = func_8005AF60;
L2_func_8005C964 = func_8005BE58;
L2_func_8005C994 = func_8005BE88;
L2_func_8005C9C4 = func_8005BEB8;
L2_func_8005CB20 = func_8005C014;
func_8005CAB8 = L2_func_8005D5CC;
L2_func_8005D670 = func_8005CB5C;
func_8005CFBC = L2_func_8005DAD0;
func_8005D46C = L2_func_8005DF80;
func_8005E328 = L2_func_8005ECF4;
func_8005E3FC = L2_func_8005EDC8;
L2_func_8005EF48 = func_8005E57C;
L2_func_8005F374 = func_8005E9A8;
func_8005ED80 = L2_func_8005F74C;
L2_func_8005F8AC = func_8005EEE0;
L2_func_8005FBBC = func_8005F1F0;
func_8005F4F8 = L2_func_8005FEC4;
func_8005F680 = L2_func_8006004C;
func_8005FA44 = L2_func_80060410;
L2_func_80060594 = func_8005FBC8;
L2_func_8006066C = func_8005FCA0;
L2_func_800606F8 = func_8005FD2C;
L2_func_800609C8 = func_8005FFFC;
func_80060274 = L2_func_80060C40;
func_800604F8 = L2_func_80060EC4;
func_80060514 = L2_func_80060EE0;
L2_func_8006114C = func_8006074C;
L2_func_800616AC = func_80060CAC;
L2_func_800617EC = func_80060DEC;
func_80060E90 = L2_func_80061890;
func_80060FB8 = L2_func_800619B8;
func_80060FF0 = L2_func_800619F0;
func_80061594 = L2_func_80061F64;
L2_func_800622F4 = func_8006195C;
L2_func_80063630 = func_80062C98;
func_80062E38 = L2_func_800637D0;
func_800630BC = L2_func_80063A54;
L2_func_80063A98 = func_80063100;
func_800634B4 = L2_func_80063E4C;
L2_func_80063EFC = func_80063564;
func_800642A0 = L2_func_80064C38;
func_8006458C = L2_func_80064F24;
func_800648B8 = L2_func_80065250;
func_80065A64 = L2_func_800663FC;
func_80069A48 = L2_func_80069DD8;
L2_func_8006B2F0 = func_8006A89C;
L2_func_8006BB4C = func_8006A338;
func_8006B5B8 = L2_func_8006D29C;
func_8006C0D4 = L2_func_8006E97C;
func_8006C128 = L2_func_8006E9D0;
L2_func_80072648 = func_8006FDA0;
L2_func_800727D4 = func_8006FF2C;
func_80075CE0 = L2_func_80078588;
func_80075D30 = L2_func_800785D8;
func_8007629C = L2_func_80078B44;
func_800762E8 = L2_func_80078B90;
func_80076798 = L2_func_80079040;
func_800767C4 = L2_func_8007906C;
func_80076E04 = L2_func_800796AC;
func_80076E98 = L2_func_80079740;
func_80076EDC = L2_func_80079784;
func_80076FAC = L2_func_80079854;
func_800770D4 = L2_func_8007997C;
L2_func_8007D6E0 = func_80079FD8;
L2_func_8007E33C = func_8007ABDC;
L2_func_8007F098 = func_8007B950;
L2_func_8007F210 = func_8007BAC8;
L2_func_8007F36C = func_8007BC24;
L2_func_8007F520 = func_8007BDD8;
L2_func_8007FF68 = func_8007C820;
L2_func_800800D4 = func_8007C98C;
L2_func_80080238 = func_8007CAF0;
L2_func_800803A8 = func_8007CC60;
L2_func_80080518 = func_8007CDD0;
L2_func_80080660 = func_8007CF18;
L2_func_800807A0 = func_8007D058;
L2_func_80080930 = func_8007D1E8;
L2_func_80080AC8 = func_8007D380;
L2_func_80080C04 = func_8007D4BC;
L2_func_80080D44 = func_8007D5FC;
L2_func_80080E8C = func_8007D744;
L2_func_80081390 = func_8007DC48;
L2_func_80083044 = func_8007F8FC;
L2_func_80083064 = func_8007F91C;
L2_func_80083074 = func_8007F92C;
L2_func_80083280 = func_8007FB38;
L2_func_80083494 = func_8007FD4C;
L2_func_800855E0 = func_80081E98;
L2_func_800855F0 = func_80081EA8;
L2_func_80085600 = func_80081EB8;
L2_func_80085C3C = func_800824F4;
L2_func_80085D5C = func_80082614;
L2_func_80085E1C = func_800826D4;
L2_func_80085E4C = func_80082704;
L2_func_80085E7C = func_80082734;
L2_func_80085EDC = func_80082794;
L2_func_80085F1C = func_800827D4;
L2_func_80086EA8 = func_80083760;
L2_func_80086FAC = func_80083864;
L2_func_800870CC = func_80083984;
L2_func_8008710C = func_800839C4;
L2_func_80087120 = func_800839D8;
L2_func_80087134 = func_800839EC;
L2_func_800873A4 = func_80083C5C;
L2_func_80087530 = func_80083DE8;
L2_func_80087574 = func_80083E2C;
L2_func_8008836C = func_80084C24;
L2_func_80089774 = func_8008602C;
L2_func_80089AF4 = func_800863AC;
L2_func_80089BB4 = func_8008646C;
L2_func_80089D04 = func_800865BC;
L2_func_80089D44 = func_800865FC;
L2_func_80089D64 = func_8008661C;
L2_func_80089D94 = func_8008664C;
L2_func_80089F64 = func_8008681C;
L2_func_8008A014 = func_800868CC;
L2_func_8008A0C4 = func_8008697C;
L2_func_8008A724 = func_80086FDC;
L2_func_8008AAD0 = func_80087388;
L2_func_8008C0C0 = func_80088978;
L2_func_8008C48C = func_80088D44;
L2_func_8008C6CC = func_80088F84;
L2_func_8008C90C = func_800891C4;
L2_func_8008CBBC = func_80089474;
L2_func_8008CE0C = func_800896C4;
L2_func_8008D02C = func_800898E4;
L2_func_8008D33C = func_80089BF4;
L2_func_8008D66C = func_80089F24;
L2_func_8008D92C = func_8008A1E4;
L2_func_8008DB6C = func_8008A424;
L2_func_8008DCEC = func_8008A5A4;
L2_func_8008DF2C = func_8008A7E4;
L2_func_8008E09C = func_8008A954;
L2_func_8008E28C = func_8008AB44;
L2_func_8008E5CC = func_8008AE84;
L2_func_8008E7EC = func_8008B0A4;
L2_func_8008EAFC = func_8008B3B4;
L2_func_8008ECEC = func_8008B5A4;
L2_func_8008EEEC = func_8008B7A4;
L2_func_8008F21C = func_8008BAD4;
L2_func_8008F49C = func_8008BD54;
L2_func_8008F74C = func_8008C004;
L2_func_8008FCDC = func_8008C594;
L2_func_8008FDAC = func_8008C664;
L2_func_8008FF2C = func_8008C7E4;
L2_func_8008FFCC = func_8008C884;
L2_func_8009003C = func_8008C8F4;
L2_func_800900AC = func_8008C964;
L2_func_800912A4 = func_8008DACC;
D_1F8003D4 = 0x1F8003D4;
D_1F8003D8 = 0x1F8003D8;
D_1F8003DC = 0x1F8003DC;
L1_D_800AB540_b = L1_D_800AB540;
L1_D_800AB540_c = L1_D_800AB540;
L1_D_8009CE24 = L1_D_8009CE20 + 4;
