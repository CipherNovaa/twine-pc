/* Generated by tools/port_level.py: LEVEL01 names (L1_ prefix) bound to level05's symbols. */
L1_AddPrim = func_8008DD70;
L1_ApplyBonusCheats = func_8002E070;
L1_ApplyMatrix = func_80090A50;
L1_ApplyMatrixLV = func_8007ED40;
L1_ApplyMatrixSV = func_80092B44;
L1_Args_GetFlag115 = func_8002E218;
L1_CALLOC3_OBJ_54 = func_8008FF34;
func_80050008 = L1_Camera_ResetZoom;
func_8002C31C = L1_CdBin_Disable;
func_8002C360 = L1_CdBin_Enable;
func_8002C47C = L1_CdBin_SetLevel;
L1_CdInit = func_8008A038;
L1_CdSearchFile = func_80087B9C;
L1_ChangeClearPAD = func_80097268;
L1_ChangeClearRCnt = func_80097278;
func_8002DCE8 = L1_Cheat_CheckCodes;
L1_Cheat_DoAction = func_8002DA5C;
L1_Cheat_ResetCodes = func_8002E1C0;
L1_CloseEvent = func_80085A64;
L1_D_80082604 = func_80086C30;
L1_D_80095808 = D_80099E34;
L1_D_8009C180 = D_800A07AC;
L1_D_8009C184 = D_800A07B0;
L1_D_8009C1EC = D_800A0818;
L1_D_8009C1ED = D_800A0819;
L1_D_8009C1EE = D_800A081A;
L1_D_8009C1F0 = D_800A081C;
L1_D_8009C1F4 = D_800A0820;
L1_D_8009C1F8 = D_800A0824;
L1_D_8009C200 = D_800A082C;
L1_D_8009C204 = D_800A0830;
L1_D_8009C208 = D_800A0834;
L1_D_8009C20A = D_800A0836;
L1_D_8009C20C = D_800A0838;
L1_D_8009CA56 = D_800A1082;
L1_D_8009CA58 = D_800A1084;
L1_D_8009CA59 = D_800A1085;
L1_D_8009CA5A = D_800A1086;
L1_D_8009CA5C = D_800A1088;
L1_D_8009CA5E = D_800A108A;
L1_D_8009CA60 = D_800A108C;
L1_D_8009CA64 = D_800A1090;
L1_D_8009CA68 = D_800A1094;
L1_D_8009CA70 = D_800A109C;
L1_D_8009CA74 = D_800A10A0;
L1_D_8009CA78 = D_800A10A4;
L1_D_8009CA7C = D_800A10A8;
L1_D_8009CA80 = D_800A10AC;
L1_D_8009CA84 = D_800A10B0;
L1_D_8009CA8C = D_800A10B8;
L1_D_8009CA90 = D_800A10BC;
L1_D_8009CA94 = D_800A10C0;
L1_D_8009CA98 = D_800A10C4;
L1_D_8009CA9C = D_800A10C8;
L1_D_8009CAA0 = D_800A10CC;
L1_D_8009CAA4 = D_800A10D0;
L1_D_8009CAA8 = D_800A10D4;
L1_D_8009CAAC = D_800A10D8;
L1_D_8009CABD = D_800A10E9;
L1_D_8009CABE = D_800A10EA;
L1_D_8009CABF = D_800A10EB;
L1_D_8009CAC0 = D_800A10EC;
L1_D_8009CAC4 = D_800A10F0;
L1_D_8009CACC = D_800A10F8;
L1_D_8009CAD0 = D_800A10FC;
L1_D_8009CD00 = D_800A132C;
L1_D_8009CD30 = D_800A1360;
L1_D_8009CD3C = D_800A136C;
L1_D_8009CD4C = D_800A137C;
L1_D_8009CD50 = D_800A1380;
L1_D_8009CD54 = D_800A1384;
L1_D_8009CD58 = D_800A1388;
L1_D_8009CD5C = D_800A138C;
L1_D_8009CD5E = D_800A138E;
L1_D_8009CD60 = D_800A1390;
L1_D_8009CD62 = D_800A1392;
L1_D_8009CD6C = D_800A139C;
L1_D_8009CD6E = D_800A139E;
L1_D_8009CD78 = D_800A13A8;
L1_D_8009CD80 = D_800A13B0;
L1_D_8009CD88 = D_800A13B8;
L1_D_8009CD8C = D_800A13BC;
L1_D_8009CD98 = D_800A13C8;
L1_D_8009CDA0 = D_800A13D0;
L1_D_8009CDA2 = D_800A13D2;
L1_D_8009CDA8 = D_800A13D8;
L1_D_8009CDD0 = D_800A1400;
L1_D_8009CDDC = D_800A140C;
L1_D_8009CDE4 = D_800A1414;
L1_D_8009CDE5 = D_800A1415;
L1_D_8009CDE6 = D_800A1416;
L1_D_8009CDE7 = D_800A1417;
L1_D_8009CDE8 = D_800A1418;
L1_D_8009CDEC = D_800A141C;
L1_D_8009CDF0 = D_800A1420;
L1_D_8009CE20 = D_800A1450;
L1_D_8009CE28 = D_800A1458;
L1_D_8009CE38 = D_800A1468;
L1_D_8009CE3C = D_800A146C;
L1_D_8009CE48 = D_800A1478;
L1_D_8009CEB0 = D_800A14E0;
L1_D_8009CEE0 = D_800A1510;
L1_D_8009CF10 = D_800A1540;
L1_D_8009CF14 = D_800A1544;
L1_D_8009CF2C = D_800A155C;
L1_D_8009CF30 = D_800A1560;
L1_D_8009CF34 = D_800A1564;
L1_D_8009CF48 = D_800A1578;
L1_D_8009CF4C = D_800A157C;
L1_D_8009CF50 = D_800A1580;
L1_D_8009CF54 = D_800A1584;
L1_D_8009CF68 = D_800A1594;
L1_D_8009CF6C = D_800A1598;
L1_D_8009CF70 = D_800A159C;
L1_D_8009CF74 = D_800A15A0;
L1_D_8009CF7C = D_800A15A8;
L1_D_8009CF80 = D_800A15AC;
L1_D_8009CF8C = D_800A15B8;
L1_D_8009CF90 = D_800A15BC;
L1_D_8009CF94 = D_800A15C0;
L1_D_8009CF98 = D_800A15C4;
L1_D_8009CF9C = D_800A15C8;
L1_D_8009CFA8 = D_800A15D4;
L1_D_8009CFB0 = D_800A15DC;
L1_D_8009CFB4 = D_800A15E0;
L1_D_8009CFBB = D_800A15E7;
L1_D_8009CFBE = D_800A15EA;
L1_D_8009CFC0 = D_800A15EC;
L1_D_8009CFC4 = D_800A15F0;
L1_D_8009CFC8 = D_800A15F4;
L1_D_8009CFCC = D_800A15F8;
L1_D_8009CFE4 = D_800A1610;
L1_D_8009CFE8 = D_800A1614;
L1_D_8009CFEC = D_800A1618;
L1_D_8009CFF0 = D_800A161C;
L1_D_8009CFF6 = D_800A1622;
L1_D_8009CFF8 = D_800A1624;
L1_D_8009CFFC = D_800A1628;
L1_D_8009D000 = D_800A162C;
L1_D_8009D002 = D_800A162E;
L1_D_8009D004 = D_800A1630;
L1_D_8009D008 = D_800A1634;
L1_D_8009D00C = D_800A1638;
L1_D_8009D00E = D_800A163A;
L1_D_8009D010 = D_800A163C;
L1_D_8009D014 = D_800A1640;
L1_D_8009D018 = D_800A1644;
L1_D_8009D01A = D_800A1646;
L1_D_8009D020 = D_800A164C;
L1_D_8009D038 = D_800A1664;
L1_D_8009D03C = D_800A1668;
L1_D_8009D040 = D_800A166C;
L1_D_8009D084 = D_800A16B0;
L1_D_8009D088 = D_800A16B4;
L1_D_8009D09C = D_800A16C8;
L1_D_8009D0FC = D_800A1728;
L1_D_8009D104 = D_800A1730;
L1_D_8009D106 = D_800A1732;
L1_D_8009D108 = D_800A1734;
L1_D_8009D10A = D_800A1736;
L1_D_8009D10C = D_800A1738;
L1_D_8009D124 = D_800A1750;
L1_D_8009D130 = D_800A175C;
L1_D_8009D26C = D_800A189C;
L1_D_8009D280 = D_800A18D4;
L1_D_8009D2A8 = D_800A18A0;
L1_D_8009D368 = D_800A1A60;
L1_D_8009D374 = D_800A1A6C;
L1_D_8009D384 = D_800A1A7C;
L1_D_8009D394 = D_800A1A8C;
L1_D_8009D3A4 = D_800A1A9C;
L1_D_8009D3A8 = D_800A1AA0;
L1_D_8009D3AC = D_800A1AA4;
L1_D_8009D3B0 = D_800A1AA8;
L1_D_8009D3BC = D_800A1AB4;
L1_D_8009D3F0 = D_800A1AE8;
L1_D_8009D3F4 = D_800A1AEC;
L1_D_8009D3F8 = D_800A1AF0;
L1_D_8009D3FC = D_800A1AF4;
L1_D_8009D444 = D_800A1B3C;
L1_D_8009D5A8 = D_800A1DBC;
L1_D_8009D5AC = D_800A1DC0;
L1_D_8009D5F8 = D_800A1DFC;
L1_D_8009D5FC = D_800A1E00;
L1_D_8009D600 = D_800A1E04;
L1_D_8009D610 = D_800A1E14;
L1_D_8009D620 = D_800A1E24;
L1_D_8009D660 = D_800A1E64;
L1_D_8009D7A4 = D_800A1FA8;
L1_D_8009D7A8 = D_800A1FAC;
L1_D_8009D8B8 = D_800A20BC;
L1_D_8009D8D4 = D_800A20D8;
L1_D_8009D8E4 = D_800A20E0;
L1_D_8009D8E8 = D_800A20E4;
L1_D_8009D8F0 = D_800A20EC;
L1_D_8009D8F4 = D_800A20F0;
L1_D_8009D8F8 = D_800A20F4;
L1_D_8009D8FC = D_800A20F8;
L1_D_8009D900 = D_800A20FC;
L1_D_8009D904 = D_800A2100;
L1_D_8009D90C = D_800A2108;
L1_D_8009D910 = D_800A210C;
L1_D_8009D914 = D_800A2110;
L1_D_8009D918 = D_800A2114;
L1_D_8009D91C = D_800A2118;
L1_D_8009D920 = D_800A211C;
L1_D_8009D924 = D_800A2120;
L1_D_8009D928 = D_800A2124;
L1_D_8009DB50 = D_800A2338;
L1_D_8009E410 = D_800A3414;
L1_D_8009E480 = D_800A33EC;
L1_D_8009E490 = D_800A33F0;
L1_D_8009E9B4 = D_800A381C;
L1_D_8009E9B8 = D_800A3820;
L1_D_8009E9BC = D_800A3824;
L1_D_8009E9C0 = D_800A3828;
L1_D_8009E9C4 = D_800A382C;
L1_D_8009E9D8 = D_800A3840;
L1_D_8009EADC = D_800A3A38;
L1_D_8009EB5C = D_800A3AB8;
L1_D_8009EB7C = D_800A3AD8;
L1_D_8009EB88 = D_800A3AE4;
L1_D_8009EB8C = D_800A3AE8;
L1_D_8009EE0C = D_800A3D68;
L1_D_8009EE3D = D_800A3D99;
L1_D_8009EE8C = D_800A3DE8;
L1_D_8009EEC4 = D_800A3E20;
L1_D_8009EEC8 = D_800A3E24;
L1_D_8009EED0 = D_800A3E2C;
L1_D_8009EED4 = D_800A3E30;
L1_D_8009EED8 = D_800A3E34;
L1_D_8009EEDC = D_800A3E38;
L1_D_8009EEF0 = D_800A3E50;
L1_D_8009EEF4 = D_800A3E54;
L1_D_8009EEF8 = D_800A3E58;
L1_D_8009EF1C = D_800A3E7C;
L1_D_8009EF94 = D_800A3EF4;
L1_D_8009EF98 = D_800A3EF8;
L1_D_8009EF9C = D_800A3EFC;
L1_D_8009EFA0 = D_800A3F00;
L1_D_8009EFA4 = D_800A3F04;
L1_D_8009EFA8 = D_800A3F08;
L1_D_8009EFC8 = D_800A3F28;
L1_D_8009F008 = D_800A3F68;
L1_D_8009F00C = D_800A3F6C;
L1_D_8009F010 = D_800A3F70;
L1_D_8009F012 = D_800A3F72;
L1_D_8009F013 = D_800A3F73;
L1_D_8009F014 = D_800A3F74;
L1_D_8009F016 = D_800A3F76;
L1_D_8009F018 = D_800A3F78;
L1_D_8009F01C = D_800A3F7C;
L1_D_8009F07C = D_800A3FDC;
L1_D_8009F084 = D_800A3FE4;
L1_D_8009F090 = D_800A3FF0;
L1_D_8009F09C = D_800A3FFC;
L1_D_8009F0BC = D_800A401C;
L1_D_8009F0D0 = D_800A4030;
L1_D_8009F0E4 = D_800A4044;
L1_D_8009F0E6 = D_800A4046;
L1_D_8009F10C = D_800A406C;
L1_D_8009F114 = D_800A4074;
L1_D_8009F118 = D_800A4078;
L1_D_8009F11C = D_800A407C;
L1_D_8009F120 = D_800A4080;
L1_D_8009F124 = D_800A4084;
L1_D_8009F128 = D_800A4088;
L1_D_8009F12C = D_800A408C;
L1_D_8009F130 = D_800A4090;
L1_D_8009F134 = D_800A4094;
L1_D_8009F138 = D_800A4098;
L1_D_8009F13C = D_800A409C;
L1_D_8009F140 = D_800A40A0;
L1_D_8009F144 = D_800A40A4;
L1_D_8009F148 = D_800A40A8;
L1_D_8009F14C = D_800A40AC;
L1_D_8009F150 = D_800A40B0;
L1_D_8009F160 = D_800A40C0;
L1_D_8009F170 = D_800A40D0;
L1_D_8009F178 = D_800A40D8;
L1_D_8009F17C = D_800A40DC;
L1_D_8009F18C = D_800A40EC;
L1_D_8009F190 = D_800A40F0;
L1_D_8009F194 = D_800A40F4;
L1_D_8009F198 = D_800A40F8;
L1_D_8009F1B0 = D_800A4110;
L1_D_8009F230 = D_800A4190;
L1_D_8009F234 = D_800A4194;
L1_D_8009F248 = D_800A41A8;
L1_D_8009F24C = D_800A41AC;
L1_D_8009F250 = D_800A41B0;
L1_D_8009F254 = D_800A41B4;
L1_D_8009F2B8 = D_800A4218;
L1_D_8009F2BA = D_800A421A;
L1_D_8009F2BC = D_800A421C;
L1_D_8009F2E8 = D_800A4248;
L1_D_8009F2F4 = D_800A4254;
L1_D_800A0340 = D_800A52A0;
L1_D_800A0344 = D_800A52A4;
L1_D_800A0348 = D_800A52A8;
L1_D_800A034C = D_800A52AC;
L1_D_800A0350 = D_800A52B0;
L1_D_800A0370 = D_800A52D0;
L1_D_800A4370 = D_800A92D0;
L1_D_800A4374 = D_800A92D4;
L1_D_800A4378 = D_800A92D8;
L1_D_800A437C = D_800A92DC;
L1_D_800A4380 = D_800A92E0;
L1_D_800A4382 = D_800A92E2;
L1_D_800A4384 = D_800A92E4;
L1_D_800A4390 = D_800A92F0;
L1_D_800A4394 = D_800A92F4;
L1_D_800A43B0 = D_800A9310;
L1_D_800A43C8 = D_800A9328;
L1_D_800A43CC = D_800A932C;
L1_D_800A43D0 = D_800A9330;
L1_D_800A43D4 = D_800A9334;
L1_D_800A43D8 = D_800A9338;
L1_D_800A43DC = D_800A933C;
L1_D_800A43E0 = D_800A9340;
L1_D_800A43E4 = D_800A9344;
L1_D_800A43E8 = D_800A9348;
L1_D_800A43EC = D_800A934C;
L1_D_800A43F0 = D_800A9350;
L1_D_800A43F4 = D_800A9354;
L1_D_800A43F8 = D_800A9358;
L1_D_800A43FC = D_800A935C;
L1_D_800A4400 = D_800A9360;
L1_D_800A4404 = D_800A9364;
L1_D_800A4408 = D_800A9368;
L1_D_800A440C = D_800A936C;
L1_D_800A4410 = D_800A9370;
L1_D_800A4414 = D_800A9374;
L1_D_800A4418 = D_800A9378;
L1_D_800A441C = D_800A937C;
L1_D_800A4420 = D_800A9380;
L1_D_800A4428 = D_800A9388;
L1_D_800A442C = D_800A938C;
L1_D_800A4430 = D_800A9390;
L1_D_800A4440 = D_800A93A0;
L1_D_800A4450 = D_800A93B0;
L1_D_800A4460 = D_800A93C0;
L1_D_800A446C = D_800A93CC;
L1_D_800A4470 = D_800A93D0;
L1_D_800A4474 = D_800A93D4;
L1_D_800A4478 = D_800A93D8;
L1_D_800A447C = D_800A93DC;
L1_D_800A45D0 = D_800A9530;
L1_D_800A45D4 = D_800A9534;
L1_D_800A45D8 = D_800A9538;
L1_D_800A4EA0 = D_800A9E00;
L1_D_800A4FD8 = D_800A9F38;
L1_D_800A4FDC = D_800A9F3C;
L1_D_800A4FF0 = D_800A9F50;
L1_D_800A5000 = D_800A9F60;
L1_D_800A5010 = D_800A9F70;
L1_D_800A56A0 = D_800AA600;
L1_D_800A5834 = D_800AA794;
L1_D_800A59D0 = D_800AA930;
L1_D_800A59D4 = D_800AA934;
L1_D_800A59D8 = D_800AA938;
L1_D_800A59DC = D_800AA93C;
L1_D_800A59E0 = D_800AA940;
L1_D_800A5B60 = D_800AAAC0;
L1_D_800A5B6C = D_800AAACC;
L1_D_800A5B90 = D_800AAAF0;
L1_D_800A5BA8 = D_800AAB08;
L1_D_800A5CB0 = D_800AAC10;
L1_D_800A5CB4 = D_800AAC14;
L1_D_800A5CB8 = D_800AAC18;
L1_D_800A5CBC = D_800AAC1C;
L1_D_800A5CC0 = D_800AAC20;
L1_D_800A5CC8 = D_800AAC28;
L1_D_800A5CCC = D_800AAC2C;
L1_D_800A5CD0 = D_800AAC30;
L1_D_800A5CD4 = D_800AAC34;
L1_D_800A5CD8 = D_800AAC38;
L1_D_800A5CDC = D_800AAC3C;
L1_D_800A5CE0 = D_800AAC40;
L1_D_800A5CE4 = D_800AAC44;
L1_D_800A5CE8 = D_800AAC48;
L1_D_800A5CEC = D_800AAC4C;
L1_D_800A5CF0 = D_800AAC50;
L1_D_800A5D00 = D_800AAC60;
L1_D_800A5D04 = D_800AAC64;
L1_D_800A5D08 = D_800AAC68;
L1_D_800A5D18 = D_800AAC78;
L1_D_800A5D1C = D_800AAC7C;
L1_D_800A5D20 = D_800AAC80;
L1_D_800A5D24 = D_800AAC84;
L1_D_800A5D28 = D_800AAC88;
L1_D_800A5D2C = D_800AAC8C;
L1_D_800A5D34 = D_800AAC94;
L1_D_800A5D44 = D_800AACA4;
L1_D_800A5D48 = D_800AACA8;
L1_D_800A5D4C = D_800AACAC;
L1_D_800A5D7A = D_800AACDA;
L1_D_800A5D7C = D_800AACDC;
L1_D_800A5D80 = D_800AACE0;
L1_D_800A5D98 = D_800AACF8;
L1_D_800A5D9C = D_800AACFC;
L1_D_800A5DA0 = D_800AAD00;
L1_D_800A5DA4 = D_800AAD04;
L1_D_800A5DA8 = D_800AAD08;
L1_D_800A5DAC = D_800AAD0C;
L1_D_800A5DB0 = D_800AAD10;
L1_D_800A5DB4 = D_800AAD14;
L1_D_800A5DB5 = D_800AAD15;
L1_D_800A5DBC = D_800AAD1C;
L1_D_800A5E3C = D_800AAD9C;
L1_D_800A5E5C = D_800AADBC;
L1_D_800A5EA0 = D_800AAE00;
L1_D_800A5EDC = D_800AAE3C;
L1_D_800A5F5C = D_800AAEBC;
L1_D_800A5FDC = D_800AAF3C;
L1_D_800A605C = D_800AAFBC;
L1_D_800A6060 = D_800AAFC0;
L1_D_800A6064 = D_800AAFC4;
L1_D_800A6068 = D_800AAFC8;
L1_D_800A606C = D_800AAFCC;
L1_D_800A6070 = D_800AAFD0;
L1_D_800A6074 = D_800AAFD4;
L1_D_800A6075 = D_800AAFD5;
L1_D_800A6078 = D_800AAFD8;
L1_D_800A6090 = D_800AAFF0;
L1_D_800A6094 = D_800AAFF4;
L1_D_800A6098 = D_800AAFF8;
L1_D_800A609C = D_800AAFFC;
L1_D_800A60A0 = D_800AB000;
L1_D_800A60B0 = D_800AB010;
L1_D_800A60D0 = D_800AB030;
L1_D_800A60D4 = D_800AB034;
L1_D_800A60E0 = D_800AB040;
L1_D_800A60E4 = D_800AB044;
L1_D_800A6104 = D_800AB064;
L1_D_800A6110 = D_800AB070;
L1_D_800A6114 = D_800AB074;
L1_D_800A6118 = D_800AB078;
L1_D_800A611C = D_800AB07C;
L1_D_800A6120 = D_800AB080;
L1_D_800A6140 = D_800AB0A0;
L1_D_800A6170 = D_800AB0D0;
L1_D_800A6174 = D_800AB0D4;
L1_D_800A6178 = D_800AB0D8;
L1_D_800A6180 = D_800AB0E0;
L1_D_800A6198 = D_800AB0F8;
L1_D_800A62A0 = D_800AB200;
L1_D_800A66A0 = D_800AB600;
L1_D_800A6EB0 = D_800ABE10;
L1_D_800A6ED0 = D_800ABE30;
L1_D_800A6EF8 = D_800ABE58;
L1_D_800A6F00 = D_800ABE60;
L1_D_800A6F1C = D_800ABE7C;
L1_D_800A6F34 = D_800ABE94;
L1_D_800A6F4C = D_800ABEAC;
L1_D_800A7048 = D_800ABFA8;
L1_D_800A7060 = D_800ABFC0;
L1_D_800A70A0 = D_800AC000;
L1_D_800A70C8 = D_800AC028;
L1_D_800A70D4 = D_800AC034;
L1_D_800A70F8 = D_800AC058;
L1_D_800A7190 = D_800AC0F0;
L1_D_800A71EC = D_800AC14C;
L1_D_800A71F0 = D_800AC150;
L1_D_800A71F4 = D_800AC154;
L1_D_800A71F8 = D_800AC158;
L1_D_800A7214 = D_800AC174;
L1_D_800A7260 = D_800AC1C0;
L1_D_800A7290 = D_800AC1F0;
L1_D_800A72E8 = D_800AC248;
L1_D_800A7300 = D_800AC260;
L1_D_800A7310 = D_800AC270;
L1_D_800A7320 = D_800AC280;
L1_D_800A7324 = D_800AC284;
L1_D_800A7330 = D_800AC290;
L1_D_800A7344 = D_800AC2A4;
L1_D_800A735C = D_800AC2BC;
L1_D_800A7474 = D_800AC3D4;
L1_D_800A747C = D_800AC3DC;
L1_D_800A7498 = D_800AC3F8;
L1_D_800A74D4 = D_800AC434;
L1_D_800A74E0 = D_800AC440;
L1_D_800A7510 = D_800AC470;
L1_D_800A75D0 = D_800AC530;
L1_D_800A7678 = D_800AC5D8;
L1_D_800A76A0 = D_800AC600;
L1_D_800A76E4 = D_800AC644;
L1_D_800A76F8 = D_800AC658;
L1_D_800A770C = D_800AC66C;
L1_D_800A7714 = D_800AC674;
L1_D_800A7728 = D_800AC688;
L1_D_800A773C = D_800AC69C;
L1_D_800A7750 = D_800AC6B0;
L1_D_800A775C = D_800AC6BC;
L1_D_800A7778 = D_800AC6D8;
L1_D_800A7784 = D_800AC6E4;
L1_D_800A7788 = D_800AC6E8;
L1_D_800A77A0 = D_800AC700;
L1_D_800A77B4 = D_800AC714;
L1_D_800A77CC = D_800AC72C;
L1_D_800A79F0 = D_800AC950;
L1_D_800A7A0C = D_800AC96C;
L1_D_800A7A24 = D_800AC984;
L1_D_800A7A30 = D_800AC990;
L1_D_800A7D44 = D_800ACCDC;
L1_D_800A7D64 = D_800ACD30;
L1_D_800A7D74 = D_800ACD54;
L1_D_800A7D90 = D_800ACD70;
L1_D_800A7DC0 = D_800ACDA0;
L1_D_800A7DE8 = D_800ACDC8;
L1_D_800A7DF4 = D_800ACDD4;
L1_D_800A7E14 = D_800ACDF4;
L1_D_800A7EFC = D_800ACEDC;
L1_D_800A7FF8 = D_800ACFD8;
L1_D_800A8000 = D_800ACFE0;
L1_D_800A80A4 = D_800AD084;
L1_D_800A80B0 = D_800AD090;
L1_D_800A80BC = D_800AD09C;
L1_D_800A80C8 = D_800AD0A8;
L1_D_800A81F8 = D_800AD1D8;
L1_D_800A8210 = D_800AD1F0;
L1_D_800A8224 = D_800AD204;
L1_D_800A8238 = D_800AD218;
L1_D_800A824C = D_800AD22C;
L1_D_800A8260 = D_800AD240;
L1_D_800A8274 = D_800AD254;
L1_D_800A8280 = D_800AD260;
L1_D_800A828C = D_800AD26C;
L1_D_800A82B4 = D_800AD294;
L1_D_800A82DC = D_800AD2BC;
L1_D_800A8304 = D_800AD2E4;
L1_D_800A8308 = D_800AD2E8;
L1_D_800A8310 = D_800AD2F0;
L1_D_800A8318 = D_800AD2F8;
L1_D_800A8320 = D_800AD300;
L1_D_800A832C = D_800AD30C;
L1_D_800A8340 = D_800AD320;
L1_D_800A8370 = D_800AD350;
L1_D_800A8390 = D_800AD370;
L1_D_800A83B0 = D_800AD390;
L1_D_800A83BC = D_800AD39C;
L1_D_800A83C8 = D_800AD3A8;
L1_D_800A83D4 = D_800AD3B4;
L1_D_800A83E0 = D_800AD3C0;
L1_D_800A83E8 = D_800AD3C8;
L1_D_800A83F0 = D_800AD3D0;
L1_D_800A8400 = D_800AD3E0;
L1_D_800A8410 = D_800AD3F0;
L1_D_800A8418 = D_800AD3F8;
L1_D_800A8420 = D_800AD400;
L1_D_800A842C = D_800AD40C;
L1_D_800A8444 = D_800AD424;
L1_D_800A844C = D_800AD42C;
L1_D_800A8458 = D_800AD438;
L1_D_800A8460 = D_800AD440;
L1_D_800A8464 = D_800AD444;
L1_D_800A8468 = D_800AD448;
L1_D_800A8478 = D_800AD458;
L1_D_800A8484 = D_800AD464;
L1_D_800A8490 = D_800AD470;
L1_D_800A849C = D_800AD47C;
L1_D_800A84A8 = D_800AD488;
L1_D_800A84B4 = D_800AD494;
L1_D_800A84B8 = D_800AD498;
L1_D_800A84D0 = D_800AD4B0;
L1_D_800A84D8 = D_800AD4B8;
L1_D_800A84E4 = D_800AD4C4;
L1_D_800A84F0 = D_800AD4D0;
L1_D_800A84FC = D_800AD4DC;
L1_D_800A850C = D_800AD4EC;
L1_D_800A851C = D_800AD4FC;
L1_D_800A8528 = D_800AD508;
L1_D_800A8534 = D_800AD514;
L1_D_800A8544 = D_800AD524;
L1_D_800A857C = D_800AD55C;
L1_D_800A85C4 = D_800AD5A4;
L1_D_800A85D4 = D_800AD5B4;
L1_D_800A85F8 = D_800AD5D8;
L1_D_800A86C0 = D_800AD6D0;
L1_D_800A86CC = D_800AD6DC;
L1_D_800A8764 = D_800AD768;
L1_D_800A87EC = D_800AD7F0;
L1_D_800A880C = D_800AD810;
L1_D_800A8820 = D_800AD824;
L1_D_800A8858 = D_800AD85C;
L1_D_800A887C = D_800AD880;
L1_D_800A8884 = D_800AD888;
L1_D_800A8894 = D_800AD898;
L1_D_800A88A4 = D_800AD8A8;
L1_D_800A88D0 = D_800AD8D4;
L1_D_800A89A4 = D_800AD988;
L1_D_800A89F0 = D_800AD9D4;
L1_D_800A8A2C = D_800ADA10;
L1_D_800A8AA8 = D_800ADA8C;
L1_D_800A8C08 = D_800ADBEC;
L1_D_800A8C28 = D_800ADC0C;
L1_D_800A8C48 = D_800ADC2C;
L1_D_800A8D14 = D_800ADCF8;
L1_D_800A8D44 = D_800ADD18;
L1_D_800A8D58 = D_800ADD2C;
L1_D_800A8F94 = D_800ADE88;
L1_D_800A8FAC = D_800ADEA0;
L1_D_800A9390 = D_800AE284;
L1_D_800A9488 = D_800AE340;
L1_D_800A9498 = D_800AE350;
L1_D_800A9794 = D_800AE830;
L1_D_800A97BC = D_800AE858;
L1_D_800A98C8 = D_800AE9B0;
L1_D_800A99D0 = D_800AEADC;
L1_D_800A99EC = D_800AEAF8;
L1_D_800A9A08 = D_800AEB14;
L1_D_800A9A60 = D_800AEB6C;
L1_D_800A9A84 = D_800AEB90;
L1_D_800A9AA8 = D_800AEBB4;
L1_D_800A9B6C = D_800AEC78;
L1_D_800A9B78 = D_800AEC84;
L1_D_800A9BE8 = D_800AECF4;
L1_D_800A9C08 = D_800AED14;
L1_D_800A9C78 = D_800AED84;
L1_D_800A9C8C = D_800AED98;
L1_D_800A9CA0 = D_800AEDAC;
L1_D_800A9CAC = D_800AEDB8;
L1_D_800A9CC0 = D_800AEDCC;
L1_D_800A9CC4 = D_800AEDD0;
L1_D_800A9CDC = D_800AEDE8;
L1_D_800A9D00 = D_800AEE0C;
L1_D_800A9D18 = D_800AEE24;
L1_D_800A9D30 = D_800AEE3C;
L1_D_800A9D44 = D_800AEE50;
L1_D_800A9D78 = D_800AEE84;
L1_D_800A9D90 = D_800AEE9C;
L1_D_800A9EB0 = D_800AEFBC;
L1_D_800A9EC8 = D_800AEFD4;
L1_D_800A9EE0 = D_800AEFEC;
L1_D_800A9F10 = D_800AF01C;
L1_D_800A9F2C = D_800AF038;
L1_D_800A9F44 = D_800AF050;
L1_D_800A9F60 = D_800AF06C;
L1_D_800A9F80 = D_800AF08C;
L1_D_800A9F8C = D_800AF098;
L1_D_800A9F9C = D_800AF0A8;
L1_D_800A9FC8 = D_800AF0D4;
L1_D_800A9FD0 = D_800AF0DC;
L1_D_800AA000 = D_800AF10C;
L1_D_800AA024 = D_800AF130;
L1_D_800AA044 = D_800AF150;
L1_D_800AA058 = D_800AF164;
L1_D_800AA07C = D_800AF188;
L1_D_800AA09C = D_800AF1A8;
L1_D_800AA0B8 = D_800AF1C4;
L1_D_800AA0BC = D_800AF1C8;
L1_D_800AA0BE = D_800AF1CA;
L1_D_800AA0C0 = D_800AF1CC;
L1_D_800AA0DC = D_800AF1E8;
L1_D_800AA110 = D_800AF21C;
L1_D_800AA154 = D_800AF260;
L1_D_800AA170 = D_800AF27C;
L1_D_800AA1B0 = D_800AF2BC;
L1_D_800AA1D0 = D_800AF2DC;
L1_D_800AA3C0 = D_800AF4CC;
L1_D_800AA3E8 = D_800AF4F4;
L1_D_800AA410 = D_800AF51C;
L1_D_800AA438 = D_800AF544;
L1_D_800AA444 = D_800AF550;
L1_D_800AA46C = D_800AF578;
L1_D_800AA494 = D_800AF5A0;
L1_D_800AA4C0 = D_800AF5CC;
L1_D_800AA4F0 = D_800AF5FC;
L1_D_800AA518 = D_800AF624;
L1_D_800AA580 = D_800AF68C;
L1_D_800AA590 = D_800AF69C;
L1_D_800AA5A0 = D_800AF6AC;
L1_D_800AA5B4 = D_800AF6C0;
L1_D_800AA70C = D_800AF818;
L1_D_800AA71C = D_800AF828;
L1_D_800AA738 = D_800AF844;
L1_D_800AA744 = D_800AF850;
L1_D_800AA760 = D_800AF86C;
L1_D_800AA774 = D_800AF880;
L1_D_800AA794 = D_800AF8A0;
L1_D_800AA79C = D_800AF8A8;
L1_D_800AA7A8 = D_800AF8B4;
L1_D_800AA7B0 = D_800AF8BC;
L1_D_800AA7C0 = D_800AF8CC;
L1_D_800AA800 = D_800AF90C;
L1_D_800AA80C = D_800AF918;
L1_D_800AA818 = D_800AF924;
L1_D_800AA830 = D_800AF93C;
L1_D_800AA84C = D_800AF958;
L1_D_800AA8A0 = D_800AF9AC;
L1_D_800AA8C8 = D_800AF9D4;
L1_D_800AA8E0 = D_800AF9EC;
L1_D_800AA8E8 = D_800AF9F4;
L1_D_800AA8F0 = D_800AF9FC;
L1_D_800AB540 = D_800B0650;
L1_D_800AB5E0 = D_800B06F0;
L1_D_800AB5E4 = D_800B06F4;
L1_D_800AB5E8 = D_800B06F8;
L1_D_800AB5EC = D_800B06FC;
L1_D_800AB5F0 = D_800B0700;
L1_D_800AB5F4 = D_800B0704;
L1_D_800AB5F8 = D_800B0708;
L1_D_800AB5FC = D_800B070C;
L1_D_800AB600 = D_800B0710;
L1_D_800AB604 = D_800B0714;
L1_D_800AB608 = D_800B0718;
L1_D_800AB60C = D_800B071C;
L1_D_800AB610 = D_800B0720;
L1_D_800AB614 = D_800B0724;
L1_D_800AB618 = D_800B0728;
L1_D_800AB744 = D_800B0854;
L1_D_800AB754 = D_800B0864;
L1_D_800AC284 = D_800B1394;
L1_D_800AC384 = D_800B1494;
L1_D_800AC38C = D_800B149C;
L1_D_800AC4C8 = D_800B15D8;
L1_D_800AC4D0 = D_800B15E0;
L1_D_800AC4D8 = D_800B15E8;
L1_D_800AC4DC = D_800B15EC;
L1_D_800AC4E0 = D_800B15F0;
L1_D_800AC4E4 = D_800B15F4;
L1_D_800AC4E8 = D_800B15F8;
L1_D_800AC4EC = D_800B15FC;
L1_D_800AC54C = D_800B165C;
L1_D_800AC550 = D_800B1660;
L1_D_800AE940 = D_800B3A50;
L1_D_800AE9B8 = D_800B3AC8;
L1_D_800AE9C0 = D_800B3AD0;
L1_D_800AEB1A = D_800B3C2A;
L1_D_800AEC38 = D_800B3D48;
L1_D_800AEDA0 = D_800B3EB0;
L1_D_800AEDA4 = D_800B3EB4;
L1_D_800AEDA8 = D_800B3EB8;
L1_D_800AEDAC = D_800B3EBC;
L1_D_800AEDB0 = D_800B3EC0;
L1_D_800AEDB4 = D_800B3EC4;
L1_D_800AEDB8 = D_800B3EC8;
L1_D_800AEDBC = D_800B3ECC;
L1_D_800AEDD4 = D_800B3EE4;
L1_D_800AEDD8 = D_800B3EE8;
L1_D_800AEDDC = D_800B3EEC;
L1_D_800AEDE0 = D_800B3EF0;
L1_D_800AEDE4 = D_800B3EF4;
L1_D_800AEDE8 = D_800B3EF8;
L1_D_800AEDEC = D_800B3EFC;
L1_D_800AEDF0 = D_800B3F00;
L1_D_800AEE10 = D_800B3F20;
L1_D_800AEE14 = D_800B3F24;
L1_D_800AF620 = D_800B4730;
L1_D_800AF624 = D_800B4734;
L1_D_800AF6A4 = D_800B47B4;
L1_D_800AF6A5 = D_800B47B5;
L1_D_800AF6A8 = D_800B47B8;
L1_D_800AFEA8 = D_800B4FB8;
L1_D_800AFEAC = D_800B4FBC;
L1_D_800AFEB0 = D_800B4FC0;
L1_D_800AFEB5 = D_800B4FC5;
L1_D_800AFEB6 = D_800B4FC6;
L1_D_800AFEB7 = D_800B4FC7;
L1_D_800AFEB8 = D_800B4FC8;
L1_D_800AFEB9 = D_800B4FC9;
L1_D_800AFEBC = D_800B4FCC;
L1_D_800AFEC0 = D_800B4FD0;
L1_D_800AFEC8 = D_800B4FD8;
L1_D_800AFF2C = D_800B503C;
L1_D_800AFF48 = D_800B5058;
L1_D_800AFF58 = D_800B5068;
L1_D_800AFF64 = D_800B5074;
L1_D_800AFF68 = D_800B5078;
L1_D_800AFF78 = D_800B5088;
L1_D_800AFF88 = D_800B5098;
L1_D_800AFF8C = D_800B509C;
L1_D_800AFFA4 = D_800B50B4;
L1_D_800AFFA8 = D_800B50B8;
L1_D_800AFFAC = D_800B50BC;
L1_D_800AFFC0 = D_800B50D0;
L1_D_800AFFC8 = D_800B50D8;
L1_D_800AFFCC = D_800B50DC;
L1_D_800B0014 = D_800B5124;
L1_D_800B0018 = D_800B5128;
L1_D_800B0064 = D_800B5174;
L1_D_800B0066 = D_800B5176;
L1_D_800B0068 = D_800B5178;
L1_D_800B0070 = D_800B5180;
L1_D_800B0084 = D_800B5194;
L1_D_800B008C = D_800B519C;
L1_D_800B0094 = D_800B51A4;
L1_D_800B00A0 = D_800B51B0;
L1_D_800B0108 = D_800B5218;
L1_D_800B05AC = D_800B5A54;
L1_D_800B05B0 = D_800B5A58;
L1_D_800B077C = D_800B5C24;
L1_D_800B0794 = D_800B5C3C;
L1_D_800B0798 = D_800B5C40;
L1_D_800B07A8 = D_800B5C50;
L1_D_800B07B0 = D_800B5C58;
L1_D_800B07B4 = D_800B5C5C;
L1_D_800B07B8 = D_800B5C60;
L1_D_800B07BC = D_800B5C64;
L1_D_800B07C4 = D_800B5C6C;
L1_D_800B0808 = D_800B5CB0;
L1_D_800B0848 = D_800B5CF0;
L1_D_800B0868 = D_800B5D10;
L1_D_800B086C = D_800B5D14;
L1_D_800B087C = D_800B5D24;
L1_D_800B0A94 = D_800B5F3C;
L1_D_800B0A98 = D_800B5F40;
L1_D_800B0AA0 = D_800B5F48;
L1_D_800B0AA4 = D_800B5F4C;
L1_D_800B0AA8 = D_800B5F50;
L1_D_800B0AB4 = D_800B5F5C;
L1_D_800B0AB8 = D_800B5F60;
L1_D_800B0AC0 = D_800B5F68;
L1_D_800B0ACC = D_800B5F74;
L1_D_800B0AD0 = D_800B5F78;
L1_D_800B0AD4 = D_800B5F7C;
L1_D_800B0AE0 = D_800B5F88;
L1_D_800B0AE8 = D_800B5F90;
L1_D_800B0AEC = D_800B5F94;
L1_D_800B0AFC = D_800B5FA4;
L1_D_800B0B10 = D_800B5FB8;
L1_D_800B0B14 = D_800B5FBC;
L1_D_800B0B54 = D_800B5FFC;
L1_D_800B0B58 = D_800B6000;
L1_D_800B0B64 = D_800B600C;
L1_D_800B0B68 = D_800B6010;
L1_D_800B0B6A = D_800B6012;
L1_D_800B0B6C = D_800B6014;
L1_D_800B0B70 = D_800B6018;
L1_D_800B0B72 = D_800B601A;
L1_D_800B0B78 = D_800B6020;
L1_D_800B0B80 = D_800B6028;
L1_D_800B0B84 = D_800B602C;
L1_D_800B0B88 = D_800B6030;
L1_D_800B0B8C = D_800B6034;
L1_D_800B0B9C = D_800B6044;
L1_D_800B0BA0 = D_800B6048;
L1_D_800B0BC0 = D_800B6068;
L1_D_800B0C10 = D_800B60B8;
L1_D_800B0C38 = D_800B60E0;
L1_D_800B0C5C = D_800B6104;
L1_D_800B0C60 = D_800B6108;
L1_D_800B0C64 = D_800B610C;
L1_D_800B0C68 = D_800B6110;
L1_D_800B0C74 = D_800B611C;
L1_D_800B0C84 = D_800B612C;
L1_D_800B0C8C = D_800B6134;
L1_D_800B0C9C = D_800B6144;
L1_D_800B0CA0 = D_800B6148;
L1_D_800B0CA4 = D_800B614C;
L1_D_800B0CA8 = D_800B6150;
L1_D_800B0CB0 = D_800B6158;
L1_D_800B0CC4 = D_800B616C;
L1_D_800B0D50 = D_800B61F8;
L1_D_800B0D94 = D_800B623C;
L1_D_800B0D9C = D_800B6244;
L1_D_800B0DA0 = D_800B6248;
L1_D_800B0DA4 = D_800B624C;
L1_D_800B0DA8 = D_800B6250;
L1_D_800B0DAC = D_800B6254;
L1_D_800B0DC0 = D_800B6268;
L1_D_800B0DD4 = D_800B627C;
L1_D_800B0DDC = D_800B6284;
L1_D_800B0DE4 = D_800B628C;
L1_D_800B0E34 = D_800B62DC;
L1_D_800B0E36 = D_800B62DE;
L1_D_800B0E40 = D_800B62E8;
L1_D_800B0E48 = D_800B62F0;
L1_D_800B0E54 = D_800B62FC;
L1_D_800B0E58 = D_800B6300;
L1_D_800B0E5E = D_800B6306;
L1_D_800B0E5F = D_800B6307;
L1_D_800B0E62 = D_800B630A;
L1_D_800B0E63 = D_800B630B;
L1_D_800B0E8C = D_800B6334;
L1_D_800B0EA0 = D_800B6348;
L1_D_800B0EFC = D_800B63A4;
L1_D_800B8EFC = D_800BE3A4;
L1_D_800B8F24 = D_800BE3CC;
L1_D_800B8F28 = D_800BE3D0;
L1_D_800B8F68 = D_800BE410;
L1_D_800B8F88 = D_800BE430;
L1_D_800B8FB0 = D_800BE458;
L1_D_800B8FB4 = D_800BE45C;
L1_D_800C1C54 = D_800CAFE0;
L1_D_800CA8F4 = D_800D7B64;
L1_D_800D28F4 = D_800DFB64;
L1_D_800D2AF8 = D_800DFD68;
L1_D_800D2AFC = D_800DFD6C;
L1_D_800D2BC4 = D_800DFE34;
L1_D_800D2BE8 = D_800DFE58;
L1_D_800D2BEC = D_800DFE5C;
L1_D_800D2BF0 = D_800DFE60;
L1_D_800D2D30 = D_800DFFA0;
L1_D_800D2E70 = D_800E00E0;
L1_D_800D2E74 = D_800E00E4;
L1_D_800D2E84 = D_800E00F4;
L1_D_800D2E90 = D_800E0100;
L1_D_800D2F48 = D_800E01B8;
L1_D_800D2F68 = D_800E01D8;
L1_D_800D2F8C = D_800E01FC;
L1_D_800D2F90 = D_800E0200;
L1_D_800D2F94 = D_800E0204;
L1_D_800D2FA4 = D_800E0214;
L1_D_800D2FA8 = D_800E0218;
L1_D_800D2FAC = D_800E021C;
L1_D_800D2FB0 = D_800E0220;
L1_D_800D2FC0 = D_800E0230;
L1_D_800D2FC4 = D_800E0234;
L1_D_800D2FF4 = D_800E0264;
L1_D_800D305C = D_800E02CC;
L1_D_800D3068 = D_800E02D8;
L1_D_800D308C = D_800E02FC;
L1_D_800D30C0 = D_800E0330;
L1_D_800D30D4 = D_800E0344;
L1_D_800D30D8 = D_800E0348;
L1_D_800D31B8 = D_800E0428;
L1_D_800D31C0 = D_800E0430;
L1_D_800D31D0 = D_800E0440;
L1_D_800D3238 = D_800E04A8;
L1_D_800D3288 = D_800E04F8;
L1_D_800D3FA8 = D_800E1218;
L1_D_800D3FAC = D_800E121C;
L1_D_800D3FB0 = D_800E1220;
L1_D_800D3FD4 = D_800E1244;
L1_D_800D3FD8 = D_800E1248;
L1_D_800D3FE0 = D_800E1250;
L1_D_800D3FE4 = D_800E1254;
L1_D_800D3FEC = D_800E125C;
L1_D_800D3FF0 = D_800E1260;
L1_D_800D4050 = D_800E12C0;
L1_D_800D4058 = D_800E12C8;
L1_D_800D4068 = D_800E12D8;
L1_D_800D406C = D_800E12DC;
L1_D_800D4070 = D_800E12E0;
L1_D_800D4074 = D_800E12E4;
L1_D_800D4080 = D_800E12F0;
L1_D_800D40D8 = D_800E1348;
L1_D_800D40F8 = D_800E1368;
L1_D_800D40FC = D_800E136C;
L1_D_800D4100 = D_800E1370;
L1_D_800D4104 = D_800E1374;
L1_D_800D4108 = D_800E1378;
L1_D_800D410C = D_800E137C;
L1_D_800D4110 = D_800E1380;
L1_D_800D4114 = D_800E1384;
L1_D_800D424C = D_800E14BC;
L1_D_800D4250 = D_800E14C0;
L1_D_800D4384 = D_800E1714;
L1_D_800D4385 = D_800E1715;
L1_D_800D4386 = D_800E1716;
L1_D_800D4387 = D_800E1717;
L1_D_800D4388 = D_800E1718;
L1_D_800D4389 = D_800E1719;
L1_D_800D438A = D_800E171A;
L1_D_800D438B = D_800E171B;
L1_D_800D438C = D_800E171C;
L1_D_800D438D = D_800E171D;
L1_D_800D438E = D_800E171E;
L1_D_800D438F = D_800E171F;
L1_D_800D4390 = D_800E1720;
L1_D_800D43A8 = D_800E1738;
L1_D_800D43AC = D_800E173C;
L1_D_800D43C0 = D_800E1750;
L1_D_800D43C4 = D_800E1754;
L1_D_800D43CC = D_800E175C;
L1_D_800D43D0 = D_800E1760;
L1_D_800D43E4 = D_800E1774;
L1_D_800D43F0 = D_800E1780;
L1_D_800D43F4 = D_800E1784;
L1_D_800D43F8 = D_800E1788;
L1_D_800D4400 = D_800E1790;
L1_D_800D4404 = D_800E1794;
L1_D_800D440C = D_800E179C;
L1_D_800D4410 = D_800E17A0;
L1_D_800D4414 = D_800E17A4;
L1_D_800D4424 = D_800E17B4;
L1_D_800D4440 = D_800E17D0;
L1_D_800D4444 = D_800E17D4;
L1_D_800D4450 = D_800E1804;
L1_D_800D4454 = D_800E1808;
L1_D_800D4458 = D_800E180C;
L1_D_800D445C = D_800E1810;
L1_D_800D4464 = D_800E1818;
L1_D_800D4468 = D_800E181C;
L1_D_800D446C = D_800E1820;
L1_D_800D4474 = D_800E182C;
L1_D_800D4484 = D_800E1844;
L1_D_800D4564 = D_800E1924;
L1_D_800D45C4 = D_800E1984;
L1_D_800D45F4 = D_800E19B4;
L1_D_800D4688 = D_800E1A48;
L1_D_800D46D8 = D_800E1A98;
L1_D_800D4958 = D_800E1D18;
L1_D_800D4984 = D_800E1D44;
L1_D_800D5DA4 = D_800E3164;
L1_D_800D5E80 = D_800E3240;
L1_D_800D5ED0 = D_800E3290;
L1_D_800D5ED8 = D_800E3298;
L1_D_800D5EF0 = D_800E32B0;
L1_D_800D5F40 = D_800E3300;
L1_D_800D5F48 = D_800E3308;
L1_D_800D74F8 = D_800E48B8;
L1_D_800D74FC = D_800E48BC;
L1_D_800D7500 = D_800E48C0;
L1_D_800D7550 = D_800E4910;
L1_D_800D7554 = D_800E4914;
L1_D_800D7588 = D_800E4948;
L1_D_800D77B8 = D_800E4B78;
L1_D_800D77E8 = D_800E4BA8;
L1_D_800D7838 = D_800E4BF8;
L1_D_800D7888 = D_800E4C48;
L1_D_800D78D8 = D_800E4C98;
L1_D_800D7930 = D_800E4CF0;
L1_D_800D7980 = D_800E4D40;
L1_D_800D79D0 = D_800E4D90;
L1_D_800D79D4 = D_800E4D94;
L1_D_800D7A1C = D_800E4DDC;
L1_D_800D7A20 = D_800E4DE0;
L1_D_800D7AB8 = D_800E4E78;
L1_D_800D7B08 = D_800E4EC8;
L1_D_800D7BE8 = D_800E4FA8;
L1_D_800D7BF0 = D_800E4FB0;
L1_D_800D7C24 = D_800E4FE4;
L1_D_800D7C64 = D_800E5024;
L1_D_800D7CB4 = D_800E5074;
L1_D_800D7CB8 = D_800E5078;
L1_D_800D7D08 = D_800E50C8;
L1_D_800D7DF8 = D_800E51B8;
L1_D_800D7DFC = D_800E51BC;
L1_D_800D7E9C = D_800E525C;
L1_D_800D7EEC = D_800E52AC;
L1_D_800D7FDC = D_800E539C;
L1_D_800D811C = D_800E54DC;
L1_D_800D8138 = D_800E54F8;
L1_D_800D8150 = D_800E5510;
L1_D_800D8154 = D_800E5514;
L1_D_800D861C = D_800E59DC;
L1_D_800D8620 = D_800E59E0;
L1_D_800D8624 = D_800E59E4;
L1_D_800D8674 = D_800E5A34;
L1_D_800D86C4 = D_800E5A84;
L1_D_800D86C8 = D_800E5A88;
L1_D_800D86E4 = D_800E5AA4;
L1_D_800D86E8 = D_800E5AA8;
L1_D_800D8BE8 = D_800E5FA8;
L1_D_800D8C7C = D_800E603C;
L1_D_800D8C94 = D_800E6054;
L1_D_800D8E74 = D_800E6234;
L1_D_800D8E8C = D_800E6258;
L1_D_800D8EA4 = D_800E627C;
L1_D_800D8EA8 = D_800E6280;
L1_D_800D8FF8 = D_800E6478;
L1_D_800D90C0 = D_800E6588;
L1_D_800D911C = D_800E65E4;
L1_D_800D91E4 = D_800E66AC;
L1_D_800D91E7 = D_800E66AF;
L1_D_800D91E8 = D_800E66B0;
L1_D_800D91F0 = D_800E66B8;
L1_D_800D91F8 = D_800E66C0;
L1_D_800D91FC = D_800E66C4;
L1_D_800D9200 = D_800E66C8;
L1_D_800D9208 = D_800E66D0;
L1_D_800D920C = D_800E66D4;
L1_D_800D9210 = D_800E66D8;
L1_D_800D9214 = D_800E66DC;
L1_D_800D9218 = D_800E66E0;
L1_D_800D9232 = D_800E66FA;
L1_D_800D9268 = D_800E6728;
L1_D_800D9278 = D_800E6738;
L1_D_800DA270 = D_800E7730;
L1_D_800DA5C0 = D_800E7A80;
L1_D_800DA5C4 = D_800E7A84;
L1_D_800DB884 = D_800E8D44;
L1_D_800DCB44 = D_800EAC84;
L1_D_800DCB4C = D_800EAC8C;
L1_D_800DD7F4 = D_800EB934;
L1_D_800DDC44 = D_800EB938;
L1_D_800DDC48 = D_800EB93C;
L1_D_800DDC4C = D_800EB940;
L1_D_800DDC50 = D_800EB944;
L1_D_800DDC54 = D_800EB948;
L1_D_800DDC58 = D_800EB94C;
L1_D_800DDC5C = D_800EB950;
L1_D_800DDC60 = D_800EB954;
L1_D_800DDC64 = D_800EB958;
L1_D_800DDC68 = D_800EB95C;
L1_D_800DDC6C = D_800EB960;
L1_D_800DDCC0 = D_800EB9B4;
L1_D_800DDCC4 = D_800EB9B8;
L1_D_800DDCC8 = D_800EB9BC;
L1_D_800DDCCC = D_800EB9C0;
L1_D_800DDD8C = D_800EBA80;
L1_D_800DDD90 = D_800EBA84;
L1_D_800DDD94 = D_800EBA88;
L1_D_800DDD98 = D_800EBA8C;
L1_D_800DDDA0 = D_800EBA94;
L1_D_800DDDA4 = D_800EBA98;
L1_D_800DDDA8 = D_800EBA9C;
L1_D_800DDDAC = D_800EBAA0;
L1_D_800DDDB0 = D_800EBAA4;
L1_D_800DDDB4 = D_800EBAA8;
L1_D_800DDDB8 = D_800EBAAC;
L1_D_800DDDBC = D_800EBAB0;
L1_D_800DDDCC = D_800EBAC0;
L1_D_800DDDDC = D_800EBAD0;
L1_D_800DDDEC = D_800EBAE0;
L1_D_800DDE04 = D_800EBAF8;
L1_D_800DDE08 = D_800EBAFC;
L1_D_800DDE10 = D_800EBB04;
L1_D_800DDE30 = D_800EBB24;
L1_D_800DDE34 = D_800EBB28;
L1_D_800DDEE0 = D_800EBBD4;
L1_D_800DDEE4 = D_800EBBD8;
L1_D_800DDEE8 = D_800EBBDC;
L1_D_800DDEEC = D_800EBBE0;
L1_D_800DDEF0 = D_800EBBE4;
L1_D_800DDF08 = D_800EBBFC;
L1_D_800DDF24 = D_800EBC18;
L1_D_800DDFEC = D_800EBCE0;
L1_D_800DE000 = D_800EBCF4;
L1_D_800DE004 = D_800EBCF8;
L1_D_800DE018 = D_800EBD0C;
L1_D_800DE0C4 = D_800EBDB8;
L1_D_800DE0C8 = D_800EBDBC;
L1_D_800DE0D4 = D_800EBDC8;
L1_D_800DE0D8 = D_800EBDCC;
L1_D_800DE0DC = D_800EBDD0;
L1_D_800DE0E0 = D_800EBDD4;
L1_D_800DE0E4 = D_800EBDD8;
L1_D_800DE0E8 = D_800EBDE0;
L1_D_800DE8E8 = D_800EC5E0;
L1_D_800DF0E8 = D_800ECDE0;
L1_D_800DF0EC = D_800ECDE4;
L1_D_800DF0F0 = D_800ECDE8;
L1_D_800DF0F8 = D_800ECDF0;
L1_D_800DF10C = D_800ECE04;
L1_D_800DF12C = D_800ECE24;
L1_D_800DF1F4 = D_800ECEEC;
L1_D_800DF200 = D_800ECEF8;
L1_D_800DF540 = D_800ED238;
L1_D_800DF5B8 = D_800ED2B0;
L1_D_800DF684 = D_800ED37C;
L1_D_800E02B4 = D_800EDFAC;
L1_D_800E23D4 = D_800F06E4;
L1_D_800E23E8 = D_800F070C;
L1_D_800E2438 = D_800F07A8;
L1_D_800E2448 = D_800F07B8;
L1_D_800E2DA8 = D_800F1118;
L1_D_800E2DBC = D_800F112C;
L1_D_800E2DE0 = D_800F1150;
L1_D_800E2DE4 = D_800F1154;
L1_D_800E2DF4 = D_800F1164;
L1_D_800E2E44 = D_800F11B4;
L1_D_800E2E48 = D_800F11B8;
L1_D_800E2E4C = D_800F11BC;
L1_D_800E2F2C = D_800F129C;
L1_D_800E2F38 = D_800F12A8;
L1_D_800E2F3C = D_800F12AC;
L1_D_800E2F54 = D_800F12C4;
L1_D_800E2F58 = D_800F12C8;
L1_D_800E2F5C = D_800F12CC;
L1_D_800F0F5C = D_800FF2CC;
L1_D_800F0F80 = D_800FF2F0;
L1_D_800F1180 = D_800FF6A4;
L1_D_800F11A0 = D_800FF6C4;
L1_D_800F11D0 = D_800FF6F4;
L1_D_800F11F0 = D_800FF714;
L1_D_800F128C = D_800FF7B0;
L1_D_800F1294 = D_800FF7B8;
L1_D_800F12D4 = D_800FF7F8;
L1_D_800F12EC = D_800FF810;
L1_D_800F12F4 = D_800FF818;
L1_D_800F1314 = D_800FF838;
L1_D_800F1354 = D_800FF878;
L1_D_800F136C = D_800FF890;
L1_D_800F1374 = D_800FF898;
L1_D_800F138C = D_800FF8B0;
L1_D_800F1398 = D_800FF8BC;
L1_D_800F13A8 = D_800FF8CC;
L1_D_800F1DCC = D_801002F0;
L1_D_800F25D8 = D_80100AFC;
L1_D_800F2FBC = D_801014E0;
L1_D_800F3848 = D_80101D6C;
L1_D_800F3B48 = D_8010206C;
L1_D_800F3E98 = D_801023BC;
L1_D_800F40DC = D_80102600;
L1_D_800F40E0 = D_80102604;
L1_D_800F40F8 = D_8010261C;
L1_D_800F40FC = D_80102620;
L1_D_800F4114 = D_80102638;
L1_D_800F413C = D_80102660;
L1_D_800F415C = D_80102680;
L1_D_800F4264 = D_80102788;
L1_D_800F4268 = D_8010278C;
L1_D_800F426C = D_80102790;
L1_D_800F4270 = D_80102794;
L1_D_800F5A64 = D_80103F88;
L1_D_800F5A65 = D_80103F89;
L1_D_800F5A66 = D_80103F8A;
L1_D_800F5A68 = D_80103F8C;
L1_D_800F5A6C = D_80103F90;
L1_D_800F6040 = D_80104564;
L1_D_800F6064 = D_80104588;
L1_D_800F6068 = D_8010458C;
L1_D_800F606C = D_80104590;
L1_D_800F6070 = D_80104594;
L1_D_800F7664 = D_80105B88;
L1_D_800F7E64 = D_80106388;
L1_D_800F7EC4 = D_801063E8;
L1_D_800F7EC8 = D_801063EC;
L1_D_800F7EC9 = D_801063ED;
L1_D_800F7ECA = D_801063EE;
L1_D_800F7ECC = D_801063F0;
L1_D_800F7ECE = D_801063F2;
L1_D_800F7ED0 = D_801063F4;
L1_D_800F7ED2 = D_801063F6;
L1_D_800F7EE4 = D_80106408;
L1_D_800F7EE8 = D_8010640C;
L1_D_800F7EEC = D_80106410;
L1_D_800F7EF4 = D_80106418;
L1_D_800F7EF8 = D_8010641C;
L1_D_800F7EFC = D_80106420;
L1_D_800F7F00 = D_80106424;
L1_D_800F7F04 = D_80106428;
L1_D_800F7F08 = D_8010642C;
L1_D_800F7F10 = D_80106434;
L1_D_800F7F1C = D_80106440;
L1_D_800F7F64 = D_80106488;
L1_D_800F7F68 = D_8010648C;
L1_D_800F7F6C = D_80106490;
L1_D_800F7F70 = D_80106494;
L1_D_800F7F74 = D_80106498;
L1_D_800F7F81 = D_801064A5;
L1_D_800F7F84 = D_801064A8;
L1_D_800F7FCC = D_801064F0;
L1_D_800F8014 = D_80106538;
L1_D_800F81F4 = D_80106718;
L1_D_800F81F8 = D_8010671C;
L1_D_800F8204 = D_80106728;
L1_D_800F8208 = D_8010672C;
L1_D_800F8214 = D_80106738;
L1_D_800F8614 = D_80106B38;
L1_D_800FC614 = D_8010AB38;
L1_D_800FC616 = D_8010AB3A;
L1_D_800FC624 = D_8010AB48;
L1_D_800FC628 = D_8010AB4C;
L1_D_800FC62C = D_8010AB50;
L1_D_800FC630 = D_8010AB54;
L1_D_800FC640 = D_8010AB64;
L1_D_800FC644 = D_8010AB68;
L1_D_800FC648 = D_8010AB6C;
L1_D_800FC650 = D_8010AB74;
L1_D_800FC654 = D_8010AB78;
L1_D_800FC658 = D_8010AB7C;
L1_D_800FC65C = D_8010AB80;
L1_D_800FC660 = D_8010AB84;
L1_D_800FC664 = D_8010AB88;
L1_D_800FC670 = D_8010AB94;
L1_D_800FC67C = D_8010ABA0;
L1_D_800FC6A0 = D_8010ABC4;
L1_D_800FC6B0 = D_8010ABD4;
L1_D_800FC6C0 = D_8010ABE4;
L1_D_800FC780 = D_8010ACA4;
L1_D_800FC784 = D_8010ACA8;
L1_D_800FC788 = D_8010ACAC;
L1_D_800FC790 = D_8010ACB4;
L1_D_800FC794 = D_8010ACB8;
L1_D_800FCF94 = D_8010B4B8;
L1_D_800FCF98 = D_8010B4BC;
L1_D_800FCF9C = D_8010B4C0;
L1_D_800FCFA0 = D_8010B4C4;
L1_D_800FCFA4 = D_8010B4C8;
L1_D_800FCFA8 = D_8010B4CC;
L1_D_800FCFAC = D_8010B4D0;
L1_D_800FCFB0 = D_8010B4D4;
L1_D_800FCFB4 = D_8010B4D8;
L1_D_800FD038 = D_8010B55C;
L1_D_800FD0B8 = D_8010B5DC;
L1_D_800FD0F8 = D_8010B61C;
L1_D_800FD138 = D_8010B65C;
L1_D_800FD178 = D_8010B69C;
L1_D_800FD17C = D_8010B6A0;
L1_D_800FD190 = D_8010B6B4;
L1_D_800FD191 = D_8010B6B5;
L1_D_800FD195 = D_8010B6B9;
L1_D_800FD197 = D_8010B6BB;
L1_D_800FD19A = D_8010B6BE;
L1_D_800FD19B = D_8010B6BF;
L1_D_800FD19F = D_8010B6C3;
L1_D_800FD1A1 = D_8010B6C5;
L1_D_800FD1A2 = D_8010B6C6;
L1_D_800FD1A4 = D_8010B6C8;
L1_D_800FD1A6 = D_8010B6C8 + 0x2;
L1_D_800FD1A8 = D_8010B6CC;
L1_D_800FD1AC = D_8010B6D0;
L1_D_800FD1BC = D_8010B6E0;
L1_D_800FD1C0 = D_8010B6E4;
L1_D_800FD1C4 = D_8010B6E8;
L1_D_800FD1C8 = D_8010B6EC;
L1_D_800FD208 = D_8010B72C;
L1_D_800FD248 = D_8010B76C;
L1_D_800FD24C = D_8010B770;
L1_D_800FD254 = D_8010B778;
L1_D_800FD258 = D_8010B77C;
L1_D_800FD25C = D_8010B780;
L1_D_800FD260 = D_8010B784;
L1_D_800FD264 = D_8010B788;
L1_D_800FD266 = D_8010B78A;
L1_D_800FD268 = D_8010B78C;
L1_D_800FD26A = D_8010B78E;
L1_D_800FD26C = D_8010B790;
L1_D_800FD3E4 = D_8010B908;
L1_D_800FD3E8 = D_8010B90C;
L1_D_800FD400 = D_8010B924;
L1_D_800FD440 = D_8010B964;
L1_D_800FD442 = D_8010B966;
L1_D_800FD444 = D_8010B968;
L1_D_800FD446 = D_8010B96A;
L1_D_800FD448 = D_8010B96C;
L1_D_800FD44A = D_8010B96E;
L1_D_800FD44C = D_8010B970;
L1_D_800FD44E = D_8010B972;
L1_D_800FD450 = D_8010B974;
L1_D_800FD452 = D_8010B976;
L1_D_800FD454 = D_8010B978;
L1_D_800FD456 = D_8010B97A;
L1_D_800FD458 = D_8010B97C;
L1_D_800FD45A = D_8010B97E;
L1_D_800FD45D = D_8010B981;
L1_D_800FD45E = D_8010B982;
L1_D_800FD460 = D_8010B984;
L1_D_800FD462 = D_8010B986;
L1_D_800FD464 = D_8010B988;
L1_D_800FD466 = D_8010B98A;
L1_D_800FD46A = D_8010B98E;
L1_D_800FD46C = D_8010B990;
L1_D_800FD46E = D_8010B992;
L1_D_800FD470 = D_8010B994;
L1_D_800FD472 = D_8010B996;
L1_D_800FD476 = D_8010B99A;
L1_D_800FD824 = D_8010BD48;
L1_D_800FD980 = D_8010BEA4;
L1_D_800FD984 = D_8010BEA8;
L1_D_800FD988 = D_8010BEAC;
L1_D_800FD98C = D_8010BEB0;
L1_D_800FD990 = D_8010BEB4;
L1_D_800FD994 = D_8010BEB8;
L1_D_800FD998 = D_8010BEBC;
L1_D_800FD99C = D_8010BEC0;
L1_D_800FD9A0 = D_8010BEC4;
L1_D_800FD9A4 = D_8010BEC8;
L1_D_800FD9AC = D_8010BED0;
L1_D_800FD9C0 = D_8010BEE4;
L1_D_800FD9C8 = D_8010BEEC;
L1_D_800FD9D0 = D_8010BEF4;
L1_D_800FD9D8 = D_8010BEFC;
L1_D_800FD9DC = D_8010BF00;
L1_D_800FD9E0 = D_8010BF04;
L1_D_800FD9F4 = D_8010BF18;
L1_D_800FDA04 = D_8010BF28;
L1_D_800FDA08 = D_8010BF2C;
L1_D_800FDA0C = D_8010BF30;
L1_D_800FDA24 = D_8010BF48;
L1_D_800FDB2C = D_8010C050;
L1_DebugPage_ArtProfile = func_800416DC;
func_800419D4 = L1_DebugPage_Camera;
L1_DebugPage_ContourMask = func_80078D2C;
L1_DebugPage_FPWeapon = func_8007DA1C;
L1_DebugPage_Framerate = func_80041718;
L1_DebugPage_Loadpoint = func_80031D94;
func_80041764 = L1_DebugPage_ObjectCount;
L1_DebugPage_Profile = func_800416A0;
func_8002FD28 = L1_DebugScreen_DrawPage;
L1_DeliverEvent = func_80098280;
func_80032C24 = L1_DevMenu_Draw;
func_800329CC = L1_DevMenu_HandleInput;
func_80032DEC = L1_DevMenu_Init;
L1_DisableEvent = func_8009F22C;
L1_EVENT_OBJ_11C = func_8008A154;
L1_EVENT_OBJ_90 = func_8008A0C8;
L1_EVENT_OBJ_CC = func_8008A104;
L1_EVENT_OBJ_F4 = func_8008A12C;
L1_EnableEvent = func_800833B4;
L1_FlushCache = func_8009F53C;
L1_FntFlush = func_8008C228;
L1_FntLoad = func_8008BED0;
L1_FntOpen = func_8008BF70;
L1_FntPrint = func_8008C544;
L1_GPU_cw = func_80092C64;
L1_GS_001_OBJ_1F8 = func_80088FA0;
L1_GS_001_OBJ_74 = func_80088E1C;
L1_GS_107_OBJ_4B8 = func_8007B3DC;
L1_GS_107_OBJ_51C = func_8007B440;
L1_GetClut = func_800862E0;
L1_GetTPage = func_80086360;
func_8002F738 = L1_Gfx_Init;
L1_GsClearOt = func_8008D6B0;
L1_GsDefDispBuff = func_8008E990;
L1_GsGetActiveBuff = func_80089318;
L1_GsGetHeadpUnit = func_8009299C;
L1_GsGetLs = func_8007E840;
L1_GsGetLsUnit = func_80091108;
L1_GsGetLwUnit = func_800913D8;
L1_GsGetTimInfo = func_80090530;
L1_GsInit3D = func_8008E910;
L1_GsInitGraph = func_80088DA8;
L1_GsInitGraph2 = func_80088F38;
L1_GsInitVcount = func_8008A218;
L1_GsLinkAnim = func_80092630;
L1_GsLinkObject4 = func_8008A258;
L1_GsMapCoordUnit = func_80091C38;
L1_GsMapModelingData = func_8008FE70;
L1_GsMapUnit = func_80091CB8;
L1_GsScanAnim = func_80092588;
L1_GsScanUnit = func_800927E4;
L1_GsSetAmbient = func_80092B14;
L1_GsSetDrawBuffClip = func_800975D8;
L1_GsSetDrawBuffOffset = func_80089328;
L1_GsSetFlatLight = func_8007AF24;
L1_GsSetRefView2 = func_800894F8;
L1_GsSortClear = func_800891C0;
L1_GsSortObject4 = func_8007FB5C;
L1_GsSortOt = func_8008BDD0;
L1_GsSortUnit = func_80090F34;
L1_GsSwapDispBuff = func_8008D710;
L1_GsTMDdivF3NL = func_8008EF80;
L1_GsTMDdivG3NL = func_8008F170;
L1_GsTMDdivNF3 = func_8008E520;
L1_GsTMDdivNG3 = func_8008E710;
L1_GsTMDdivTF3L = func_8008F370;
L1_GsTMDdivTF3LFG = func_8008D7C0;
L1_GsTMDdivTF3NL = func_8008CD90;
L1_GsTMDdivTG3NL = func_8008D040;
L1_GsTMDdivTNF3 = func_8008F920;
L1_GsTMDdivTNG3 = func_8008FBD0;
L1_GsTMDfastF3GL = func_8008D290;
L1_GsTMDfastF3GLFG = func_8008EA50;
L1_GsTMDfastF3GNL = func_8008DFF0;
L1_GsTMDfastF3L = func_800811C8;
L1_GsTMDfastF3LFG = func_80081310;
L1_GsTMDfastF3NL = func_80081088;
L1_GsTMDfastG3GL = func_8008D4B0;
L1_GsTMDfastG3GLFG = func_8008EC70;
L1_GsTMDfastG3GNL = func_8008E3B0;
L1_GsTMDfastG3L = func_80080C24;
L1_GsTMDfastG3LFG = func_80080DB4;
L1_GsTMDfastG3NL = func_80080AE4;
L1_GsTMDfastNF3 = func_80080F4C;
L1_GsTMDfastNG3 = func_8008099C;
L1_GsTMDfastTF3L = func_800806BC;
L1_GsTMDfastTF3LFG = func_8008082C;
L1_GsTMDfastTF3NL = func_80080558;
L1_GsTMDfastTG3L = func_8007F7F0;
L1_GsTMDfastTG3LFG = func_8007F9A4;
L1_GsTMDfastTG3NL = func_8007F694;
L1_GsTMDfastTNF3 = func_800803EC;
L1_GsTMDfastTNG3 = func_8007F51C;
L1_GsU_00000008 = func_8009DAFC;
L1_GsU_00000009 = func_8009DC7C;
L1_GsU_0000000c = func_8009D1BC;
L1_GsU_0000000d = func_8009D37C;
L1_GsU_0000000f = func_8009D54C;
L1_GsU_00000209 = func_8009DE0C;
L1_GsU_0000020d = func_8009D72C;
L1_GsU_00200009 = func_8009DFAC;
L1_GsU_0020000d = func_8009D91C;
L1_GsU_01000000 = func_8009C21C;
L1_GsU_0100000c = func_8009BD7C;
L1_GsU_0100000d = func_8009BFEC;
L1_GsU_02000000 = func_8009BC3C;
L1_GsU_02000001 = func_8009BCCC;
L1_GsU_03000000 = D_8009C34C;
L1_GsU_03000001 = func_8009CA8C;
L1_GsU_03000010 = func_8009CC6C;
L1_GsU_03000011 = func_8009CE5C;
L1_Gssub_make_matrix = func_80090940;
L1_HookEntryInt = func_80097298;
L1_INTR_DMA_OBJ_1CC = func_80097474;
L1_INTR_DMA_OBJ_278 = func_80097520;
L1_INTR_DMA_OBJ_4C = func_800972F4;
L1_INTR_VB_OBJ_58 = func_800971A0;
L1_INTR_VB_OBJ_C4 = func_8009720C;
L1_INTR_VB_OBJ_F0 = func_80097238;
L1_ISO9660_OBJ_2D8 = func_80087E74;
L1_ISO9660_OBJ_2F8 = func_80087E94;
L1_ISO9660_OBJ_5BC = func_80088158;
L1_ISO9660_OBJ_660 = func_800881FC;
L1_ISO9660_OBJ_8FC = func_80088498;
L1_InitGeom = func_8008BD48;
L1_InitHeap3 = func_8008FE10;
L1_LoadClut = func_80090450;
L1_LoadClut2 = func_800904C0;
L1_LoadTPage = func_80099E50;
func_80079070 = L1_Math_Abs;
func_800790AC = L1_Math_Max;
func_80079160 = L1_Math_Max3;
func_800790F8 = L1_Math_Min3;
L1_Menu_ResetState = func_80029114;
L1_MulMatrix = func_8007EEA0;
L1_MulMatrix2 = func_8007EFB0;
L1_OpenEvent = func_800834D8;
L1_PADIF_OBJ_120 = func_80099850;
L1_PADIF_OBJ_1CC = func_800998FC;
L1_PADIF_OBJ_290 = func_800999C0;
L1_PADIF_OBJ_48 = func_80099778;
L1_PADPORTD_OBJ_160 = func_8008A6A8;
L1_PADPORTD_OBJ_1C8 = func_8008A710;
L1_PADPORTD_OBJ_2BC = func_8008A804;
L1_PADPORTD_OBJ_2CC = func_8008A814;
L1_PADPORTD_OBJ_388 = func_8008A8D0;
L1_PADPORTD_OBJ_604 = func_8008AB4C;
L1_PADPORTD_OBJ_63C = func_8008AB84;
L1_PADSEQD_OBJ_144 = func_800986D4;
L1_PADSEQD_OBJ_34 = func_800985C4;
L1_PADSEQD_OBJ_488 = func_80098A18;
L1_PATCHGTE_OBJ_DC = D_80099E4C;
L1_PCcreat = func_800892F8;
L1_PClseek = func_8008851C;
L1_PCopen = func_80087B7C;
L1_PCread = func_80087444;
L1_PadInitDirect = func_8008A548;
func_80045240 = L1_Pad_StickToSpeed;
func_8002F2CC = L1_Pad_Update;
func_80042060 = L1_PauseMenu_Open;
L1_PopMatrix = func_8007B5F8;
L1_PushMatrix = func_8007B554;
L1_ResetEntryInt = func_80097578;
func_80042A40 = L1_RestartPrompt_Open;
L1_ReturnFromException = func_80097568;
L1_RotAverage3 = func_8009A990;
L1_RotAverageNclip3 = func_8009A900;
L1_RotAverageNclipColorCol3 = func_8009B30C;
L1_RotAverageNclipColorDpq3 = func_80099FA0;
L1_RotAverageNclipColorDpq3_1 = func_8009A3F8;
L1_RotMatrix = func_80092068;
L1_RotMatrixY = func_800907A0;
L1_RotMatrixYXZ = func_800922F8;
L1_RotMatrixYXZ_gte = func_80090D34;
L1_RotTrans = func_80092C34;
L1_ScaleMatrix = func_800929D4;
L1_SetBackColor = func_8009E14C;
L1_SetColorMatrix = func_8007B524;
L1_SetDefDispEnv = func_8008EF40;
L1_SetDefDrawEnv = func_8008EE70;
L1_SetDrawMode = func_800861E0;
L1_SetDumpFnt = func_8008BE90;
L1_SetFarColor = func_8009E84C;
L1_SetLightMatrix = func_80092BF4;
L1_SetLineF4 = func_800861C0;
L1_SetRotMatrix = func_80092BA4;
L1_SetTransMatrix = func_80092BD4;
L1_SpuClearReverbWorkArea = func_800982B0;
L1_SpuFree = func_800984D0;
L1_SpuGetVoiceEnvelope = func_8009E4BC;
L1_SpuInitMalloc = func_8009F55C;
L1_SpuIsTransferCompleted = func_8009B4CC;
L1_SpuMalloc = func_8009B96C;
L1_SpuRead = func_8009B46C;
L1_SpuSetCommonAttr = func_80094B2C;
L1_SpuSetKey = func_8009E50C;
L1_SpuSetNoiseClock = func_8009E6FC;
L1_SpuSetTransferMode = func_8009B3DC;
L1_SpuSetTransferStartAddr = func_8009B40C;
L1_SpuSetVoiceAttr = func_80097A10;
L1_SpuStart = func_8009598C;
L1_SquareRoot0 = func_8007B494;
L1_SquareRoot12 = func_80090B40;
L1_SsEnd = func_8008A498;
L1_SsPitchFromNote = func_80093A58;
L1_SsSeqCalledTbyT = func_80098010;
L1_SsSetSerialAttr = func_800860D0;
L1_SsSetSerialVol = func_80085F24;
L1_SsSetTickMode = func_80089BF8;
L1_SsUtAllKeyOff = func_80089A98;
L1_SsVabClose = func_8008A3E8;
L1_SsVabOpenHead = func_800903B0;
L1_SsVabTransBody = func_80090160;
L1_SsVabTransCompleted = func_80090230;
L1_SsVoKeyOn = func_80085B7C;
L1_SysDeqIntRP = func_80099650;
L1_SysEnqIntRP = func_80099660;
L1_TestEvent = func_8009F54C;
L1_TransposeMatrix = func_80090A10;
L1_VSYNC_OBJ_178 = func_800886C8;
L1_VS_VH2_OBJ_34 = func_800903E4;
L1_VSync = func_80088550;
func_80078D9C = L1_Vec_Dot;
func_80078E18 = L1_Vec_ProjectXZ;
func_80078EC0 = L1_Vec_Scale;
L1_WaitEvent = func_8009F21C;
L1__SN_read = func_80095A94;
L1__SN_write = func_80097678;
L1__SpuInit = func_800958A4;
L1__SpuSetAnyVoice = func_8009F5BC;
L1__SsGetSeqData = func_8009FBBC;
L1__SsInit = func_80092C74;
L1__SsReadDeltaValue = func_800A06FC;
L1__SsSeqGetEof = func_8009F978;
L1__SsSeqPlay = func_8009F87C;
L1__SsSndCrescendo = func_8009EADC;
L1__SsSndNextSep = func_800A05FC;
L1__SsSndPause = func_8009EF0C;
L1__SsSndPlay = func_8009EAAC;
L1__SsSndReplay = func_8009EFAC;
L1__SsSndTempo = func_8009ECEC;
L1__SsVmAlloc = func_8009487C;
L1__SsVmDoAllocate = func_80093264;
L1__SsVmFlush = func_80092DD4;
L1__SsVmInit = func_8009E16C;
L1__SsVmKeyOffNow = func_80094054;
L1__SsVmKeyOnNow = func_80093B84;
L1__SsVmSelectToneAndVag = func_8009E74C;
L1__SsVmVSetUp = func_80092D14;
L1__dirFailAuto = func_80098938;
L1__gp = D_800AF9EC;
L1__padInitDirSeq = func_80098590;
L1__patch_gte = func_80099D70;
L1__spu_gcSPU = func_8009F23C;
L1_bzero = func_80098A50;
L1_calloc3 = func_8008FEE0;
L1_chkRC2wait = func_80099690;
L1_exit = func_80086300;
L1_free3 = func_80090010;
PROVIDE(L1_func_800274F4 = func_800275D0);
PROVIDE(func_800275D0 = L1_func_800274F4);
func_8002844C = L1_func_80028370;
PROVIDE(L1_func_8002847C = func_80028558);
PROVIDE(func_80028558 = L1_func_8002847C);
func_80028754 = L1_func_80028678;
L1_func_800286EC = func_800287C8;
func_80028808 = L1_func_8002872C;
func_800288EC = L1_func_80028810;
func_80028934 = L1_func_80028858;
func_80028A34 = L1_func_80028958;
L1_func_800289C0 = func_80028A9C;
func_80028C34 = L1_func_80028B58;
func_80028CE4 = L1_func_80028C08;
func_80028E98 = L1_func_80028DBC;
func_80029140 = L1_func_80029064;
PROVIDE(L1_func_800291B0 = func_8002928C);
PROVIDE(func_8002928C = L1_func_800291B0);
func_80029590 = L1_func_800294B4;
func_800295E0 = L1_func_80029504;
L1_func_8002967C = func_80029758;
func_80029760 = L1_func_80029684;
func_80029944 = L1_func_80029868;
L1_func_800299CC = func_80029AA8;
PROVIDE(L1_func_80029A34 = func_80029B10);
PROVIDE(func_80029B10 = L1_func_80029A34);
func_8002A4A4 = L1_func_8002A3C8;
func_8002A6F8 = L1_func_8002A61C;
func_8002A7FC = L1_func_8002A720;
func_8002A930 = L1_func_8002A854;
func_8002AB70 = L1_func_8002AA94;
L1_func_8002AAC4 = func_8002ABA0;
func_8002ABD8 = L1_func_8002AAFC;
func_8002AD6C = L1_func_8002AC90;
L1_func_8002ADF0 = func_8002AECC;
func_8002AF10 = L1_func_8002AE34;
L1_func_8002AF08 = func_8002AFE4;
func_8002B0D4 = L1_func_8002AFF8;
L1_func_8002B064 = func_8002B140;
func_8002B17C = L1_func_8002B0A0;
func_8002B258 = L1_func_8002B17C;
PROVIDE(L1_func_8002B29C = func_8002B378);
PROVIDE(func_8002B378 = L1_func_8002B29C);
func_8002B778 = L1_func_8002B69C;
L1_func_8002BB34 = func_8002BC10;
func_8002BC44 = L1_func_8002BB68;
func_8002BCF4 = L1_func_8002BC18;
func_8002BF00 = L1_func_8002BE24;
func_8002C010 = L1_func_8002BF34;
func_8002C244 = L1_func_8002C168;
L1_func_8002C2D8 = func_8002C3B4;
func_8002C56C = L1_func_8002C490;
L1_func_8002C664 = func_8002C740;
func_8002C798 = L1_func_8002C6BC;
L1_func_8002C83C = func_8002C918;
L1_func_8002C844 = func_8002C920;
func_8002D1CC = L1_func_8002D0F0;
func_8002D2B0 = L1_func_8002D1D4;
func_8002D5C0 = L1_func_8002D4E4;
func_8002D6E0 = L1_func_8002D604;
func_8002D7E4 = L1_func_8002D708;
L1_func_8002DD6C = func_8002DDE0;
L1_func_8002E0E8 = func_8002E168;
L1_func_8002E190 = func_8002E210;
func_8002E230 = L1_func_8002E1B0;
func_8002E3A4 = L1_func_8002E318;
L1_func_8002E3A0 = func_8002E42C;
L1_func_8002E410 = func_8002E49C;
L1_func_8002E430 = func_8002E4BC;
L1_func_8002E48C = func_8002E518;
L1_func_8002E4B4 = func_8002E540;
L1_func_8002E4D4 = func_8002E560;
func_8002E568 = L1_func_8002E4DC;
L1_func_8002E534 = func_8002E5C0;
L1_func_8002E5C4 = func_8002E650;
L1_func_8002F0A4 = func_8002F138;
L1_func_8002F114 = func_8002F1A8;
L1_func_8002F53C = func_8002F5D0;
func_8002F5F8 = L1_func_8002F564;
func_8002F6B8 = L1_func_8002F624;
L1_func_8002F7CC = func_8002F860;
PROVIDE(L1_func_8002FFD8 = func_80030058);
PROVIDE(func_80030058 = L1_func_8002FFD8);
func_80030198 = L1_func_80030118;
L1_func_800302AC = func_8003032C;
L1_func_80030304 = func_80030384;
L1_func_80030324 = func_800303A4;
func_800303B4 = L1_func_80030334;
func_80030434 = L1_func_800303B4;
PROVIDE(L1_func_8003052C = func_800305AC);
PROVIDE(func_800305AC = L1_func_8003052C);
L1_func_800305B4 = func_80030634;
L1_func_80030610 = func_80030690;
func_800306F0 = L1_func_80030670;
L1_func_800306A8 = func_80030728;
L1_func_800306F0 = func_80030770;
func_80030818 = L1_func_80030798;
L1_func_80030868 = func_800308E8;
PROVIDE(L1_func_80030994 = func_80030A14);
PROVIDE(func_80030A14 = L1_func_80030994);
func_80030B84 = L1_func_80030B04;
func_80030D88 = L1_func_80030D08;
func_80030E20 = L1_func_80030DA0;
L1_func_80030EB0 = func_80030F30;
func_80030FA0 = L1_func_80030F20;
func_80031028 = L1_func_80030FA8;
L1_func_800310B4 = func_80031134;
func_8003156C = L1_func_800314A0;
func_80031744 = L1_func_80031678;
L1_func_80031F18 = func_80031FE4;
func_80032140 = L1_func_80032074;
func_800322BC = L1_func_800321F0;
func_8003255C = L1_func_8003246C;
L1_func_800324C0 = func_800325B0;
func_800325C0 = L1_func_800324D0;
L1_func_80032648 = func_80032738;
func_80032814 = L1_func_80032724;
func_80032858 = L1_func_80032768;
L1_func_80032880 = func_80032970;
func_80032F3C = L1_func_80032E4C;
PROVIDE(L1_func_80032EFC = func_80032FEC);
PROVIDE(func_80032FEC = L1_func_80032EFC);
func_80033180 = L1_func_80033090;
func_80033394 = L1_func_800332A4;
func_80033438 = L1_func_80033348;
func_800334C4 = L1_func_800333D4;
func_80033510 = L1_func_800334F4;
L1_func_80033F38 = func_80034630;
func_80035090 = L1_func_80034998;
func_800350F0 = L1_func_800349F8;
func_80035728 = L1_func_80035030;
func_800360CC = L1_func_80035964;
func_80036154 = L1_func_800359EC;
func_80036324 = L1_func_80035BBC;
func_80036550 = L1_func_80035DE8;
func_8003666C = L1_func_80035F04;
func_80036924 = L1_func_800361BC;
func_80036A90 = L1_func_80036328;
func_80036D1C = L1_func_800365B4;
func_80036DD8 = L1_func_80036670;
L1_func_800368A8 = func_80037010;
L1_func_80036938 = func_800370A0;
func_80037570 = L1_func_80036E10;
L1_func_800373FC = func_80037B5C;
func_80037F54 = L1_func_80037768;
func_80037FE0 = L1_func_800377F4;
func_800380E8 = L1_func_800378FC;
func_80038210 = L1_func_80037A24;
func_800382B8 = L1_func_80037ACC;
L1_func_80037B6C = func_80038358;
func_8003889C = L1_func_800380DC;
PROVIDE(L1_func_800381CC = func_8003898C);
PROVIDE(func_8003898C = L1_func_800381CC);
func_80038BC4 = L1_func_80038404;
func_80038F8C = L1_func_8003872C;
func_80039598 = L1_func_80038984;
func_80039894 = L1_func_80038C04;
func_8003991C = L1_func_80038C8C;
L1_func_800390F8 = func_80039D88;
PROVIDE(L1_func_800391B0 = func_80039E40);
PROVIDE(func_80039E40 = L1_func_800391B0);
L1_func_800393AC = func_8003A03C;
func_8003A074 = L1_func_800393E4;
L1_func_80039520 = func_8003A1B0;
L1_func_800395E8 = func_8003A278;
func_8003A410 = L1_func_800397A8;
PROVIDE(L1_func_8003982C = func_8003A494);
PROVIDE(func_8003A494 = L1_func_8003982C);
func_8003A69C = L1_func_80039A34;
L1_func_80039A9C = func_8003A704;
PROVIDE(L1_func_8003A51C = func_8003B184);
PROVIDE(func_8003B184 = L1_func_8003A51C);
PROVIDE(L1_func_8003A68C = func_8003B2F4);
PROVIDE(func_8003B2F4 = L1_func_8003A68C);
L1_func_8003A71C = func_8003B384;
func_8003B500 = L1_func_8003A898;
func_8003B67C = L1_func_8003AA14;
PROVIDE(L1_func_8003AC1C = func_8003B884);
PROVIDE(func_8003B884 = L1_func_8003AC1C);
func_8003C15C = L1_func_8003B4F4;
PROVIDE(L1_func_8003B53C = func_8003C1A4);
PROVIDE(func_8003C1A4 = L1_func_8003B53C);
L1_func_8003B750 = func_8003C3B8;
PROVIDE(L1_func_8003B808 = func_8003C470);
PROVIDE(func_8003C470 = L1_func_8003B808);
L1_func_8003B940 = func_8003C5A8;
func_8003C900 = L1_func_8003BC98;
func_8003CAD0 = L1_func_8003BE68;
func_8003CC20 = L1_func_8003BFB8;
L1_func_8003C1BC = func_8003CE24;
func_8003D378 = L1_func_8003C6B0;
func_8003D3AC = L1_func_8003C6E4;
func_8003D554 = L1_func_8003C88C;
func_8003D56C = L1_func_8003C8A4;
func_8003D68C = L1_func_8003C9C4;
L1_func_8003CA4C = func_8003D714;
func_8003D784 = L1_func_8003CABC;
PROVIDE(L1_func_8003D76C = func_8003E3C4);
PROVIDE(func_8003E3C4 = L1_func_8003D76C);
func_8003EAB0 = L1_func_8003DE58;
func_8003EDB0 = L1_func_8003E158;
func_8003F0EC = L1_func_8003E494;
PROVIDE(L1_func_8003E5A0 = func_8003F1F8);
PROVIDE(func_8003F1F8 = L1_func_8003E5A0);
func_8003F67C = L1_func_8003EA24;
func_8003F758 = L1_func_8003EB00;
PROVIDE(L1_func_8003EC44 = func_8003F89C);
PROVIDE(func_8003F89C = L1_func_8003EC44);
func_800403C0 = L1_func_8003F768;
func_80040BDC = L1_func_8003FF9C;
L1_func_8004009C = func_80040CDC;
PROVIDE(L1_func_80040778 = func_8004121C);
PROVIDE(func_8004121C = L1_func_80040778);
func_8004141C = L1_func_80040978;
func_8004154C = L1_func_80040AA8;
func_80041B00 = L1_func_8004105C;
func_80041C60 = L1_func_800411BC;
L1_func_8004133C = func_80041DE0;
func_80041E98 = L1_func_800413F4;
L1_func_800414AC = func_80041F50;
L1_func_80041578 = func_8004201C;
func_80042268 = L1_func_800417C4;
L1_func_800419CC = func_80042534;
func_800425A0 = L1_func_80041A38;
func_80042708 = L1_func_80041BA0;
func_80042790 = L1_func_80041C28;
func_80042858 = L1_func_80041CF0;
func_80042924 = L1_func_80041DBC;
func_800429E0 = L1_func_80041E78;
func_80042B88 = L1_func_80042020;
func_80042CF4 = L1_func_8004218C;
PROVIDE(L1_func_800425E4 = func_8004314C);
PROVIDE(func_8004314C = L1_func_800425E4);
L1_func_80042A94 = func_800435FC;
L1_func_80042B28 = func_80043690;
func_80043884 = L1_func_80042D1C;
L1_func_80042E34 = func_8004399C;
L1_func_80042E6C = func_800439D4;
func_80043BE0 = L1_func_80043078;
func_80043D68 = L1_func_80043200;
L1_func_800433A8 = func_80043F10;
L1_func_800433F4 = func_80043F5C;
PROVIDE(L1_func_80043610 = func_80044178);
PROVIDE(func_80044178 = L1_func_80043610);
PROVIDE(L1_func_80043B14 = func_8004467C);
PROVIDE(func_8004467C = L1_func_80043B14);
L1_func_80043EE0 = func_80044A48;
func_800453E8 = L1_func_800448F4;
L1_func_80044B3C = func_80045630;
L1_func_80044BAC = func_800456A0;
L1_func_80044BBC = func_800456B0;
PROVIDE(L1_func_80044BCC = func_800456C0);
PROVIDE(func_800456C0 = L1_func_80044BCC);
func_80045B78 = L1_func_80045084;
func_80045C40 = L1_func_8004514C;
func_80045E38 = L1_func_80045344;
PROVIDE(L1_func_80045A28 = func_80046518);
PROVIDE(func_80046518 = L1_func_80045A28);
func_80046D5C = L1_func_8004626C;
PROVIDE(L1_func_800463C8 = func_80046EB8);
PROVIDE(func_80046EB8 = L1_func_800463C8);
func_80047E08 = L1_func_80047318;
PROVIDE(L1_func_800474AC = func_80047F9C);
PROVIDE(func_80047F9C = L1_func_800474AC);
func_800480AC = L1_func_800475BC;
L1_func_800477C0 = func_800482B0;
L1_func_8004782C = func_8004831C;
L1_func_8004783C = func_8004832C;
func_800484F4 = L1_func_80047A04;
func_80048640 = L1_func_80047B50;
func_800488AC = L1_func_80047DBC;
L1_func_80047ECC = func_800489BC;
func_80048ECC = L1_func_800483D8;
func_80048F10 = L1_func_8004841C;
PROVIDE(L1_func_80048794 = func_80049288);
PROVIDE(func_80049288 = L1_func_80048794);
func_80049640 = L1_func_80048B4C;
func_800498D8 = L1_func_80048DE4;
func_80049954 = L1_func_80048E60;
L1_func_80048FE8 = func_80049ADC;
L1_func_8004900C = func_80049B00;
func_80049EB4 = L1_func_800493C0;
func_80049F64 = L1_func_80049470;
func_8004A230 = L1_func_8004973C;
func_8004A3D8 = L1_func_800498E4;
func_8004A57C = L1_func_80049A88;
L1_func_80049B7C = func_8004A670;
func_8004A678 = L1_func_80049B84;
PROVIDE(L1_func_80049D60 = func_8004A854);
PROVIDE(func_8004A854 = L1_func_80049D60);
L1_func_8004A294 = func_8004AD88;
L1_func_8004A29C = func_8004AD90;
L1_func_8004A304 = func_8004ADF8;
L1_func_8004A338 = func_8004AE2C;
L1_func_8004A370 = func_8004AE64;
L1_func_8004A380 = func_8004AE74;
L1_func_8004A398 = func_8004AE8C;
L1_func_8004A81C = func_8004B2C8;
L1_func_8004A85C = func_8004B308;
L1_func_8004A8A8 = func_8004B354;
func_8004B390 = L1_func_8004A8E4;
PROVIDE(L1_func_8004A9E4 = func_8004B490);
PROVIDE(func_8004B490 = L1_func_8004A9E4);
func_8004B9B8 = L1_func_8004AF0C;
L1_func_8004B028 = func_8004BAD4;
L1_func_8004B04C = func_8004BAF8;
L1_func_8004B06C = func_8004BB18;
L1_func_8004B084 = func_8004BB30;
func_8004BB5C = L1_func_8004B0B0;
func_8004BC40 = L1_func_8004B194;
L1_func_8004B270 = func_8004BD1C;
L1_func_8004B334 = func_8004D2E0;
func_8004D368 = L1_func_8004B3BC;
func_8004D538 = L1_func_8004B58C;
func_8004D9A8 = L1_func_8004B9FC;
func_8004DAAC = L1_func_8004BB00;
func_8004DC1C = L1_func_8004BC70;
L1_func_8004BE84 = func_8004DE30;
L1_func_8004BF70 = func_8004DF1C;
func_8004E06C = L1_func_8004C0C0;
PROVIDE(L1_func_8004C368 = func_8004E314);
PROVIDE(func_8004E314 = L1_func_8004C368);
func_8004E444 = L1_func_8004C498;
L1_func_8004C50C = func_8004E4B8;
func_8004E504 = L1_func_8004C558;
L1_func_8004C5C8 = func_8004E628;
L1_func_8004C698 = func_8004E6F8;
L1_func_8004C768 = func_8004E7C8;
L1_func_8004C824 = func_8004E884;
func_8004E88C = L1_func_8004C82C;
func_8004E9A4 = L1_func_8004C944;
func_8004EABC = L1_func_8004CA5C;
func_8004EB8C = L1_func_8004CB2C;
func_8004EC54 = L1_func_8004CBF4;
func_8004ED38 = L1_func_8004CCD8;
func_8004ED74 = L1_func_8004CD14;
func_8004EE00 = L1_func_8004CDA0;
L1_func_8004CE38 = func_8004EE98;
func_8004EED4 = L1_func_8004CE74;
func_8004EF60 = L1_func_8004CF00;
func_8004F330 = L1_func_8004D2D0;
L1_func_8004D5A8 = func_8004F608;
func_8004F78C = L1_func_8004D72C;
func_8004F7D0 = L1_func_8004D770;
func_8004F8A4 = L1_func_8004D844;
func_8004F8EC = L1_func_8004D88C;
func_8004F9D8 = L1_func_8004D978;
func_8004FAC0 = L1_func_8004DA60;
func_8004FC2C = L1_func_8004DBCC;
func_8004FDFC = L1_func_8004DD9C;
func_80050058 = L1_func_8004DFF8;
func_800500DC = L1_func_8004E07C;
func_80050364 = L1_func_8004E304;
func_80050388 = L1_func_8004E328;
L1_func_8004E37C = func_800503DC;
PROVIDE(L1_func_8004E5D8 = func_80050534);
PROVIDE(func_80050534 = L1_func_8004E5D8);
L1_func_8004E78C = func_800506E8;
func_800506F0 = L1_func_8004E794;
func_800507F8 = L1_func_8004E89C;
func_800508C8 = L1_func_8004E96C;
func_80050908 = L1_func_8004E9AC;
L1_func_8004EA68 = func_800509C4;
func_80050A14 = L1_func_8004EAB8;
func_80050A7C = L1_func_8004EB20;
func_80050BCC = L1_func_8004EC70;
func_80050EA0 = L1_func_8004EF44;
L1_func_8004F134 = func_80051090;
func_800510A4 = L1_func_8004F148;
func_800512A4 = L1_func_8004F348;
L1_func_8004F3D8 = func_80051334;
PROVIDE(L1_func_8004F3E8 = func_80051344);
PROVIDE(func_80051344 = L1_func_8004F3E8);
PROVIDE(L1_func_8004F880 = func_800517DC);
PROVIDE(func_800517DC = L1_func_8004F880);
PROVIDE(L1_func_8004FD3C = func_80051C98);
PROVIDE(func_80051C98 = L1_func_8004FD3C);
func_800520DC = L1_func_80050180;
func_800522E8 = L1_func_8005038C;
PROVIDE(L1_func_800503D8 = func_80052334);
PROVIDE(func_80052334 = L1_func_800503D8);
func_800528BC = L1_func_80050960;
func_800528F8 = L1_func_8005099C;
func_80052940 = L1_func_800509E4;
func_8005296C = L1_func_80050A10;
PROVIDE(L1_func_80050A70 = func_800529CC);
PROVIDE(func_800529CC = L1_func_80050A70);
func_80053684 = L1_func_80051728;
func_8005424C = L1_func_800523E4;
func_80054628 = L1_func_80052630;
func_80054800 = L1_func_80052808;
func_80054B24 = L1_func_80052B2C;
L1_func_80052BEC = func_80054BE4;
func_80054E48 = L1_func_80053004;
func_80054EC4 = L1_func_80053080;
func_8005547C = L1_func_80053684;
L1_func_80053790 = func_80055588;
func_8005560C = L1_func_8005397C;
func_800556BC = L1_func_80053A2C;
func_8005570C = L1_func_80053A7C;
func_800557F4 = L1_func_80053B64;
L1_func_80053BD0 = func_80055860;
func_80055870 = L1_func_80053BE0;
func_80055A74 = L1_func_80053DE4;
func_80055B68 = L1_func_80053ED8;
func_80055D28 = L1_func_80054098;
func_80055D5C = L1_func_800540CC;
func_80055DA8 = L1_func_80054118;
func_80055DFC = L1_func_8005416C;
func_80055EF8 = L1_func_80054268;
func_80055F9C = L1_func_8005430C;
func_8005604C = L1_func_800543BC;
L1_func_80054414 = func_800560A4;
func_80056320 = L1_func_80054604;
func_800563B8 = L1_func_8005469C;
func_800564E0 = L1_func_800547C4;
func_80056558 = L1_func_8005483C;
func_80056680 = L1_func_80054964;
func_800567E4 = L1_func_80054AC8;
func_80056914 = L1_func_80054BF8;
func_80056AC0 = L1_func_80054DA4;
func_80056B54 = L1_func_80054E38;
func_80056C50 = L1_func_80054F34;
func_80056CF8 = L1_func_80054FDC;
func_80056D7C = L1_func_80055060;
func_80056E88 = L1_func_8005516C;
func_80056F20 = L1_func_80055204;
func_80056FB8 = L1_func_8005529C;
func_80057018 = L1_func_800552FC;
func_80057078 = L1_func_8005535C;
func_800570DC = L1_func_800553C0;
func_8005722C = L1_func_80055510;
func_800572B4 = L1_func_80055598;
func_8005738C = L1_func_80055670;
func_800574E4 = L1_func_800557C8;
PROVIDE(L1_func_800557F4 = func_80057510);
PROVIDE(func_80057510 = L1_func_800557F4);
func_80057530 = L1_func_80055814;
PROVIDE(L1_func_80055878 = func_80057594);
PROVIDE(func_80057594 = L1_func_80055878);
PROVIDE(L1_func_80055BA8 = func_800578C4);
PROVIDE(func_800578C4 = L1_func_80055BA8);
func_80057B40 = L1_func_80055E24;
func_80057C74 = L1_func_80055F58;
func_80057D70 = L1_func_80056054;
func_80057E2C = L1_func_80056110;
PROVIDE(L1_func_80056154 = func_80057E70);
PROVIDE(func_80057E70 = L1_func_80056154);
func_80058074 = L1_func_80056358;
func_800580D8 = L1_func_800563BC;
func_80058160 = L1_func_80056444;
func_800581C8 = L1_func_800564AC;
func_80058254 = L1_func_80056538;
func_8005828C = L1_func_80056570;
func_800582F8 = L1_func_800565DC;
func_80058330 = L1_func_80056614;
func_80058414 = L1_func_800566F8;
func_80058558 = L1_func_8005683C;
func_800585B0 = L1_func_80056894;
func_80058A38 = L1_func_80056D1C;
func_80058CAC = L1_func_80056F90;
func_80058D90 = L1_func_80057074;
func_80058E14 = L1_func_800570F8;
func_80058EB0 = L1_func_80057194;
func_80058ED4 = L1_func_800571B8;
PROVIDE(L1_func_800572F4 = func_80059010);
PROVIDE(func_80059010 = L1_func_800572F4);
func_800590C0 = L1_func_800573A4;
func_8005912C = L1_func_80057410;
func_80059158 = L1_func_8005743C;
func_80059198 = L1_func_8005747C;
func_80059318 = L1_func_800575FC;
L1_func_80057648 = func_80059364;
PROVIDE(L1_func_80057750 = func_8005946C);
PROVIDE(func_8005946C = L1_func_80057750);
func_800597CC = L1_func_80057AB0;
L1_func_80057AD8 = func_800597F4;
func_80059848 = L1_func_80057B2C;
L1_func_80057B94 = func_800598B0;
L1_func_80057BFC = func_80059918;
L1_func_80058694 = func_8005A3B0;
func_8005A578 = L1_func_8005885C;
func_8005A774 = L1_func_80058A58;
func_8005A82C = L1_func_80058B10;
func_8005A888 = L1_func_80058B6C;
L1_func_80058D00 = func_8005AA1C;
func_8005AA78 = L1_func_80058D5C;
func_8005AB18 = L1_func_8005AD6C;
L1_func_8005ADB0 = func_8005AB5C;
PROVIDE(L1_func_8005ADD4 = func_8005AB80);
PROVIDE(func_8005AB80 = L1_func_8005ADD4);
PROVIDE(L1_func_8005AEF8 = func_8005ACA4);
PROVIDE(func_8005ACA4 = L1_func_8005AEF8);
func_8005B2B4 = L1_func_8005B508;
func_8005B330 = L1_func_8005B584;
func_8005B358 = L1_func_8005B5AC;
func_8005B478 = L1_func_8005B6CC;
func_8005B518 = L1_func_8005B76C;
func_8005B568 = L1_func_8005B7BC;
func_8005B618 = L1_func_8005B86C;
func_8005B718 = L1_func_8005B96C;
func_8005B7DC = L1_func_8005BA30;
func_8005B894 = L1_func_8005BAE8;
func_8005BA2C = L1_func_8005BC80;
func_8005BC9C = L1_func_8005BEF0;
func_8005BEB8 = L1_func_8005C10C;
PROVIDE(L1_func_8005C214 = func_8005BFC0);
PROVIDE(func_8005BFC0 = L1_func_8005C214);
func_8005C0E8 = L1_func_8005C33C;
L1_func_8005C864 = func_8005C610;
L1_func_8005C894 = func_8005C640;
func_8005C670 = L1_func_8005C8C4;
func_8005C7CC = L1_func_8005CA20;
L1_func_8005CB38 = func_8005C8CC;
func_8005CB54 = L1_func_8005CED0;
func_8005CC4C = L1_func_8005CFC8;
func_8005CF34 = L1_func_8005D2B0;
L1_func_8005D58C = func_8005D210;
func_8005D248 = L1_func_8005D5C4;
func_8005D2B4 = L1_func_8005D630;
L1_func_8005D654 = func_8005D2D8;
func_8005D318 = L1_func_8005D694;
func_8005D3E4 = L1_func_8005D760;
L1_func_8005DA90 = func_8005D714;
PROVIDE(L1_func_8005DB7C = func_8005D800);
PROVIDE(func_8005D800 = L1_func_8005DB7C);
func_8005D8C4 = L1_func_8005DC40;
L1_func_8005DF40 = func_8005DBC4;
func_8005DC00 = L1_func_8005DF7C;
func_8005DCA4 = L1_func_8005E020;
func_8005DEAC = L1_func_8005E228;
PROVIDE(L1_func_8005E424 = func_8005E0A8);
PROVIDE(func_8005E0A8 = L1_func_8005E424);
func_8005E760 = L1_func_8005EADC;
func_8005E7F0 = L1_func_8005EB6C;
func_8005EA50 = L1_func_8005EC84;
func_8005EBC4 = L1_func_8005EE6C;
L1_func_8005F3B0 = func_8005F100;
func_8005F638 = L1_func_8005F93C;
func_8005F7A4 = L1_func_8005FAA8;
L1_func_80060094 = func_8005FD80;
func_80060128 = L1_func_8006043C;
func_800601F8 = L1_func_800604B0;
L1_func_8006060C = func_80060354;
func_8006035C = L1_func_80060614;
func_800604E0 = L1_func_80060798;
func_8006062C = L1_func_800608E4;
func_80060808 = L1_func_80060AC0;
L1_func_80060E28 = func_80060B44;
L1_func_80061018 = func_80060CE8;
PROVIDE(L1_func_80061068 = func_80060D7C);
PROVIDE(func_80060D7C = L1_func_80061068);
func_800612DC = L1_func_800615C8;
L1_func_80061700 = func_80061414;
func_8006141C = L1_func_80061708;
L1_func_80061DC0 = func_80061A14;
func_80061B18 = L1_func_80061EC4;
func_80061F48 = L1_func_80062300;
L1_func_80062394 = func_80061FDC;
func_800623CC = L1_func_80062784;
func_800627B0 = L1_func_80062B68;
func_80062B80 = L1_func_80062F38;
PROVIDE(L1_func_80062FAC = func_80062BF4);
PROVIDE(func_80062BF4 = L1_func_80062FAC);
func_80062E78 = L1_func_800632AC;
func_80062F7C = L1_func_800633B0;
func_8006308C = L1_func_800634C0;
func_80063284 = L1_func_800636B8;
func_8006337C = L1_func_800637B0;
L1_func_80063858 = func_80063424;
L1_func_80063ADC = func_800636A8;
func_800636EC = L1_func_80063B20;
func_80063878 = L1_func_80063CAC;
func_8006390C = L1_func_80063D40;
L1_func_80063ED4 = func_80063AA0;
L1_func_80063EF8 = func_80063AC4;
func_80063B00 = L1_func_80063F34;
func_80063F44 = L1_func_8006412C;
func_80064034 = L1_func_8006421C;
func_800641B4 = L1_func_8006439C;
func_800642F4 = L1_func_800644DC;
func_80064434 = L1_func_8006461C;
func_80064478 = L1_func_80064660;
func_80064664 = L1_func_8006484C;
func_80064828 = L1_func_80064A10;
func_80064A40 = L1_func_80064C28;
L1_func_80064E40 = func_80064C58;
func_80064ECC = L1_func_80065510;
L1_func_80065588 = func_80064F44;
func_80064F74 = L1_func_800655B8;
func_80064FD0 = L1_func_80065614;
L1_func_800658B4 = func_80065270;
L1_func_80065928 = func_800652E4;
PROVIDE(L1_func_80065A20 = func_800653DC);
PROVIDE(func_800653DC = L1_func_80065A20);
func_80065A54 = L1_func_80066098;
func_80065C64 = L1_func_800662A8;
func_80065E74 = L1_func_800664B8;
func_800660C0 = L1_func_80066704;
L1_func_8006692C = func_800662E8;
func_800663C4 = L1_func_800669A4;
L1_func_80066A60 = func_80066480;
L1_func_80069318 = func_8006A278;
L1_func_80069328 = func_8006A288;
L1_func_800693DC = func_8006A30C;
L1_func_8006981C = func_8006D5B8;
L1_func_80069850 = func_8006D6A4;
L1_func_800698B8 = func_8006D720;
L1_func_8006B1DC = func_8006F120;
L1_func_8006B230 = func_8006F174;
func_8006F1B8 = L1_func_8006B274;
PROVIDE(L1_func_8006B2C4 = func_8006F208);
PROVIDE(func_8006F208 = L1_func_8006B2C4);
func_800703D8 = L1_func_8006C494;
func_80070838 = L1_func_8006C8F4;
PROVIDE(L1_func_8006CB88 = func_80070ACC);
PROVIDE(func_80070ACC = L1_func_8006CB88);
PROVIDE(L1_func_8006CEA4 = func_80070DE8);
PROVIDE(func_80070DE8 = L1_func_8006CEA4);
func_80071304 = L1_func_8006D3C0;
PROVIDE(L1_func_8006D470 = func_800713B4);
PROVIDE(func_800713B4 = L1_func_8006D470);
func_80071C64 = L1_func_8006DD20;
PROVIDE(L1_func_8006E054 = func_80071F98);
PROVIDE(func_80071F98 = L1_func_8006E054);
func_80072564 = L1_func_8006E620;
func_80072924 = L1_func_8006E9E0;
func_80072C00 = L1_func_8006ECBC;
func_80072DEC = L1_func_8006EEA8;
func_80072F78 = L1_func_8006F034;
PROVIDE(L1_func_8006F168 = func_800730AC);
PROVIDE(func_800730AC = L1_func_8006F168);
func_800735F0 = L1_func_8006F6AC;
PROVIDE(L1_func_8006F784 = func_800736C8);
PROVIDE(func_800736C8 = L1_func_8006F784);
func_800738E8 = L1_func_8006F9A4;
func_80073998 = L1_func_8006FA54;
func_80073A48 = L1_func_8006FB04;
func_80073E18 = L1_func_8006FED4;
func_80073FB4 = L1_func_80070070;
func_80074210 = L1_func_800702CC;
func_800744EC = L1_func_800705A8;
func_80074634 = L1_func_800706F0;
func_8007557C = L1_func_80071638;
PROVIDE(L1_func_80072190 = func_800760D4);
PROVIDE(func_800760D4 = L1_func_80072190);
func_80076350 = L1_func_8007240C;
PROVIDE(L1_func_800726D0 = func_80076614);
PROVIDE(func_80076614 = L1_func_800726D0);
func_80076C8C = L1_func_80072D48;
func_80076D6C = L1_func_80072E28;
PROVIDE(L1_func_8007369C = func_800775E0);
PROVIDE(func_800775E0 = L1_func_8007369C);
func_8007832C = L1_func_800743E8;
PROVIDE(L1_func_800746D0 = func_80078614);
PROVIDE(func_80078614 = L1_func_800746D0);
func_80078F2C = L1_func_80074FE8;
func_80079204 = L1_func_800752C0;
PROVIDE(L1_func_800752E8 = func_8007922C);
PROVIDE(func_8007922C = L1_func_800752E8);
L1_func_800753A4 = func_800792E8;
L1_func_800753F0 = func_80079334;
func_800793A0 = L1_func_8007545C;
func_80079500 = L1_func_800755BC;
func_800795C0 = L1_func_8007567C;
func_80079704 = L1_func_800757C0;
L1_func_800758C0 = func_80079804;
func_80079834 = L1_func_800758F0;
func_80079864 = L1_func_80075920;
func_80079C8C = L1_func_80075D48;
func_80079DE0 = L1_func_80075E9C;
func_80079E64 = L1_func_80075F20;
L1_func_80075FA0 = func_80079EE4;
L1_func_80075FE4 = func_80079F28;
func_80079F58 = L1_func_80076014;
L1_func_800760B4 = func_80079FF8;
func_8007A048 = L1_func_80076104;
func_8007A0C8 = L1_func_80076184;
L1_func_80076A8C = func_8007A934;
L1_func_80077764 = func_8007B6A4;
L1_func_800779FC = func_8007B93C;
L1_func_80077CCC = func_8007BC0C;
L1_func_80077D50 = func_8007BC90;
L1_func_80077FC4 = func_8007BF04;
L1_func_800781B4 = func_8007C0F4;
L1_func_80078534 = func_8007C474;
L1_func_800785A8 = func_8007C4E8;
L1_func_800787FC = func_8007C73C;
L1_func_80078840 = func_8007C780;
L1_func_800788E0 = func_8007C820;
L1_func_800792B8 = func_8007D700;
L1_func_80079390 = func_8007D7D8;
L1_func_800793EC = func_8007D90C;
L1_func_800794A0 = func_8007D9D0;
L1_func_800794D4 = func_8007DA04;
L1_func_80079588 = func_8007DAB8;
L1_func_800797A8 = func_8007DD40;
L1_func_8007980C = func_8007DD90;
L1_func_800798A8 = func_8007DE84;
L1_func_800798D4 = func_8007DEB0;
L1_func_80079B94 = func_8007E170;
L1_func_80079C04 = func_8007E1E0;
L1_func_80079C54 = func_8007E230;
L1_func_80079D84 = func_8007E360;
L1_func_80079DB8 = func_8007E3AC;
L1_func_80079E10 = func_8007E404;
L1_func_80079F84 = func_8007E578;
L1_func_8007A040 = func_8007E66C;
L1_func_8007A17C = func_8007E7A8;
L1_func_8007A1B0 = func_8007E7DC;
L1_func_8007A1FC = func_8007E828;
L1_func_8007A4E4 = func_8007EB10;
L1_func_8007A554 = func_8007EB80;
L1_func_8007A580 = func_8007EBAC;
L1_func_8007A614 = func_8007EC40;
L1_func_8007A694 = func_8007ECC0;
L1_func_8007AA94 = func_8007F0C0;
L1_func_8007AC7C = func_8007F2A8;
L1_func_8007CE30 = func_8008145C;
L1_func_8007D184 = func_800817B0;
L1_func_8007D1E8 = func_80081814;
L1_func_8007D260 = func_8008188C;
L1_func_8007D2B4 = func_800818E0;
L1_func_8007D914 = func_80081F40;
L1_func_8007DA88 = func_800820B4;
L1_func_8007DE50 = func_8008247C;
L1_func_8007E610 = func_80082C3C;
L1_func_8007E6A4 = func_80082CD0;
L1_func_8007EB7C = func_800831A8;
L1_func_8007EC78 = func_800832A4;
L1_func_8007ED98 = func_800833C4;
L1_func_8007EE34 = func_80083460;
L1_func_8007EE64 = func_80083490;
L1_func_8007EEBC = func_800834E8;
L1_func_8007EECC = func_800834F8;
L1_func_8007F040 = func_8008366C;
L1_func_8007F0D8 = func_80083704;
L1_func_8007F140 = func_8008376C;
L1_func_8007F25C = func_80083888;
L1_func_8007F2EC = func_80083918;
L1_func_8007F34C = func_80083978;
L1_func_8007F414 = func_80083A40;
L1_func_8007F4C0 = func_80083AEC;
L1_func_8007F530 = func_80083B5C;
L1_func_8007F5F0 = func_80083C1C;
L1_func_8007FAE8 = func_80084114;
L1_func_8007FCE0 = func_8008430C;
L1_func_8007FF50 = func_8008457C;
L1_func_8007FF70 = func_8008459C;
L1_func_80080008 = func_80084634;
L1_func_800800A0 = func_800846CC;
L1_func_800800BC = func_800846E8;
L1_func_8008013C = func_80084768;
L1_func_80080154 = func_80084780;
L1_func_80080234 = func_80084860;
L1_func_80080464 = func_80084A90;
L1_func_800806A0 = func_80084CCC;
L1_func_80080920 = func_80084F4C;
L1_func_80080944 = func_80084F70;
L1_func_80080958 = func_80084F84;
L1_func_80080998 = func_80084FC4;
L1_func_800809E0 = func_8008500C;
L1_func_80080A10 = func_8008503C;
L1_func_80080A34 = func_80085060;
L1_func_80080CE4 = func_80085310;
L1_func_80080F44 = func_80085570;
L1_func_80081094 = func_800856C0;
L1_func_800811D0 = func_800857FC;
L1_func_80081204 = func_80085830;
L1_func_80081348 = func_80085974;
L1_func_800813E8 = func_80085A14;
L1_func_80081410 = func_80085A3C;
L1_func_80081448 = func_80085A74;
L1_func_80081458 = func_80085A84;
L1_func_800814CC = func_80085AF8;
L1_func_800815A0 = func_80085BCC;
L1_func_80081A08 = func_80086034;
L1_func_80081B74 = func_800861A0;
L1_func_80081C54 = func_80086280;
L1_func_80081C84 = func_800862B0;
L1_func_80081CE4 = func_80086310;
L1_func_80081D14 = func_80086340;
L1_func_80082638 = func_80086C64;
L1_func_800828AC = func_80086ED8;
L1_func_8008297C = func_80086FA8;
L1_func_80082B64 = func_80087190;
L1_func_80082D00 = func_8008732C;
L1_func_80082E04 = func_80087430;
L1_func_80082ED8 = func_80087504;
L1_func_80082EE8 = func_80087514;
L1_func_80082EF8 = func_80087524;
L1_func_80082F04 = func_80087530;
L1_func_80082F24 = func_80087550;
L1_func_80082F44 = func_80087570;
L1_func_80082F64 = func_80087590;
L1_func_80082F78 = func_800875A4;
L1_func_80082F8C = func_800875B8;
L1_func_800830C8 = func_800876F4;
L1_func_800831FC = func_80087828;
L1_func_80083348 = func_80087974;
L1_func_80083368 = func_80087994;
L1_func_80083388 = func_800879B4;
L1_func_800833AC = func_800879D8;
L1_func_800833CC = func_800879F8;
L1_func_800834D0 = func_80087AFC;
L1_func_80083F14 = func_80088540;
L1_func_80084134 = func_80088760;
L1_func_80084164 = func_80088790;
L1_func_80084194 = func_800887C0;
L1_func_800841C4 = func_800887F0;
L1_func_800841F8 = func_80088824;
L1_func_80084228 = func_80088854;
L1_func_80084238 = func_80088864;
L1_func_80084250 = func_8008887C;
L1_func_80084328 = func_80088954;
L1_func_800844F8 = func_80088B24;
L1_func_80084640 = func_80088C6C;
L1_func_800846E0 = func_80088D0C;
L1_func_80084758 = func_80088D84;
L1_func_80084E0C = func_80089438;
L1_func_800855BC = func_80089BE8;
L1_func_8008571C = func_80089D48;
L1_func_8008596C = func_80089F98;
L1_func_800859B8 = func_80089FE4;
L1_func_80085B5C = func_8008A188;
L1_func_80085BD0 = func_8008A1FC;
L1_func_800865BC = func_8008ABE8;
L1_func_80086688 = func_8008ACB4;
L1_func_80086780 = func_8008ADAC;
L1_func_80086854 = func_8008AE80;
L1_func_8008688C = func_8008AEB8;
L1_func_800868D4 = func_8008AF00;
L1_func_80086928 = func_8008AF54;
L1_func_80086A40 = func_8008B06C;
L1_func_80086A6C = func_8008B098;
L1_func_80086AD4 = func_8008B100;
L1_func_80086C64 = func_8008B290;
L1_func_80086D30 = func_8008B35C;
L1_func_80086D74 = func_8008B3A0;
L1_func_800870A8 = func_8008B6D4;
L1_func_80087198 = func_8008B7C4;
L1_func_800873A8 = func_8008B9D4;
L1_func_80087620 = func_8008BC4C;
L1_func_800876B0 = func_8008BCDC;
L1_func_800876E4 = func_8008BD10;
L1_func_80088C44 = func_8008D270;
L1_func_8008A404 = func_8008EA30;
L1_func_8008A904 = func_8008EF30;
L1_func_8008C5A4 = func_80090BE0;
L1_func_8008C5C4 = func_80090C00;
L1_func_8008C5D8 = func_80090C14;
L1_func_8008C638 = func_80090C74;
L1_func_8008CCB8 = func_80091064;
L1_func_8008D2EC = func_80091698;
L1_func_8008DAAC = func_80091E58;
L1_func_8008DB68 = func_80091F14;
L1_func_8008DBDC = func_80091F88;
L1_func_8008E03C = func_80092678;
L1_func_8008E378 = func_800929B4;
L1_func_8008FAE8 = func_80094114;
L1_func_80090004 = func_80094630;
L1_func_80090164 = func_80094790;
L1_func_80090880 = func_80094EAC;
L1_func_80090B00 = func_8009512C;
L1_func_80090CC0 = func_800952EC;
L1_func_80090D7C = func_800953A8;
L1_func_80090FFC = func_80095628;
L1_func_80091080 = func_800956AC;
L1_func_800910C4 = func_800956F0;
L1_func_80091168 = func_80095794;
L1_func_800911C0 = func_800957EC;
L1_func_800911E8 = func_80095814;
L1_func_80091210 = func_8009583C;
L1_func_80091450 = func_80095A7C;
L1_func_80091480 = func_80095AAC;
L1_func_800919DC = func_80096008;
L1_func_80091C5C = func_80096288;
L1_func_80091F24 = func_80096550;
L1_func_80092330 = func_8009695C;
L1_func_80092404 = func_80096A30;
L1_func_800924F4 = func_80096B20;
L1_func_800926D4 = func_80096D00;
L1_func_8009283C = func_80096E68;
L1_func_8009293C = func_80096F68;
L1_func_80092A34 = func_80097060;
L1_func_80092F24 = func_80097550;
L1_func_80092F5C = func_80097588;
L1_func_8009302C = func_80097658;
L1_func_80093C64 = func_80098290;
L1_func_80093E24 = func_80098450;
L1_func_80093F24 = func_80098550;
L1_func_80093F4C = func_80098578;
L1_func_80094434 = func_80098A60;
L1_func_80094440 = func_80098A6C;
L1_func_800944C4 = func_80098AF0;
L1_func_80094734 = func_80098D60;
L1_func_8009476C = func_80098D98;
L1_func_80094840 = func_80098E6C;
L1_func_800948E8 = func_80098F14;
L1_func_80094CE0 = func_8009930C;
L1_func_80094D48 = func_80099374;
L1_func_80094D64 = func_80099390;
L1_func_80094E2C = func_80099458;
L1_func_80094EC4 = func_800994F0;
L1_func_80094F18 = func_80099544;
L1_func_80094F78 = func_800995A4;
L1_func_80094F98 = func_800995C4;
L1_func_80094FAC = func_800995D8;
L1_func_80094FCC = func_800995F8;
L1_func_80094FEC = func_80099618;
L1_func_8009500C = func_80099638;
L1_func_80095104 = func_80099730;
L1_func_800957F0 = func_80099E1C;
L1_func_80095914 = func_80099F40;
L1_func_80095934 = func_80099F60;
L1_func_80095954 = func_80099F80;
L1_func_80095A44 = func_8009A070;
L1_func_80095A64 = func_8009A090;
L1_func_80095D7C = func_8009A3A8;
L1_func_80095ECC = func_8009A4F8;
L1_func_80096270 = func_8009A89C;
L1_func_800963C4 = func_8009A9F0;
L1_func_80096738 = func_8009AD64;
L1_func_800967BC = func_8009ADE8;
L1_func_80096BC0 = func_8009B1EC;
L1_func_80096C54 = func_8009B280;
L1_func_80096C9C = func_8009B2C8;
L1_func_80096F50 = func_8009B57C;
L1_func_80099EB0 = func_8009E4DC;
L1_func_8009A0A0 = func_8009E6CC;
L1_func_8009A1F0 = func_8009E81C;
L1_func_8009A3B0 = func_8009E9DC;
L1_func_8009A9E0 = func_8009F00C;
L1_func_8009AB60 = func_8009F18C;
L1_func_8009B940 = func_8009FF6C;
L1_func_8009BEAC = func_800A04D8;
L1_func_8009BF10 = func_800A053C;
L1_func_8009BFC0 = func_800A05EC;
L1_func_800AACFC = func_800AFE0C;
L1_func_800AAEF8 = func_800B0008;
L1_gPsi = D_800B50AC;
L1_g_Args = D_800B508C;
L1_g_CamPosX = D_800B513C;
L1_g_CamPosY = D_800B5140;
L1_g_CamRotX = D_800B5104;
L1_g_CamTargetX = D_800B50F8;
L1_g_Camera = D_800B50F4;
L1_g_CheatCodeProgress = D_800B5FC0;
L1_g_CheatCodes = D_800A12E8;
L1_g_CutScene = D_800A1328;
L1_g_DebugPageNames = D_800A1480;
L1_g_DebugTextX = D_800A1648;
L1_g_DebugTextY = D_800A164A;
L1_g_DevMenu = D_800E0294;
L1_g_FrameCap = D_800B5F44;
L1_g_FrameRate = D_800A13DC;
L1_g_GodMode = D_800A136A;
L1_g_Invincible = D_800A10B4;
L1_g_MenuUpdateFunc = D_800E17AC;
L1_g_PadAxes = D_800B6304;
L1_g_PadAxesPrev = D_800B6308;
L1_g_PadHeld = D_800B62EC;
L1_g_PadPressed = D_800B62F4;
L1_g_PadPrev = D_800B62F8;
L1_g_Player = D_800B5FA8;
L1_g_Projection = D_800B51A0;
L1_g_Weapons = D_800B51B4;
L1_gteMIMefunc = func_80090AC0;
L1_gte_rotate_z_matrix = func_80097690;
L1_jtbl_800A6F68 = jtbl_800ABEC8;
L1_jtbl_800A7168 = jtbl_800AC0C8;
L1_jtbl_800A74B0 = jtbl_800AC410;
L1_jtbl_800A7764 = jtbl_800AC6C4;
L1_jtbl_800A8028 = jtbl_800AD008;
L1_jtbl_800A8088 = jtbl_800AD068;
L1_jtbl_800A859C = jtbl_800AD57C;
L1_jtbl_800A8AC0 = jtbl_800ADAA4;
L1_jtbl_800A8B20 = jtbl_800ADB04;
L1_jtbl_800A8BE8 = jtbl_800ADBCC;
L1_jtbl_800A98E4 = jtbl_800AE9CC;
L1_jtbl_800A9AEC = jtbl_800AEBF8;
L1_jtbl_800A9DF8 = jtbl_800AEF04;
L1_jtbl_800AA190 = jtbl_800AF29C;
L1_jtbl_800AA1F0 = jtbl_800AF2FC;
L1_jtbl_800AA270 = jtbl_800AF37C;
L1_jtbl_800AA2A8 = jtbl_800AF3B4;
L1_jtbl_800AA330 = jtbl_800AF43C;
L1_jtbl_800AA540 = jtbl_800AF64C;
L1_jtbl_800AA560 = jtbl_800AF66C;
L1_jtbl_800AA780 = jtbl_800AF88C;
L1_jtbl_800AA860 = jtbl_800AF96C;
L1_jtbl_800AA880 = jtbl_800AF98C;
L1_malloc3 = func_8008FF60;
L1_memchr = func_80090220;
L1_memcpy = func_80090AB0;
L1_memmove = func_80095A04;
L1_memset = func_80090AA0;
L1_note2pitch = func_800939A4;
L1_note2pitch2 = func_800939F0;
L1_printf = func_800834C8;
L1_rand = func_800860C0;
L1_ratan2 = func_80090620;
L1_rcos = func_8009E86C;
L1_rsin = func_8009E90C;
L1_setRC2wait = func_80099670;
L1_setjmp = func_80097288;
L1_sin_1 = func_8009E948;
L1_sprintf = func_800863A0;
L1_start = func_8002C8E4;
L1_startIntrDMA = func_800972A8;
L1_startIntrVSync = func_80097148;
L1_strcat = func_8008850C;
L1_strcmp = func_80090260;
L1_strcpy = func_800862D0;
L1_strlen = func_800862A0;
L1_strncmp = func_80097138;
L1_strncpy = func_80092C24;
L1_strstr = func_800903A0;
L1_strtok = func_80090270;
L1_strtol = func_80090390;
L1_toupper = func_80086190;
L1_vmNoiseOff = func_80094AEC;
L1_vmNoiseOn = func_80093434;
L1_func_80026F30 = func_80026F30;
L1_func_80027248 = func_80027248;
L2_D_800A03C0 = D_800A07B4;
L2_D_800A0425 = D_800A0819;
L2_D_800A0426 = D_800A081A;
L2_D_800A0438 = D_800A082C;
L2_D_800A0C92 = D_800A1086;
L2_D_800A0CC0 = D_800A10B4;
L2_D_800A0CC4 = D_800A10B8;
L2_D_800A0CD4 = D_800A10C8;
L2_D_800A0CDC = D_800A10D0;
L2_D_800A0CF7 = D_800A10EB;
L2_D_800A0CFC = D_800A10F0;
L2_D_800A0EF4 = D_800A12E8;
L2_D_800A0F34 = D_800A1328;
L2_D_800A0F8C = D_800A1384;
L2_D_800A0F9C = D_800A1394;
L2_D_800A0FAB = D_800A13A3;
L2_D_800A0FD0 = D_800A13C8;
L2_D_800A0FE0 = D_800A13D8;
L2_D_800A0FE4 = D_800A13DC;
L2_D_800A106C = D_800A1464;
L2_D_800A1070 = D_800A1468;
L2_D_800A119C = D_800A3338;
L2_D_800A11F0 = D_800A15DC;
L2_D_800A11FE = D_800A15EA;
L2_D_800A1200 = D_800A15EC;
L2_D_800A1204 = D_800A15F0;
L2_D_800A1208 = D_800A15F4;
L2_D_800A1230 = D_800A161C;
L2_D_800A123C = D_800A1628;
L2_D_800A1240 = D_800A162C;
L2_D_800A1242 = D_800A162E;
L2_D_800A1244 = D_800A1630;
L2_D_800A1248 = D_800A1634;
L2_D_800A124C = D_800A1638;
L2_D_800A1254 = D_800A1640;
L2_D_800A1258 = D_800A1644;
L2_D_800A125A = D_800A1646;
L2_D_800A125C = D_800A1648;
L2_D_800A125E = D_800A164A;
L2_D_800A1268 = D_800A1654;
L2_D_800A1278 = D_800A1664;
L2_D_800A12CC = D_800A16B8;
L2_D_800A12D0 = D_800A16BC;
L2_D_800A12D4 = D_800A16C0;
L2_D_800A1344 = D_800A1730;
L2_D_800A1346 = D_800A1732;
L2_D_800A1366 = D_800A1752;
L2_D_800A14A8 = D_800A189C;
L2_D_800A14B0 = D_800A18A8;
L2_D_800A14B4 = D_800A18AC;
L2_D_800A14B8 = D_800A18B0;
L2_D_800A14BC = D_800A18B4;
L2_D_800A1628 = D_800A1A40;
L2_D_800A162C = D_800A1A44;
L2_D_800A1634 = D_800A1A54;
L2_D_800A1640 = D_800A1A60;
L2_D_800A167C = D_800A1A9C;
L2_D_800A19A0 = D_800A1DE8;
L2_D_800A1C74 = D_800A20BC;
L2_D_800A1CC4 = D_800A210C;
L2_D_800A1EEC = D_800A2334;
L2_D_800A3E74 = D_800A382C;
L2_D_800A3E8C = D_800A3844;
L2_D_800A3F0C = D_800A3894;
L2_D_800A40AC = D_800A3A34;
L2_D_800AC49C = D_800ABE20;
L2_D_800AC4AC = D_800ABE30;
L2_D_800AC4D4 = D_800ABE58;
L2_D_800AC6FC = D_800AC080;
L2_D_800AC80C = D_800AC190;
L2_D_800AC820 = D_800AC1A4;
L2_D_800AC94C = D_800AC2D0;
L2_D_800ACB1C = D_800AC4A0;
L2_D_800ACB40 = D_800AC4C4;
L2_D_800ACB4C = D_800AC4D0;
L2_D_800ACB88 = D_800AC50C;
L2_D_800ACB9C = D_800AC520;
L2_D_800ACC18 = D_800AC59C;
L2_D_800ACC2C = D_800AC5B0;
L2_D_800ACC40 = D_800AC5C4;
L2_D_800ACC54 = D_800AC5D8;
L2_D_800ACC7C = D_800AC600;
L2_D_800ACC88 = D_800AC60C;
L2_D_800ACC9C = D_800AC620;
L2_D_800ACF24 = D_800AC8A8;
L2_D_800ACF38 = D_800AC8BC;
L2_D_800ACF48 = D_800AC8CC;
L2_D_800ACF5C = D_800AC8E0;
L2_D_800ACF70 = D_800AC8F4;
L2_D_800ACF94 = D_800AC918;
L2_D_800ACFCC = D_800AC950;
L2_D_800AD400 = D_800ACDA0;
L2_D_800AD428 = D_800ACDC8;
L2_D_800AD820 = D_800AD1C0;
L2_D_800ADA08 = D_800AD3A8;
L2_D_800ADA50 = D_800AD3F0;
L2_D_800ADA58 = D_800AD3F8;
L2_D_800ADC24 = D_800AD5C4;
L2_D_800ADD00 = D_800AD6A0;
L2_D_800ADE00 = D_800AD7A4;
L2_D_800ADE10 = D_800AD7B4;
L2_D_800ADE20 = D_800AD7C4;
L2_D_800ADE6C = D_800AD810;
L2_D_800ADE80 = D_800AD824;
L2_D_800ADEB8 = D_800AD85C;
L2_D_800AE5A4 = D_800ADED8;
L2_D_800AE8D8 = D_800AE20C;
L2_D_800AE8EC = D_800AE220;
L2_D_800AE914 = D_800AE248;
L2_D_800AE968 = D_800AE29C;
L2_D_800AF09C = D_800AE7A8;
L2_D_800AF0A0 = D_800AE7AC;
L2_D_800AF140 = D_800AE84C;
L2_D_800AF160 = D_800AE86C;
L2_D_800AF188 = D_800AE894;
L2_D_800AF198 = D_800AE8A4;
L2_D_800AF1B0 = D_800AE8BC;
L2_D_800AF28C = D_800AE998;
L2_D_800B0F58 = D_800B0650;
L2_D_800B0FF8 = D_800B06F0;
L2_D_800B0FFC = D_800B06F4;
L2_D_800B1018 = D_800B0710;
L2_D_800B102C = D_800B0724;
L2_D_800B117C = D_800B0854;
L2_D_800B118C = D_800B0864;
L2_D_800B1DC4 = D_800B149C;
L2_D_800B1F2C = D_800B15E8;
L2_D_800B1F30 = D_800B15EC;
L2_D_800B1FA0 = D_800B165C;
L2_D_800B4E3C = D_800B3EB8;
L2_D_800B4E6C = D_800B3EE8;
L2_D_800B56B4 = D_800B4730;
L2_D_800B5738 = D_800B47B4;
L2_D_800B5739 = D_800B47B5;
L2_D_800B5F3C = D_800B4FB8;
L2_D_800B5F49 = D_800B4FC5;
L2_D_800B5F4A = D_800B4FC6;
L2_D_800B5F4B = D_800B4FC7;
L2_D_800B5F50 = D_800B4FCC;
L2_D_800B5FB4 = D_800B5030;
L2_D_800B6010 = D_800B508C;
L2_D_800B6014 = D_800B5090;
L2_D_800B6030 = D_800B50AC;
L2_D_800B6038 = D_800B50B4;
L2_D_800B603C = D_800B50B8;
L2_D_800B6054 = D_800B50D0;
L2_D_800B6058 = D_800B50D4;
L2_D_800B605C = D_800B50D8;
L2_D_800B6060 = D_800B50DC;
L2_D_800B6064 = D_800B50E0;
L2_D_800B60C0 = D_800B513C;
L2_D_800B6104 = D_800B5180;
L2_D_800B6120 = D_800B519C;
L2_D_800B6138 = D_800B51B4;
L2_D_800B6A94 = D_800B5A58;
L2_D_800B6C78 = D_800B5C3C;
L2_D_800B6C8C = D_800B5C50;
L2_D_800B6C94 = D_800B5C58;
L2_D_800B6CA8 = D_800B5C6C;
L2_D_800B6D4C = D_800B5D10;
L2_D_800B6F80 = D_800B5F44;
L2_D_800B6F88 = D_800B5F4C;
L2_D_800B6F8C = D_800B5F50;
L2_D_800B6FC4 = D_800B5F88;
L2_D_800B6FE4 = D_800B5FA8;
L2_D_800B6FFC = D_800B5FC0;
L2_D_800B7084 = D_800B6048;
L2_D_800B70F4 = D_800B60B8;
L2_D_800B7114 = D_800B60D8;
L2_D_800B7140 = D_800B6104;
L2_D_800B7160 = D_800B6124;
L2_D_800B7170 = D_800B6134;
L2_D_800B7284 = D_800B6248;
L2_D_800B7288 = D_800B624C;
L2_D_800B72A4 = D_800B6268;
L2_D_800B72B4 = D_800B6278;
L2_D_800B72B8 = D_800B627C;
L2_D_800B72C8 = D_800B628C;
L2_D_800B7318 = D_800B62DC;
L2_D_800B7324 = D_800B62E8;
L2_D_800B7328 = D_800B62EC;
L2_D_800B7330 = D_800B62F4;
L2_D_800B7334 = D_800B62F8;
L2_D_800B7338 = D_800B62FC;
L2_D_800B733C = D_800B6300;
L2_D_800B7340 = D_800B6304;
L2_D_800B7344 = D_800B6308;
L2_D_800BF408 = D_800BE3CC;
L2_D_800BF46C = D_800BE430;
L2_D_800C625C = D_800CAFE0;
L2_D_800CD020 = D_800D7B64;
L2_D_800D5318 = D_800DFE5C;
L2_D_800D55A0 = D_800E00E4;
L2_D_800D55A4 = D_800E00E8;
L2_D_800D55A8 = D_800E00EC;
L2_D_800D5670 = D_800E01B4;
L2_D_800D58E0 = D_800E0424;
L2_D_800D6B48 = D_800E17AC;
L2_D_800D6B70 = D_800E17D4;
L2_D_800D6BB8 = D_800E181C;
L2_D_800D6D20 = D_800E1984;
L2_D_800D6D54 = D_800E19B8;
L2_D_800D6D6C = D_800E19D0;
L2_D_800D6D84 = D_800E19E8;
L2_D_800D6D9C = D_800E1A00;
L2_D_800D70B4 = D_800E1D18;
L2_D_800D8500 = D_800E3164;
L2_D_800D85DC = D_800E3240;
L2_D_800D869C = D_800E3300;
L2_D_800D8840 = D_800E34A4;
L2_D_800DA12C = D_800E4D90;
L2_D_800DA410 = D_800E5074;
L2_D_800DA414 = D_800E5078;
L2_D_800DA894 = D_800E54F8;
L2_D_800DA8AC = D_800E5510;
L2_D_800DAD80 = D_800E59E4;
L2_D_800DADD0 = D_800E5A34;
L2_D_800DAE20 = D_800E5A84;
L2_D_800DAE24 = D_800E5A88;
L2_D_800DAE44 = D_800E5AA8;
L2_D_800DB3D8 = D_800E603C;
L2_D_800DB67C = D_800E62E0;
L2_D_800DB7FC = D_800E6460;
L2_D_800DB814 = D_800E6478;
L2_D_800DBA48 = D_800E66AC;
L2_D_800DBA6C = D_800E66D0;
L2_D_800DBA70 = D_800E66D4;
L2_D_800DBA98 = D_800E66FC;
L2_D_800DCAE0 = D_800E7730;
L2_D_800DCD68 = D_800E79B8;
L2_D_800E0068 = D_800EB938;
L2_D_800E006C = D_800EB93C;
L2_D_800E0070 = D_800EB940;
L2_D_800E0074 = D_800EB944;
L2_D_800E0078 = D_800EB948;
L2_D_800E007C = D_800EB94C;
L2_D_800E0080 = D_800EB950;
L2_D_800E0084 = D_800EB954;
L2_D_800E0088 = D_800EB958;
L2_D_800E008C = D_800EB95C;
L2_D_800E00E4 = D_800EB9B4;
L2_D_800E00E8 = D_800EB9B8;
L2_D_800E00EC = D_800EB9BC;
L2_D_800E01B0 = D_800EBA80;
L2_D_800E01B4 = D_800EBA84;
L2_D_800E01B8 = D_800EBA88;
L2_D_800E01BC = D_800EBA8C;
L2_D_800E01C4 = D_800EBA94;
L2_D_800E01C8 = D_800EBA98;
L2_D_800E01D0 = D_800EBAA0;
L2_D_800E01D4 = D_800EBAA4;
L2_D_800E01DC = D_800EBAAC;
L2_D_800E0228 = D_800EBAF8;
L2_D_800E022C = D_800EBAFC;
L2_D_800E030C = D_800EBBDC;
L2_D_800E0310 = D_800EBBE0;
L2_D_800E04FC = D_800EBDCC;
L2_D_800E0500 = D_800EBDD0;
L2_D_800E0504 = D_800EBDD4;
L2_D_800E1510 = D_800ECDE0;
L2_D_800E1514 = D_800ECDE4;
L2_D_800E1554 = D_800ECE24;
L2_D_800E1628 = D_800ECEF8;
L2_D_800E6694 = D_800F1150;
L2_D_800E680C = D_800F12C8;
L2_D_800E6810 = D_800F12CC;
L2_D_800F4010 = D_800FF2CC;
L2_D_800F415C = D_800FF418;
L2_D_800F4160 = D_800FF41C;
L2_D_800F430C = D_800FF5C8;
L2_D_800F4458 = D_800FF714;
L2_D_800F44DC = D_800FF798;
L2_D_80100D94 = D_8010C050;
L2_func_8002680C = func_8002680C;
func_800268CC = L2_func_800268CC;
func_80026B00 = L2_func_80026B00;
func_80026C14 = L2_func_80026C14;
func_80026C38 = L2_func_80026C38;
L2_func_80026C90 = func_80026C90;
L2_func_80026F5C = func_80026F30;
L2_func_80027274 = func_80027248;
func_800274F4 = L2_func_80027520;
func_800287C8 = L2_func_800288B4;
L2_func_800288F4 = func_80028808;
L2_func_800289D8 = func_800288EC;
L2_func_80028B20 = func_80028A34;
func_80028A9C = L2_func_80028B88;
func_80029114 = L2_func_80029200;
L2_func_80029378 = func_8002928C;
L2_func_80029A30 = func_80029944;
L2_func_8002A7E4 = func_8002A6F8;
L2_func_8002A8E8 = func_8002A7FC;
func_8002ABA0 = L2_func_8002AC8C;
func_8002AECC = L2_func_8002AFB8;
func_8002AFE4 = L2_func_8002B0D0;
func_8002B140 = L2_func_8002B22C;
L2_func_8002B268 = func_8002B17C;
L2_func_8002B464 = func_8002B378;
func_8002BC10 = L2_func_8002BCFC;
func_8002BEC0 = L2_func_8002BFAC;
L2_func_8002C330 = func_8002C244;
func_8002C3B4 = L2_func_8002C4A0;
func_8002C740 = L2_func_8002C82C;
L2_func_8002D39C = func_8002D2B0;
L2_func_8002D6AC = func_8002D5C0;
func_8002DA5C = L2_func_8002DB48;
func_8002E168 = L2_func_8002E24C;
func_8002E1C0 = L2_func_8002E2A4;
func_8002E218 = L2_func_8002E2FC;
func_8002E2A8 = L2_func_8002E38C;
L2_func_8002E3F8 = func_8002E314;
L2_func_8002E440 = func_8002E364;
func_8002E42C = L2_func_8002E508;
func_8002E4BC = L2_func_8002E598;
func_8002E518 = L2_func_8002E5F4;
func_8002E5C0 = L2_func_8002E69C;
func_8002F138 = L2_func_8002F214;
func_8002F1A8 = L2_func_8002F284;
func_8002F250 = L2_func_8002F32C;
func_8002F288 = L2_func_8002F364;
func_8002F508 = L2_func_8002F5E4;
L2_func_8002F68C = func_8002F5B0;
func_8002F5D0 = L2_func_8002F6AC;
L2_func_8002F6D4 = func_8002F5F8;
L2_func_8002F814 = func_8002F738;
func_8002FE84 = L2_func_8002FF60;
func_80030384 = L2_func_80030454;
func_800303D4 = L2_func_800304A4;
L2_func_80030504 = func_80030434;
L2_func_80030704 = func_80030634;
L2_func_800307C0 = func_800306F0;
func_80030770 = L2_func_80030840;
func_800308E8 = L2_func_800309B8;
func_80030F30 = L2_func_80031000;
func_80031D94 = L2_func_80031E68;
L2_func_80031F34 = func_80031E60;
func_80031FF4 = L2_func_800320C8;
func_80032020 = L2_func_800320F4;
L2_func_800322F0 = func_8003221C;
func_80032414 = L2_func_800324E8;
L2_func_80032684 = func_800325B0;
func_80032738 = L2_func_8003280C;
L2_func_8003292C = func_80032858;
L2_func_80033254 = func_80033180;
L2_func_80035C7C = func_800359D8;
L2_func_800368C8 = func_8003666C;
func_80037A8C = L2_func_80037CD8;
L2_func_8003815C = func_80037FE0;
L2_func_8003838C = func_80038210;
L2_func_800387C4 = func_80038670;
func_800387DC = L2_func_80038930;
func_80039168 = L2_func_800393F8;
func_800394BC = L2_func_8003974C;
func_800394DC = L2_func_8003976C;
func_80039568 = L2_func_800398F0;
L2_func_80039920 = func_80039598;
func_800396B8 = L2_func_80039A40;
func_80039818 = L2_func_80039BA0;
func_800398D4 = L2_func_80039C5C;
func_80039D88 = L2_func_8003A110;
func_8003A03C = L2_func_8003A3C4;
L2_func_8003A3FC = func_8003A074;
func_8003A1B0 = L2_func_8003A538;
func_8003A278 = L2_func_8003A600;
L2_func_8003AA8C = func_8003A704;
func_8003B384 = L2_func_8003B70C;
L2_func_8003BC0C = func_8003B884;
func_8003D714 = L2_func_8003D98C;
func_800408B8 = L2_func_80040B30;
func_80041718 = L2_func_80041990;
func_80041DE0 = L2_func_80042058;
func_80041E24 = L2_func_8004209C;
func_80041F50 = L2_func_800421C8;
func_80042470 = L2_func_800426E8;
func_80042534 = L2_func_800427AC;
L2_func_80042A08 = func_80042790;
func_800435FC = L2_func_80043874;
L2_func_80043908 = func_80043690;
L2_func_80043AFC = func_80043884;
func_8004399C = L2_func_80043C14;
L2_func_80043C4C = func_800439D4;
L2_func_80043E58 = func_80043BE0;
func_800453AC = L2_func_80045624;
func_80045668 = L2_func_800458C8;
func_80045C28 = L2_func_80045E88;
L2_func_80046098 = func_80045E38;
func_80045F14 = L2_func_80046174;
func_80046478 = L2_func_800466D8;
L2_func_800481FC = func_80047F9C;
L2_func_8004857C = func_8004831C;
func_8004832C = L2_func_8004858C;
func_80048864 = L2_func_80048AC4;
L2_func_80048B04 = func_800488A4;
func_800489BC = L2_func_80048C74;
L2_func_800497E4 = func_80049640;
func_80049ADC = L2_func_80049C80;
func_8004AD90 = L2_func_8004AF34;
func_8004ADD4 = L2_func_8004AF78;
func_8004ADF8 = L2_func_8004AF9C;
func_8004AE2C = L2_func_8004AFD0;
func_8004AE64 = L2_func_8004B008;
func_8004AE74 = L2_func_8004B018;
func_8004B2C8 = L2_func_8004B46C;
func_8004B308 = L2_func_8004B4AC;
func_8004B354 = L2_func_8004B4F8;
func_8004BAD4 = L2_func_8004BC78;
func_8004BB08 = L2_func_8004BCAC;
func_8004BB18 = L2_func_8004BCBC;
func_8004BB30 = L2_func_8004BCD4;
L2_func_8004BE84 = func_8004BCE0;
func_8004BD1C = L2_func_8004BEC0;
func_8004BF98 = L2_func_8004C13C;
func_8004C38C = L2_func_8004C530;
L2_func_8004C604 = func_8004C460;
func_8004CA48 = L2_func_8004CBF4;
func_8004CB18 = L2_func_8004CCC4;
func_8004CD0C = L2_func_8004CEB8;
func_8004CFC8 = L2_func_8004D174;
func_8004D2E0 = L2_func_8004D48C;
L2_func_8004DC58 = func_8004DAAC;
func_8004DE30 = L2_func_8004E0C4;
func_8004DF1C = L2_func_8004E1B0;
func_8004E4B8 = L2_func_8004E88C;
func_8004E7C8 = L2_func_8004EAE8;
func_8004EE98 = L2_func_8004F24C;
L2_func_8004F288 = func_8004EED4;
L2_func_8004F314 = func_8004EF60;
func_8004F274 = L2_func_8004F628;
func_8004F608 = L2_func_8004F9BC;
func_800503DC = L2_func_80050790;
L2_func_80050AA4 = func_800506F0;
func_800509C4 = L2_func_80050D78;
func_80051090 = L2_func_80051444;
L2_func_80054E54 = func_80054C04;
func_80054F38 = L2_func_80055188;
func_80055448 = L2_func_80055698;
func_800554E8 = L2_func_80055738;
func_800555FC = L2_func_8005584C;
func_800556E8 = L2_func_80055938;
func_800557D0 = L2_func_80055A20;
func_80055A3C = L2_func_80055C8C;
func_80055DDC = L2_func_800560EC;
func_8005821C = L2_func_80058570;
func_80059448 = L2_func_8005979C;
func_80059740 = L2_func_80059A94;
func_800597F4 = L2_func_80059B48;
func_800598B0 = L2_func_80059C04;
func_80059918 = L2_func_80059C6C;
L2_func_80059EF0 = func_80059B9C;
L2_func_8005AE6C = func_8005AB18;
func_8005AB5C = L2_func_8005AEB0;
L2_func_8005BA6C = func_8005B718;
L2_func_8005C964 = func_8005C610;
L2_func_8005C994 = func_8005C640;
L2_func_8005C9C4 = func_8005C670;
L2_func_8005CB20 = func_8005C7CC;
func_8005CBC4 = L2_func_8005CF80;
func_8005D210 = L2_func_8005D5CC;
L2_func_8005D670 = func_8005D2B4;
func_8005D714 = L2_func_8005DAD0;
func_8005DBC4 = L2_func_8005DF80;
func_8005EA80 = L2_func_8005ECF4;
func_8005EB54 = L2_func_8005EDC8;
L2_func_8005EF48 = func_8005ECD4;
L2_func_8005F374 = func_8005F100;
func_8005F4D8 = L2_func_8005F74C;
L2_func_8005FBBC = func_8005F948;
func_8005FC50 = L2_func_8005FEC4;
func_8005FDD8 = L2_func_8006004C;
L2_func_80060594 = func_800601F8;
L2_func_8006066C = func_800602D0;
L2_func_800606F8 = func_8006035C;
func_800608A4 = L2_func_80060C40;
func_80060B28 = L2_func_80060EC4;
func_80060B44 = L2_func_80060EE0;
L2_func_8006114C = func_80060D7C;
L2_func_800616AC = func_800612DC;
L2_func_800617EC = func_8006141C;
func_800614C0 = L2_func_80061890;
func_800615E8 = L2_func_800619F0;
func_80061B8C = L2_func_80061F64;
L2_func_800622F4 = func_80061F48;
L2_func_80063630 = func_80063284;
func_80063424 = L2_func_800637D0;
func_800636A8 = L2_func_80063A54;
L2_func_80063A98 = func_800636EC;
func_80063AA0 = L2_func_80063E4C;
L2_func_80063EFC = func_80063B50;
func_80064C58 = L2_func_80064C38;
func_80064F44 = L2_func_80064F24;
L2_func_80064FB0 = func_80064FD0;
func_80065270 = L2_func_80065250;
func_80066480 = L2_func_800663FC;
L2_func_8006B2F0 = func_8006A7A8;
L2_func_8006BC94 = func_8006E744;
L2_func_8006BE78 = func_8006D6A4;
func_8006E75C = L2_func_8006D4B8;
func_8006F0C4 = L2_func_8006E920;
func_8006F0EC = L2_func_8006E948;
func_8006F120 = L2_func_8006E97C;
func_8006F174 = L2_func_8006E9D0;
L2_func_80072648 = func_80072DEC;
L2_func_800727D4 = func_80072F78;
func_80078D2C = L2_func_80078588;
func_80078D7C = L2_func_800785D8;
func_800792E8 = L2_func_80078B44;
func_80079334 = L2_func_80078B90;
func_800797E4 = L2_func_80079040;
func_80079810 = L2_func_8007906C;
func_80079E50 = L2_func_800796AC;
func_80079EE4 = L2_func_80079740;
func_80079F28 = L2_func_80079784;
func_80079FF8 = L2_func_80079854;
func_8007A120 = L2_func_8007997C;
func_8007A2D0 = L2_func_80079B2C;
func_8007A6C0 = L2_func_80079F1C;
func_8007A934 = L2_func_8007A190;
func_8007AA44 = L2_func_8007A2A0;
func_8007AAF8 = L2_func_8007A354;
L2_func_8007A4D4 = func_8007AC78;
func_8007AE1C = L2_func_8007A678;
L2_func_8007D6E0 = func_8007DAB8;
L2_func_8007E33C = func_8007E7A8;
L2_func_8007F098 = func_8007F51C;
L2_func_8007F210 = func_8007F694;
L2_func_8007F36C = func_8007F7F0;
L2_func_8007F520 = func_8007F9A4;
L2_func_8007FF68 = func_800803EC;
L2_func_800800D4 = func_80080558;
L2_func_80080238 = func_800806BC;
L2_func_800803A8 = func_8008082C;
L2_func_80080518 = func_8008099C;
L2_func_80080660 = func_80080AE4;
L2_func_800807A0 = func_80080C24;
L2_func_80080930 = func_80080DB4;
L2_func_80080AC8 = func_80080F4C;
L2_func_80080C04 = func_80081088;
L2_func_80080D44 = func_800811C8;
L2_func_80080E8C = func_80081310;
L2_func_80081390 = func_80081814;
L2_func_80083044 = func_800834C8;
L2_func_80083064 = func_800834E8;
L2_func_80083074 = func_800834F8;
L2_func_80083280 = func_80083704;
L2_func_80083494 = func_80083918;
L2_func_800855E0 = func_80085A64;
L2_func_800855F0 = func_80085A74;
L2_func_80085600 = func_80085A84;
L2_func_80085C3C = func_800860C0;
L2_func_80085D5C = func_800861E0;
L2_func_80085E1C = func_800862A0;
L2_func_80085E4C = func_800862D0;
L2_func_80085E7C = func_80086300;
L2_func_80085EDC = func_80086360;
L2_func_80085F1C = func_800863A0;
L2_func_80086EA8 = func_8008732C;
L2_func_80086FAC = func_80087430;
L2_func_800870CC = func_80087550;
L2_func_8008710C = func_80087590;
L2_func_80087120 = func_800875A4;
L2_func_80087134 = func_800875B8;
L2_func_800873A4 = func_80087828;
L2_func_80087530 = func_800879B4;
L2_func_80087574 = func_800879F8;
L2_func_8008836C = func_800887F0;
L2_func_80089774 = func_80089BF8;
L2_func_80089AF4 = func_80089F78;
L2_func_80089BB4 = func_8008A038;
L2_func_80089D04 = func_8008A188;
L2_func_80089D44 = func_8008A1C8;
L2_func_80089D64 = func_8008A1E8;
L2_func_80089D94 = func_8008A218;
L2_func_80089F64 = func_8008A3E8;
L2_func_8008A014 = func_8008A498;
L2_func_8008A0C4 = func_8008A548;
L2_func_8008A724 = func_8008ABA8;
L2_func_8008AAD0 = func_8008AF54;
L2_func_8008C0C0 = func_8008C544;
L2_func_8008C48C = func_8008C910;
L2_func_8008C6CC = func_8008CB50;
L2_func_8008C90C = func_8008CD90;
L2_func_8008CBBC = func_8008D040;
L2_func_8008CE0C = func_8008D290;
L2_func_8008D02C = func_8008D4B0;
L2_func_8008D33C = func_8008D7C0;
L2_func_8008D66C = func_8008DAF0;
L2_func_8008D92C = func_8008DDB0;
L2_func_8008DB6C = func_8008DFF0;
L2_func_8008DCEC = func_8008E170;
L2_func_8008DF2C = func_8008E3B0;
L2_func_8008E09C = func_8008E520;
L2_func_8008E28C = func_8008E710;
L2_func_8008E5CC = func_8008EA50;
L2_func_8008E7EC = func_8008EC70;
L2_func_8008EAFC = func_8008EF80;
L2_func_8008ECEC = func_8008F170;
L2_func_8008EEEC = func_8008F370;
L2_func_8008F21C = func_8008F6A0;
L2_func_8008F49C = func_8008F920;
L2_func_8008F74C = func_8008FBD0;
L2_func_8008FCDC = func_80090160;
L2_func_8008FDAC = func_80090230;
L2_func_8008FF2C = func_800903B0;
L2_func_8008FFCC = func_80090450;
L2_func_8009003C = func_800904C0;
L2_func_800900AC = func_80090530;
L2_func_800912A4 = func_80091698;
L3_D_800B37BC = D_800B6124;
func_800600FC = L3_func_800600D8;
func_800791D4 = L3_func_80076430;
D_1F8003D4 = 0x1F8003D4;
D_1F8003D8 = 0x1F8003D8;
D_1F8003DC = 0x1F8003DC;
L1_D_800AB540_b = L1_D_800AB540;
L1_D_800AB540_c = L1_D_800AB540;
L1_D_8009CE24 = L1_D_8009CE20 + 4;
