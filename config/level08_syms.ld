/* Generated by tools/port_level.py: LEVEL01 names (L1_ prefix) bound to level08's symbols. */
L1_AddPrim = func_8008BB08;
L1_ApplyBonusCheats = func_8002E0B8;
L1_ApplyMatrix = func_8008E7E8;
L1_ApplyMatrixLV = func_8007CAD8;
L1_ApplyMatrixSV = func_8009096C;
L1_Args_GetFlag115 = func_8002E260;
L1_CALLOC3_OBJ_54 = func_8008DCCC;
func_80050270 = L1_Camera_ResetZoom;
func_8002C364 = L1_CdBin_Disable;
func_8002C3A8 = L1_CdBin_Enable;
func_8002C4C4 = L1_CdBin_SetLevel;
L1_CdInit = func_80087DD0;
L1_CdSearchFile = func_80085934;
L1_ChangeClearPAD = func_80095090;
L1_ChangeClearRCnt = func_800950A0;
func_8002DD30 = L1_Cheat_CheckCodes;
L1_Cheat_DoAction = func_8002DAA4;
L1_Cheat_ResetCodes = func_8002E208;
L1_CloseEvent = func_800837FC;
L1_D_80082604 = func_800849C8;
L1_D_80095808 = D_80097C5C;
L1_D_8009C180 = D_8009E5D4;
L1_D_8009C184 = D_8009E5D8;
L1_D_8009C1EC = D_8009E640;
L1_D_8009C1ED = D_8009E641;
L1_D_8009C1EE = D_8009E642;
L1_D_8009C1F0 = D_8009E644;
L1_D_8009C1F4 = D_8009E648;
L1_D_8009C1F8 = D_8009E64C;
L1_D_8009C200 = D_8009E654;
L1_D_8009C204 = D_8009E658;
L1_D_8009C208 = D_8009E65C;
L1_D_8009C20A = D_8009E65E;
L1_D_8009C20C = D_8009E660;
L1_D_8009CA56 = D_8009EEAA;
L1_D_8009CA58 = D_8009EEAC;
L1_D_8009CA59 = D_8009EEAD;
L1_D_8009CA5A = D_8009EEAE;
L1_D_8009CA5C = D_8009EEB0;
L1_D_8009CA5E = D_8009EEB2;
L1_D_8009CA60 = D_8009EEB4;
L1_D_8009CA64 = D_8009EEB8;
L1_D_8009CA68 = D_8009EEBC;
L1_D_8009CA70 = D_8009EEC4;
L1_D_8009CA74 = D_8009EEC8;
L1_D_8009CA78 = D_8009EECC;
L1_D_8009CA7C = D_8009EED0;
L1_D_8009CA80 = D_8009EED4;
L1_D_8009CA84 = D_8009EED8;
L1_D_8009CA8C = D_8009EEE0;
L1_D_8009CA90 = D_8009EEE4;
L1_D_8009CA94 = D_8009EEE8;
L1_D_8009CA98 = D_8009EEEC;
L1_D_8009CA9C = D_8009EEF0;
L1_D_8009CAA0 = D_8009EEF4;
L1_D_8009CAA4 = D_8009EEF8;
L1_D_8009CAA8 = D_8009EEFC;
L1_D_8009CAAC = D_8009EF00;
L1_D_8009CABD = D_8009EF11;
L1_D_8009CABE = D_8009EF12;
L1_D_8009CABF = D_8009EF13;
L1_D_8009CAC0 = D_8009EF14;
L1_D_8009CAC4 = D_8009EF18;
L1_D_8009CACC = D_8009EF20;
L1_D_8009CAD0 = D_8009EF24;
L1_D_8009CD00 = D_8009F154;
L1_D_8009CD30 = D_8009F184;
L1_D_8009CD3C = D_8009F190;
L1_D_8009CD4C = D_8009F1A0;
L1_D_8009CD50 = D_8009F1A4;
L1_D_8009CD54 = D_8009F1A8;
L1_D_8009CD58 = D_8009F1AC;
L1_D_8009CD5C = D_8009F1B0;
L1_D_8009CD5E = D_8009F1B2;
L1_D_8009CD60 = D_8009F1B4;
L1_D_8009CD62 = D_8009F1B6;
L1_D_8009CD6C = D_8009F1C0;
L1_D_8009CD6E = D_8009F1C2;
L1_D_8009CD78 = D_8009F1CC;
L1_D_8009CD80 = D_8009F1D4;
L1_D_8009CD88 = D_8009F1DC;
L1_D_8009CD8C = D_8009F1E0;
L1_D_8009CD98 = D_8009F1EC;
L1_D_8009CDA0 = D_8009F1F4;
L1_D_8009CDA2 = D_8009F1F6;
L1_D_8009CDA8 = D_8009F1FC;
L1_D_8009CDD0 = D_8009F224;
L1_D_8009CDDC = D_8009F230;
L1_D_8009CDE4 = D_8009F238;
L1_D_8009CDE5 = D_8009F239;
L1_D_8009CDE6 = D_8009F23A;
L1_D_8009CDE7 = D_8009F23B;
L1_D_8009CDE8 = D_8009F23C;
L1_D_8009CDEC = D_8009F240;
L1_D_8009CDF0 = D_8009F244;
L1_D_8009CE20 = D_8009F274;
L1_D_8009CE38 = D_8009F28C;
L1_D_8009CEB0 = D_8009F304;
L1_D_8009CEE0 = D_8009F334;
L1_D_8009CF10 = D_8009F364;
L1_D_8009CF14 = D_8009F368;
L1_D_8009CF2C = D_8009F380;
L1_D_8009CF30 = D_8009F384;
L1_D_8009CF34 = D_8009F388;
L1_D_8009CF48 = D_8009F39C;
L1_D_8009CF4C = D_8009F3A0;
L1_D_8009CF50 = D_8009F3A4;
L1_D_8009CF54 = D_8009F3A8;
L1_D_8009CF68 = D_8009F3B8;
L1_D_8009CF6C = D_8009F3BC;
L1_D_8009CF70 = D_8009F3C0;
L1_D_8009CF74 = D_8009F3C4;
L1_D_8009CF7C = D_8009F3CC;
L1_D_8009CF80 = D_8009F3D0;
L1_D_8009CF8C = D_8009F3DC;
L1_D_8009CF90 = D_8009F3E0;
L1_D_8009CF94 = D_8009F3E4;
L1_D_8009CF98 = D_8009F3E8;
L1_D_8009CF9C = D_8009F3EC;
L1_D_8009CFA8 = D_8009F3F8;
L1_D_8009CFB0 = D_8009F400;
L1_D_8009CFB4 = D_8009F404;
L1_D_8009CFBB = D_8009F40B;
L1_D_8009CFBE = D_8009F40E;
L1_D_8009CFC0 = D_8009F410;
L1_D_8009CFC4 = D_8009F414;
L1_D_8009CFC8 = D_8009F418;
L1_D_8009CFCC = D_8009F41C;
L1_D_8009CFE4 = D_8009F434;
L1_D_8009CFE8 = D_8009F438;
L1_D_8009CFEC = D_8009F43C;
L1_D_8009CFF0 = D_8009F440;
L1_D_8009CFF6 = D_8009F446;
L1_D_8009CFF8 = D_8009F448;
L1_D_8009CFFC = D_8009F44C;
L1_D_8009D000 = D_8009F450;
L1_D_8009D002 = D_8009F452;
L1_D_8009D004 = D_8009F454;
L1_D_8009D008 = D_8009F458;
L1_D_8009D00C = D_8009F45C;
L1_D_8009D00E = D_8009F45E;
L1_D_8009D010 = D_8009F460;
L1_D_8009D014 = D_8009F464;
L1_D_8009D018 = D_8009F468;
L1_D_8009D01A = D_8009F46A;
L1_D_8009D020 = D_8009F470;
L1_D_8009D038 = D_8009F488;
L1_D_8009D03C = D_8009F48C;
L1_D_8009D040 = D_8009F490;
L1_D_8009D084 = D_8009F4D4;
L1_D_8009D088 = D_8009F4D8;
L1_D_8009D09C = D_8009F4EC;
L1_D_8009D0FC = D_8009F54C;
L1_D_8009D104 = D_8009F554;
L1_D_8009D106 = D_8009F556;
L1_D_8009D108 = D_8009F558;
L1_D_8009D10A = D_8009F55A;
L1_D_8009D10C = D_8009F55C;
L1_D_8009D124 = D_8009F574;
L1_D_8009D130 = D_8009F580;
L1_D_8009D26C = D_8009F6BC;
L1_D_8009D270 = D_8009F6C0;
L1_D_8009D274 = D_8009F6C4;
L1_D_8009D280 = D_8009F6D0;
L1_D_8009D2A8 = D_8009F6F8;
L1_D_8009D2AC = D_8009F6FC;
L1_D_8009D2B0 = D_8009F700;
L1_D_8009D35C = D_8009F828;
L1_D_8009D368 = D_8009F834;
L1_D_8009D36C = D_8009F838;
L1_D_8009D374 = D_8009F840;
L1_D_8009D384 = D_8009F850;
L1_D_8009D394 = D_8009F860;
L1_D_8009D3A4 = D_8009F870;
L1_D_8009D3A8 = D_8009F874;
L1_D_8009D3AC = D_8009F878;
L1_D_8009D3B0 = D_8009F87C;
L1_D_8009D3BC = D_8009F888;
L1_D_8009D3F0 = D_8009F8BC;
L1_D_8009D3F4 = D_8009F8C0;
L1_D_8009D3F8 = D_8009F8C4;
L1_D_8009D3FC = D_8009F8C8;
L1_D_8009D5A8 = D_8009FA84;
L1_D_8009D5AC = D_8009FA88;
L1_D_8009D5F8 = D_8009FAEC;
L1_D_8009D5FC = D_8009FAF0;
L1_D_8009D660 = D_8009FB54;
L1_D_8009D7A4 = D_8009FC98;
L1_D_8009D7A8 = D_8009FC9C;
L1_D_8009D8B8 = D_8009FDAC;
L1_D_8009D8D4 = D_8009FDC8;
L1_D_8009D8E4 = D_8009FDD0;
L1_D_8009D8E8 = D_8009FDD4;
L1_D_8009D8F0 = D_8009FDDC;
L1_D_8009D8F4 = D_8009FDE0;
L1_D_8009D8F8 = D_8009FDE4;
L1_D_8009D8FC = D_8009FDE8;
L1_D_8009D900 = D_8009FDEC;
L1_D_8009D904 = D_8009FDF0;
L1_D_8009D90C = D_8009FDF8;
L1_D_8009D910 = D_8009FDFC;
L1_D_8009D914 = D_8009FE00;
L1_D_8009D918 = D_8009FE04;
L1_D_8009D91C = D_8009FE08;
L1_D_8009D920 = D_8009FE0C;
L1_D_8009D924 = D_8009FE10;
L1_D_8009D928 = D_8009FE14;
L1_D_8009DB50 = D_800A0028;
L1_D_8009E480 = D_800A153C;
L1_D_8009E490 = D_800A1540;
L1_D_8009E908 = D_800A1888;
L1_D_8009E9A8 = D_800A1970;
L1_D_8009E9B4 = D_800A197C;
L1_D_8009E9B8 = D_800A1980;
L1_D_8009E9BC = D_800A1984;
L1_D_8009E9C0 = D_800A1988;
L1_D_8009E9D8 = D_800A19A0;
L1_D_8009EADC = D_800A1B60;
L1_D_8009EB5C = D_800A1BE0;
L1_D_8009EB7C = D_800A1C00;
L1_D_8009EB88 = D_800A1C0C;
L1_D_8009EB8C = D_800A1C10;
L1_D_8009EE0C = D_800A1E90;
L1_D_8009EE3D = D_800A1EC1;
L1_D_8009EE8C = D_800A1F10;
L1_D_8009EEC4 = D_800A1F48;
L1_D_8009EEC8 = D_800A1F4C;
L1_D_8009EED0 = D_800A1F54;
L1_D_8009EED4 = D_800A1F58;
L1_D_8009EED8 = D_800A1F5C;
L1_D_8009EEF0 = D_800A1F78;
L1_D_8009EEF4 = D_800A1F7C;
L1_D_8009EEF8 = D_800A1F80;
L1_D_8009EF1C = D_800A1FA4;
L1_D_8009EF94 = D_800A201C;
L1_D_8009EF98 = D_800A2020;
L1_D_8009EF9C = D_800A2024;
L1_D_8009EFA0 = D_800A2028;
L1_D_8009EFA4 = D_800A202C;
L1_D_8009EFA8 = D_800A2030;
L1_D_8009EFC8 = D_800A2050;
L1_D_8009F008 = D_800A2090;
L1_D_8009F00C = D_800A2094;
L1_D_8009F010 = D_800A2098;
L1_D_8009F012 = D_800A209A;
L1_D_8009F013 = D_800A209B;
L1_D_8009F014 = D_800A209C;
L1_D_8009F016 = D_800A209E;
L1_D_8009F018 = D_800A20A0;
L1_D_8009F01C = D_800A20A4;
L1_D_8009F07C = D_800A2104;
L1_D_8009F084 = D_800A210C;
L1_D_8009F090 = D_800A2118;
L1_D_8009F09C = D_800A2124;
L1_D_8009F0BC = D_800A2144;
L1_D_8009F0D0 = D_800A2158;
L1_D_8009F0E4 = D_800A216C;
L1_D_8009F0E6 = D_800A216E;
L1_D_8009F10C = D_800A2194;
L1_D_8009F114 = D_800A219C;
L1_D_8009F118 = D_800A21A0;
L1_D_8009F11C = D_800A21A4;
L1_D_8009F120 = D_800A21A8;
L1_D_8009F124 = D_800A21AC;
L1_D_8009F128 = D_800A21B0;
L1_D_8009F12C = D_800A21B4;
L1_D_8009F130 = D_800A21B8;
L1_D_8009F134 = D_800A21BC;
L1_D_8009F138 = D_800A21C0;
L1_D_8009F13C = D_800A21C4;
L1_D_8009F140 = D_800A21C8;
L1_D_8009F144 = D_800A21CC;
L1_D_8009F148 = D_800A21D0;
L1_D_8009F14C = D_800A21D4;
L1_D_8009F150 = D_800A21D8;
L1_D_8009F160 = D_800A21E8;
L1_D_8009F170 = D_800A21F8;
L1_D_8009F178 = D_800A2200;
L1_D_8009F17C = D_800A2204;
L1_D_8009F18C = D_800A2214;
L1_D_8009F190 = D_800A2218;
L1_D_8009F194 = D_800A221C;
L1_D_8009F198 = D_800A2220;
L1_D_8009F1B0 = D_800A2238;
L1_D_8009F230 = D_800A22B8;
L1_D_8009F234 = D_800A22BC;
L1_D_8009F248 = D_800A22D0;
L1_D_8009F24C = D_800A22D4;
L1_D_8009F250 = D_800A22D8;
L1_D_8009F254 = D_800A22DC;
L1_D_8009F2B8 = D_800A2340;
L1_D_8009F2BA = D_800A2342;
L1_D_8009F2BC = D_800A2344;
L1_D_8009F2E8 = D_800A2370;
L1_D_8009F2F4 = D_800A237C;
L1_D_800A0340 = D_800A33C8;
L1_D_800A0344 = D_800A33CC;
L1_D_800A0348 = D_800A33D0;
L1_D_800A034C = D_800A33D4;
L1_D_800A0350 = D_800A33D8;
L1_D_800A0370 = D_800A33F8;
L1_D_800A4370 = D_800A73F8;
L1_D_800A4374 = D_800A73FC;
L1_D_800A4378 = D_800A7400;
L1_D_800A437C = D_800A7404;
L1_D_800A4380 = D_800A7408;
L1_D_800A4382 = D_800A740A;
L1_D_800A4384 = D_800A740C;
L1_D_800A4390 = D_800A7418;
L1_D_800A4394 = D_800A741C;
L1_D_800A43B0 = D_800A7438;
L1_D_800A43C8 = D_800A7450;
L1_D_800A43CC = D_800A7454;
L1_D_800A43D0 = D_800A7458;
L1_D_800A43D4 = D_800A745C;
L1_D_800A43D8 = D_800A7460;
L1_D_800A43DC = D_800A7464;
L1_D_800A43E0 = D_800A7468;
L1_D_800A43E4 = D_800A746C;
L1_D_800A43E8 = D_800A7470;
L1_D_800A43EC = D_800A7474;
L1_D_800A43F0 = D_800A7478;
L1_D_800A43F4 = D_800A747C;
L1_D_800A43F8 = D_800A7480;
L1_D_800A43FC = D_800A7484;
L1_D_800A4400 = D_800A7488;
L1_D_800A4404 = D_800A748C;
L1_D_800A4408 = D_800A7490;
L1_D_800A440C = D_800A7494;
L1_D_800A4410 = D_800A7498;
L1_D_800A4414 = D_800A749C;
L1_D_800A4418 = D_800A74A0;
L1_D_800A441C = D_800A74A4;
L1_D_800A4420 = D_800A74A8;
L1_D_800A4428 = D_800A74B0;
L1_D_800A442C = D_800A74B4;
L1_D_800A4430 = D_800A74B8;
L1_D_800A4440 = D_800A74C8;
L1_D_800A4450 = D_800A74D8;
L1_D_800A4460 = D_800A74E8;
L1_D_800A446C = D_800A74F4;
L1_D_800A4470 = D_800A74F8;
L1_D_800A4474 = D_800A74FC;
L1_D_800A4478 = D_800A7500;
L1_D_800A447C = D_800A7504;
L1_D_800A45D0 = D_800A7658;
L1_D_800A45D4 = D_800A765C;
L1_D_800A45D8 = D_800A7660;
L1_D_800A4EA0 = D_800A7F28;
L1_D_800A4FD8 = D_800A8060;
L1_D_800A4FDC = D_800A8064;
L1_D_800A4FF0 = D_800A8078;
L1_D_800A5000 = D_800A8088;
L1_D_800A5010 = D_800A8098;
L1_D_800A56A0 = D_800A8728;
L1_D_800A5834 = D_800A88BC;
L1_D_800A59D0 = D_800A8A58;
L1_D_800A59D4 = D_800A8A5C;
L1_D_800A59D8 = D_800A8A60;
L1_D_800A59DC = D_800A8A64;
L1_D_800A59E0 = D_800A8A68;
L1_D_800A5B60 = D_800A8BE8;
L1_D_800A5B6C = D_800A8BF4;
L1_D_800A5B90 = D_800A8C18;
L1_D_800A5BA8 = D_800A8C30;
L1_D_800A5CB0 = D_800A8D38;
L1_D_800A5CB4 = D_800A8D3C;
L1_D_800A5CB8 = D_800A8D40;
L1_D_800A5CBC = D_800A8D44;
L1_D_800A5CC0 = D_800A8D48;
L1_D_800A5CC8 = D_800A8D50;
L1_D_800A5CCC = D_800A8D54;
L1_D_800A5CD0 = D_800A8D58;
L1_D_800A5CD4 = D_800A8D5C;
L1_D_800A5CD8 = D_800A8D60;
L1_D_800A5CDC = D_800A8D64;
L1_D_800A5CE0 = D_800A8D68;
L1_D_800A5CE4 = D_800A8D6C;
L1_D_800A5CE8 = D_800A8D70;
L1_D_800A5CEC = D_800A8D74;
L1_D_800A5CF0 = D_800A8D78;
L1_D_800A5D00 = D_800A8D88;
L1_D_800A5D04 = D_800A8D8C;
L1_D_800A5D08 = D_800A8D90;
L1_D_800A5D18 = D_800A8DA0;
L1_D_800A5D1C = D_800A8DA4;
L1_D_800A5D20 = D_800A8DA8;
L1_D_800A5D24 = D_800A8DAC;
L1_D_800A5D28 = D_800A8DB0;
L1_D_800A5D2C = D_800A8DB4;
L1_D_800A5D34 = D_800A8DBC;
L1_D_800A5D44 = D_800A8DCC;
L1_D_800A5D48 = D_800A8DD0;
L1_D_800A5D4C = D_800A8DD4;
L1_D_800A5D7A = D_800A8E02;
L1_D_800A5D7C = D_800A8E04;
L1_D_800A5D80 = D_800A8E08;
L1_D_800A5D98 = D_800A8E20;
L1_D_800A5D9C = D_800A8E24;
L1_D_800A5DA0 = D_800A8E28;
L1_D_800A5DA4 = D_800A8E2C;
L1_D_800A5DA8 = D_800A8E30;
L1_D_800A5DAC = D_800A8E34;
L1_D_800A5DB0 = D_800A8E38;
L1_D_800A5DB4 = D_800A8E3C;
L1_D_800A5DB5 = D_800A8E3D;
L1_D_800A5DBC = D_800A8E44;
L1_D_800A5E3C = D_800A8EC4;
L1_D_800A5E5C = D_800A8EE4;
L1_D_800A5EA0 = D_800A8F28;
L1_D_800A5EDC = D_800A8F64;
L1_D_800A5F5C = D_800A8FE4;
L1_D_800A5FDC = D_800A9064;
L1_D_800A605C = D_800A90E4;
L1_D_800A6060 = D_800A90E8;
L1_D_800A6064 = D_800A90EC;
L1_D_800A6068 = D_800A90F0;
L1_D_800A606C = D_800A90F4;
L1_D_800A6070 = D_800A90F8;
L1_D_800A6074 = D_800A90FC;
L1_D_800A6075 = D_800A90FD;
L1_D_800A6078 = D_800A9100;
L1_D_800A6090 = D_800A9118;
L1_D_800A6094 = D_800A911C;
L1_D_800A6098 = D_800A9120;
L1_D_800A609C = D_800A9124;
L1_D_800A60A0 = D_800A9128;
L1_D_800A60B0 = D_800A9138;
L1_D_800A60D0 = D_800A9158;
L1_D_800A60D4 = D_800A915C;
L1_D_800A60E0 = D_800A9168;
L1_D_800A60E4 = D_800A916C;
L1_D_800A6104 = D_800A918C;
L1_D_800A6110 = D_800A9198;
L1_D_800A6114 = D_800A919C;
L1_D_800A6118 = D_800A91A0;
L1_D_800A611C = D_800A91A4;
L1_D_800A6120 = D_800A91A8;
L1_D_800A6140 = D_800A91C8;
L1_D_800A6170 = D_800A91F8;
L1_D_800A6174 = D_800A91FC;
L1_D_800A6178 = D_800A9200;
L1_D_800A6180 = D_800A9208;
L1_D_800A6198 = D_800A9220;
L1_D_800A62A0 = D_800A9328;
L1_D_800A66A0 = D_800A9728;
L1_D_800A6EB0 = D_800A9F38;
L1_D_800A6ED0 = D_800A9F58;
L1_D_800A6EF8 = D_800A9F80;
L1_D_800A6F00 = D_800A9F88;
L1_D_800A6F1C = D_800A9FA4;
L1_D_800A6F34 = D_800A9FBC;
L1_D_800A6F4C = D_800A9FD4;
L1_D_800A7048 = D_800AA0D0;
L1_D_800A7060 = D_800AA0E8;
L1_D_800A70A0 = D_800AA128;
L1_D_800A70C8 = D_800AA150;
L1_D_800A70D4 = D_800AA15C;
L1_D_800A70F8 = D_800AA180;
L1_D_800A7190 = D_800AA218;
L1_D_800A71EC = D_800AA274;
L1_D_800A71F0 = D_800AA278;
L1_D_800A71F4 = D_800AA27C;
L1_D_800A71F8 = D_800AA280;
L1_D_800A7214 = D_800AA29C;
L1_D_800A7260 = D_800AA2E8;
L1_D_800A7290 = D_800AA318;
L1_D_800A72E8 = D_800AA370;
L1_D_800A7300 = D_800AA388;
L1_D_800A7310 = D_800AA398;
L1_D_800A7320 = D_800AA3A8;
L1_D_800A7324 = D_800AA3AC;
L1_D_800A7330 = D_800AA3B8;
L1_D_800A7344 = D_800AA3CC;
L1_D_800A735C = D_800AA3E4;
L1_D_800A73BC = D_800AA444;
L1_D_800A73D8 = D_800AA460;
L1_D_800A7418 = D_800AA4A0;
L1_D_800A7424 = D_800AA4AC;
L1_D_800A7474 = D_800AA4FC;
L1_D_800A747C = D_800AA504;
L1_D_800A7498 = D_800AA520;
L1_D_800A74D4 = D_800AA55C;
L1_D_800A74E0 = D_800AA568;
L1_D_800A7510 = D_800AA598;
L1_D_800A75D0 = D_800AA658;
L1_D_800A7678 = D_800AA700;
L1_D_800A76A0 = D_800AA728;
L1_D_800A76E4 = D_800AA76C;
L1_D_800A76F8 = D_800AA780;
L1_D_800A770C = D_800AA794;
L1_D_800A7714 = D_800AA79C;
L1_D_800A7728 = D_800AA7B0;
L1_D_800A773C = D_800AA7C4;
L1_D_800A7750 = D_800AA7D8;
L1_D_800A775C = D_800AA7E4;
L1_D_800A7778 = D_800AA800;
L1_D_800A7784 = D_800AA80C;
L1_D_800A77B4 = D_800AA83C;
L1_D_800A77CC = D_800AA854;
L1_D_800A79F0 = D_800AAA78;
L1_D_800A7A0C = D_800AAA94;
L1_D_800A7A24 = D_800AAAAC;
L1_D_800A7A30 = D_800AAAB8;
L1_D_800A7CF0 = D_800AADA8;
L1_D_800A7D08 = D_800AADC0;
L1_D_800A7D20 = D_800AADD8;
L1_D_800A7D44 = D_800AADFC;
L1_D_800A7D64 = D_800AAE1C;
L1_D_800A7D74 = D_800AAE40;
L1_D_800A7D90 = D_800AAE5C;
L1_D_800A7DC0 = D_800AAE8C;
L1_D_800A7DE8 = D_800AAEB4;
L1_D_800A7DF4 = D_800AAEC0;
L1_D_800A7E14 = D_800AAEE0;
L1_D_800A7E34 = D_800AAF00;
L1_D_800A7E50 = D_800AAF1C;
L1_D_800A7E74 = D_800AAF40;
L1_D_800A7E90 = D_800AAF5C;
L1_D_800A7EC4 = D_800AAF90;
L1_D_800A7EFC = D_800AAFC8;
L1_D_800A7F1C = D_800AAFE8;
L1_D_800A7F2C = D_800AAFF8;
L1_D_800A7FF8 = D_800AB0C4;
L1_D_800A8000 = D_800AB0CC;
L1_D_800A80A4 = D_800AB170;
L1_D_800A80B0 = D_800AB17C;
L1_D_800A80BC = D_800AB188;
L1_D_800A80C8 = D_800AB194;
L1_D_800A811C = D_800AB1E8;
L1_D_800A81F8 = D_800AB2C4;
L1_D_800A8210 = D_800AB2DC;
L1_D_800A8224 = D_800AB2F0;
L1_D_800A8238 = D_800AB304;
L1_D_800A824C = D_800AB318;
L1_D_800A8260 = D_800AB32C;
L1_D_800A8274 = D_800AB340;
L1_D_800A8280 = D_800AB34C;
L1_D_800A828C = D_800AB358;
L1_D_800A82B4 = D_800AB380;
L1_D_800A82DC = D_800AB3A8;
L1_D_800A8304 = D_800AB3D0;
L1_D_800A8308 = D_800AB3D4;
L1_D_800A8310 = D_800AB3DC;
L1_D_800A8318 = D_800AB3E4;
L1_D_800A8320 = D_800AB3EC;
L1_D_800A832C = D_800AB3F8;
L1_D_800A8340 = D_800AB40C;
L1_D_800A8370 = D_800AB43C;
L1_D_800A8390 = D_800AB45C;
L1_D_800A83B0 = D_800AB47C;
L1_D_800A83BC = D_800AB488;
L1_D_800A83C8 = D_800AB494;
L1_D_800A83D4 = D_800AB4A0;
L1_D_800A83E0 = D_800AB4AC;
L1_D_800A83E8 = D_800AB4B4;
L1_D_800A83F0 = D_800AB4BC;
L1_D_800A8400 = D_800AB4CC;
L1_D_800A8410 = D_800AB4DC;
L1_D_800A8418 = D_800AB4E4;
L1_D_800A8420 = D_800AB4EC;
L1_D_800A842C = D_800AB4F8;
L1_D_800A8444 = D_800AB510;
L1_D_800A844C = D_800AB518;
L1_D_800A8458 = D_800AB524;
L1_D_800A8460 = D_800AB52C;
L1_D_800A8464 = D_800AB530;
L1_D_800A8468 = D_800AB534;
L1_D_800A8478 = D_800AB544;
L1_D_800A8484 = D_800AB550;
L1_D_800A8490 = D_800AB55C;
L1_D_800A849C = D_800AB568;
L1_D_800A84A8 = D_800AB574;
L1_D_800A84B4 = D_800AB580;
L1_D_800A84B8 = D_800AB584;
L1_D_800A84D0 = D_800AB59C;
L1_D_800A84D8 = D_800AB5A4;
L1_D_800A84E4 = D_800AB5B0;
L1_D_800A84F0 = D_800AB5BC;
L1_D_800A84FC = D_800AB5C8;
L1_D_800A850C = D_800AB5D8;
L1_D_800A851C = D_800AB5E8;
L1_D_800A8528 = D_800AB5F4;
L1_D_800A8534 = D_800AB600;
L1_D_800A8544 = D_800AB610;
L1_D_800A857C = D_800AB648;
L1_D_800A85C4 = D_800AB690;
L1_D_800A85D4 = D_800AB6A0;
L1_D_800A85F8 = D_800AB6C4;
L1_D_800A86C0 = D_800AB7BC;
L1_D_800A86CC = D_800AB7C8;
L1_D_800A8764 = D_800AB890;
L1_D_800A87EC = D_800AB918;
L1_D_800A87F8 = D_800AB924;
L1_D_800A8808 = D_800AB934;
L1_D_800A880C = D_800AB938;
L1_D_800A8820 = D_800AB94C;
L1_D_800A8858 = D_800AB984;
L1_D_800A887C = D_800AB9A8;
L1_D_800A8884 = D_800AB9B0;
L1_D_800A8894 = D_800AB9C0;
L1_D_800A89A4 = D_800ABAF8;
L1_D_800A89F0 = D_800ABB44;
L1_D_800A8A2C = D_800ABB80;
L1_D_800A8AA8 = D_800ABBFC;
L1_D_800A8C08 = D_800ABD5C;
L1_D_800A8C28 = D_800ABD7C;
L1_D_800A8C48 = D_800ABD9C;
L1_D_800A8D14 = D_800ABE68;
L1_D_800A8D44 = D_800ABE88;
L1_D_800A8D58 = D_800ABE9C;
L1_D_800A8F94 = D_800AC05C;
L1_D_800A8FAC = D_800AC074;
L1_D_800A9318 = D_800AC3E0;
L1_D_800A932C = D_800AC3F4;
L1_D_800A9354 = D_800AC41C;
L1_D_800A9390 = D_800AC458;
L1_D_800A9488 = D_800AC514;
L1_D_800A9498 = D_800AC524;
L1_D_800A9794 = D_800AC96C;
L1_D_800A97BC = D_800AC994;
L1_D_800A98C8 = D_800ACB24;
L1_D_800A99D0 = D_800ACC40;
L1_D_800A99EC = D_800ACC5C;
L1_D_800A9A08 = D_800ACC78;
L1_D_800A9A60 = D_800ACCD0;
L1_D_800A9A84 = D_800ACCF4;
L1_D_800A9AA8 = D_800ACD18;
L1_D_800A9B6C = D_800ACDDC;
L1_D_800A9B78 = D_800ACDE8;
L1_D_800A9BE8 = D_800ACE58;
L1_D_800A9C08 = D_800ACE78;
L1_D_800A9C78 = D_800ACEE8;
L1_D_800A9C8C = D_800ACEFC;
L1_D_800A9CA0 = D_800ACF10;
L1_D_800A9CAC = D_800ACF1C;
L1_D_800A9CC0 = D_800ACF30;
L1_D_800A9CC4 = D_800ACF34;
L1_D_800A9CDC = D_800ACF4C;
L1_D_800A9D00 = D_800ACF70;
L1_D_800A9D18 = D_800ACF88;
L1_D_800A9D30 = D_800ACFA0;
L1_D_800A9D44 = D_800ACFB4;
L1_D_800A9D78 = D_800ACFE8;
L1_D_800A9D90 = D_800AD000;
L1_D_800A9EB0 = D_800AD120;
L1_D_800A9EC8 = D_800AD138;
L1_D_800A9EE0 = D_800AD150;
L1_D_800A9F10 = D_800AD180;
L1_D_800A9F2C = D_800AD19C;
L1_D_800A9F44 = D_800AD1B4;
L1_D_800A9F60 = D_800AD1D0;
L1_D_800A9F80 = D_800AD1F0;
L1_D_800A9F8C = D_800AD1FC;
L1_D_800A9F9C = D_800AD20C;
L1_D_800A9FC8 = D_800AD238;
L1_D_800A9FD0 = D_800AD240;
L1_D_800AA000 = D_800AD270;
L1_D_800AA024 = D_800AD294;
L1_D_800AA044 = D_800AD2B4;
L1_D_800AA058 = D_800AD2C8;
L1_D_800AA07C = D_800AD2EC;
L1_D_800AA09C = D_800AD30C;
L1_D_800AA0B8 = D_800AD328;
L1_D_800AA0BC = D_800AD32C;
L1_D_800AA0BE = D_800AD32E;
L1_D_800AA0C0 = D_800AD330;
L1_D_800AA0DC = D_800AD34C;
L1_D_800AA110 = D_800AD380;
L1_D_800AA154 = D_800AD3C4;
L1_D_800AA170 = D_800AD3E0;
L1_D_800AA1B0 = D_800AD420;
L1_D_800AA1D0 = D_800AD440;
L1_D_800AA3C0 = D_800AD630;
L1_D_800AA3E8 = D_800AD658;
L1_D_800AA410 = D_800AD680;
L1_D_800AA438 = D_800AD6A8;
L1_D_800AA444 = D_800AD6B4;
L1_D_800AA46C = D_800AD6DC;
L1_D_800AA494 = D_800AD704;
L1_D_800AA4C0 = D_800AD730;
L1_D_800AA4F0 = D_800AD760;
L1_D_800AA518 = D_800AD788;
L1_D_800AA580 = D_800AD7F0;
L1_D_800AA590 = D_800AD800;
L1_D_800AA5A0 = D_800AD810;
L1_D_800AA5B4 = D_800AD824;
L1_D_800AA70C = D_800AD97C;
L1_D_800AA71C = D_800AD98C;
L1_D_800AA738 = D_800AD9A8;
L1_D_800AA744 = D_800AD9B4;
L1_D_800AA760 = D_800AD9D0;
L1_D_800AA774 = D_800AD9E4;
L1_D_800AA794 = D_800ADA04;
L1_D_800AA79C = D_800ADA0C;
L1_D_800AA7A8 = D_800ADA18;
L1_D_800AA7B0 = D_800ADA20;
L1_D_800AA7C0 = D_800ADA30;
L1_D_800AA800 = D_800ADA70;
L1_D_800AA80C = D_800ADA7C;
L1_D_800AA818 = D_800ADA88;
L1_D_800AA830 = D_800ADAA0;
L1_D_800AA84C = D_800ADABC;
L1_D_800AA8A0 = D_800ADB10;
L1_D_800AA8C8 = D_800ADB38;
L1_D_800AA8E0 = D_800ADB50;
L1_D_800AA8E8 = D_800ADB58;
L1_D_800AA8F0 = D_800ADB60;
L1_D_800AB540 = D_800AE7B0;
L1_D_800AB5E0 = D_800AE850;
L1_D_800AB5E4 = D_800AE854;
L1_D_800AB5E8 = D_800AE858;
L1_D_800AB5EC = D_800AE85C;
L1_D_800AB5F0 = D_800AE860;
L1_D_800AB5F4 = D_800AE864;
L1_D_800AB5F8 = D_800AE868;
L1_D_800AB5FC = D_800AE86C;
L1_D_800AB600 = D_800AE870;
L1_D_800AB604 = D_800AE874;
L1_D_800AB608 = D_800AE878;
L1_D_800AB60C = D_800AE87C;
L1_D_800AB610 = D_800AE880;
L1_D_800AB614 = D_800AE884;
L1_D_800AB618 = D_800AE888;
L1_D_800AB744 = D_800AE9B4;
L1_D_800AB754 = D_800AE9C4;
L1_D_800AC284 = D_800AF4F4;
L1_D_800AC384 = D_800AF5F4;
L1_D_800AC38C = D_800AF5FC;
L1_D_800AC4C8 = D_800AF738;
L1_D_800AC4D0 = D_800AF740;
L1_D_800AC4D8 = D_800AF748;
L1_D_800AC4DC = D_800AF74C;
L1_D_800AC4E0 = D_800AF750;
L1_D_800AC4E4 = D_800AF754;
L1_D_800AC4E8 = D_800AF758;
L1_D_800AC4EC = D_800AF75C;
L1_D_800AC54C = D_800AF7BC;
L1_D_800AC550 = D_800AF7C0;
L1_D_800AE940 = D_800B1BB0;
L1_D_800AE9B8 = D_800B1C28;
L1_D_800AE9C0 = D_800B1C30;
L1_D_800AEB1A = D_800B1D8A;
L1_D_800AEC38 = D_800B1EA8;
L1_D_800AEDA0 = D_800B2010;
L1_D_800AEDA4 = D_800B2014;
L1_D_800AEDA8 = D_800B2018;
L1_D_800AEDAC = D_800B201C;
L1_D_800AEDB0 = D_800B2020;
L1_D_800AEDB4 = D_800B2024;
L1_D_800AEDB8 = D_800B2028;
L1_D_800AEDBC = D_800B202C;
L1_D_800AEDD4 = D_800B2044;
L1_D_800AEDD8 = D_800B2048;
L1_D_800AEDDC = D_800B204C;
L1_D_800AEDE0 = D_800B2050;
L1_D_800AEDE4 = D_800B2054;
L1_D_800AEDE8 = D_800B2058;
L1_D_800AEDEC = D_800B205C;
L1_D_800AEDF0 = D_800B2060;
L1_D_800AEE10 = D_800B2080;
L1_D_800AEE14 = D_800B2084;
L1_D_800AF620 = D_800B2890;
L1_D_800AF624 = D_800B2894;
L1_D_800AF6A4 = D_800B2914;
L1_D_800AF6A5 = D_800B2915;
L1_D_800AF6A8 = D_800B2918;
L1_D_800AFEA8 = D_800B3118;
L1_D_800AFEAC = D_800B311C;
L1_D_800AFEB0 = D_800B3120;
L1_D_800AFEB5 = D_800B3125;
L1_D_800AFEB6 = D_800B3126;
L1_D_800AFEB7 = D_800B3127;
L1_D_800AFEB8 = D_800B3128;
L1_D_800AFEB9 = D_800B3129;
L1_D_800AFEBC = D_800B312C;
L1_D_800AFEC0 = D_800B3130;
L1_D_800AFEC8 = D_800B3138;
L1_D_800AFF2C = D_800B319C;
L1_D_800AFF48 = D_800B31B8;
L1_D_800AFF4C = D_800B31BC;
L1_D_800AFF58 = D_800B31C8;
L1_D_800AFF5C = D_800B31CC;
L1_D_800AFF60 = D_800B31D0;
L1_D_800AFF64 = D_800B31D4;
L1_D_800AFF68 = D_800B31D8;
L1_D_800AFF70 = D_800B31E0;
L1_D_800AFF78 = D_800B31E8;
L1_D_800AFF80 = D_800B31F0;
L1_D_800AFF84 = D_800B31F4;
L1_D_800AFF88 = D_800B31F8;
L1_D_800AFF8C = D_800B31FC;
L1_D_800AFF94 = D_800B3204;
L1_D_800AFF98 = D_800B3208;
L1_D_800AFFA4 = D_800B3214;
L1_D_800AFFA8 = D_800B3218;
L1_D_800AFFAC = D_800B321C;
L1_D_800AFFB0 = D_800B3220;
L1_D_800AFFB4 = D_800B3224;
L1_D_800AFFC0 = D_800B3230;
L1_D_800AFFC4 = D_800B3234;
L1_D_800AFFC8 = D_800B3238;
L1_D_800AFFCC = D_800B323C;
L1_D_800B0014 = D_800B3284;
L1_D_800B0018 = D_800B3288;
L1_D_800B0064 = D_800B32D4;
L1_D_800B0066 = D_800B32D6;
L1_D_800B0070 = D_800B32E0;
L1_D_800B0084 = D_800B32F4;
L1_D_800B008C = D_800B32FC;
L1_D_800B0094 = D_800B3304;
L1_D_800B00A0 = D_800B3310;
L1_D_800B0108 = D_800B3378;
L1_D_800B05AC = D_800B3BB4;
L1_D_800B05B0 = D_800B3BB8;
L1_D_800B077C = D_800B3D84;
L1_D_800B0794 = D_800B3D9C;
L1_D_800B0798 = D_800B3DA0;
L1_D_800B07A4 = D_800B3DAC;
L1_D_800B07A8 = D_800B3DB0;
L1_D_800B07AC = D_800B3DB4;
L1_D_800B07B0 = D_800B3DB8;
L1_D_800B07B4 = D_800B3DBC;
L1_D_800B07B8 = D_800B3DC0;
L1_D_800B07BC = D_800B3DC4;
L1_D_800B07C0 = D_800B3DC8;
L1_D_800B07C4 = D_800B3DCC;
L1_D_800B0804 = D_800B3E0C;
L1_D_800B0808 = D_800B3E10;
L1_D_800B0848 = D_800B3E50;
L1_D_800B0868 = D_800B3E70;
L1_D_800B086C = D_800B3E74;
L1_D_800B087C = D_800B3E84;
L1_D_800B0A94 = D_800B409C;
L1_D_800B0A98 = D_800B40A0;
L1_D_800B0AA0 = D_800B40A8;
L1_D_800B0AA4 = D_800B40AC;
L1_D_800B0AA8 = D_800B40B0;
L1_D_800B0AB4 = D_800B40BC;
L1_D_800B0AB8 = D_800B40C0;
L1_D_800B0AC0 = D_800B40C8;
L1_D_800B0AC8 = D_800B40D0;
L1_D_800B0ACC = D_800B40D4;
L1_D_800B0AD0 = D_800B40D8;
L1_D_800B0AD4 = D_800B40DC;
L1_D_800B0ADC = D_800B40E4;
L1_D_800B0AE0 = D_800B40E8;
L1_D_800B0AE4 = D_800B40EC;
L1_D_800B0AE8 = D_800B40F0;
L1_D_800B0AEC = D_800B40F4;
L1_D_800B0AFC = D_800B4104;
L1_D_800B0B10 = D_800B4118;
L1_D_800B0B14 = D_800B411C;
L1_D_800B0B54 = D_800B415C;
L1_D_800B0B58 = D_800B4160;
L1_D_800B0B64 = D_800B416C;
L1_D_800B0B68 = D_800B4170;
L1_D_800B0B6A = D_800B4172;
L1_D_800B0B6C = D_800B4174;
L1_D_800B0B70 = D_800B4178;
L1_D_800B0B72 = D_800B417A;
L1_D_800B0B78 = D_800B4180;
L1_D_800B0B80 = D_800B4188;
L1_D_800B0B84 = D_800B418C;
L1_D_800B0B88 = D_800B4190;
L1_D_800B0B8C = D_800B4194;
L1_D_800B0B9C = D_800B41A4;
L1_D_800B0BA0 = D_800B41A8;
L1_D_800B0BB4 = D_800B41BC;
L1_D_800B0BB8 = D_800B41C0;
L1_D_800B0BBC = D_800B41C4;
L1_D_800B0BC0 = D_800B41C8;
L1_D_800B0C10 = D_800B4218;
L1_D_800B0C30 = D_800B4238;
L1_D_800B0C38 = D_800B4240;
L1_D_800B0C58 = D_800B4260;
L1_D_800B0C5C = D_800B4264;
L1_D_800B0C60 = D_800B4268;
L1_D_800B0C64 = D_800B426C;
L1_D_800B0C68 = D_800B4270;
L1_D_800B0C74 = D_800B427C;
L1_D_800B0C7C = D_800B4284;
L1_D_800B0C84 = D_800B428C;
L1_D_800B0C8C = D_800B4294;
L1_D_800B0C94 = D_800B429C;
L1_D_800B0C98 = D_800B42A0;
L1_D_800B0C9C = D_800B42A4;
L1_D_800B0CA0 = D_800B42A8;
L1_D_800B0CA4 = D_800B42AC;
L1_D_800B0CA8 = D_800B42B0;
L1_D_800B0CAC = D_800B42B4;
L1_D_800B0CB0 = D_800B42B8;
L1_D_800B0CC4 = D_800B42CC;
L1_D_800B0D50 = D_800B4358;
L1_D_800B0D94 = D_800B439C;
L1_D_800B0D9C = D_800B43A4;
L1_D_800B0DA0 = D_800B43A8;
L1_D_800B0DA4 = D_800B43AC;
L1_D_800B0DA8 = D_800B43B0;
L1_D_800B0DAC = D_800B43B4;
L1_D_800B0DB0 = D_800B43B8;
L1_D_800B0DB4 = D_800B43BC;
L1_D_800B0DB8 = D_800B43C0;
L1_D_800B0DBC = D_800B43C4;
L1_D_800B0DC0 = D_800B43C8;
L1_D_800B0DC4 = D_800B43CC;
L1_D_800B0DC8 = D_800B43D0;
L1_D_800B0DCC = D_800B43D4;
L1_D_800B0DD4 = D_800B43DC;
L1_D_800B0DD8 = D_800B43E0;
L1_D_800B0DDC = D_800B43E4;
L1_D_800B0DE4 = D_800B43EC;
L1_D_800B0E34 = D_800B443C;
L1_D_800B0E36 = D_800B443E;
L1_D_800B0E40 = D_800B4448;
L1_D_800B0E48 = D_800B4450;
L1_D_800B0E54 = D_800B445C;
L1_D_800B0E58 = D_800B4460;
L1_D_800B0E5E = D_800B4466;
L1_D_800B0E5F = D_800B4467;
L1_D_800B0E62 = D_800B446A;
L1_D_800B0E63 = D_800B446B;
L1_D_800B0E8C = D_800B4494;
L1_D_800B0EA0 = D_800B44A8;
L1_D_800B0EFC = D_800B4504;
L1_D_800B8EFC = D_800BC504;
L1_D_800B8F24 = D_800BC52C;
L1_D_800B8F28 = D_800BC530;
L1_D_800B8F68 = D_800BC570;
L1_D_800B8F88 = D_800BC590;
L1_D_800B8FB0 = D_800BC5B8;
L1_D_800B8FB4 = D_800BC5BC;
L1_D_800C1C54 = D_800C525C;
L1_D_800CA8F4 = D_800CDEFC;
L1_D_800D28F4 = D_800D5EFC;
L1_D_800D2AF4 = D_800D60FC;
L1_D_800D2AF8 = D_800D6100;
L1_D_800D2AFC = D_800D6104;
L1_D_800D2BC4 = D_800D61CC;
L1_D_800D2BE8 = D_800D61F0;
L1_D_800D2BEC = D_800D61F4;
L1_D_800D2BF0 = D_800D61F8;
L1_D_800D2D30 = D_800D6338;
L1_D_800D2E70 = D_800D6478;
L1_D_800D2E74 = D_800D647C;
L1_D_800D2E84 = D_800D648C;
L1_D_800D2E90 = D_800D6498;
L1_D_800D2F48 = D_800D6550;
L1_D_800D2F68 = D_800D6570;
L1_D_800D2F90 = D_800D6598;
L1_D_800D2FA4 = D_800D65AC;
L1_D_800D2FAC = D_800D65B4;
L1_D_800D2FB0 = D_800D65B8;
L1_D_800D2FC0 = D_800D65C8;
L1_D_800D2FC4 = D_800D65CC;
L1_D_800D2FF4 = D_800D65FC;
L1_D_800D305C = D_800D6664;
L1_D_800D3068 = D_800D6670;
L1_D_800D308C = D_800D6694;
L1_D_800D30C0 = D_800D66C8;
L1_D_800D30D4 = D_800D66DC;
L1_D_800D30D8 = D_800D66E0;
L1_D_800D31B8 = D_800D67C0;
L1_D_800D31C0 = D_800D67C8;
L1_D_800D31D0 = D_800D67D8;
L1_D_800D3238 = D_800D6840;
L1_D_800D3288 = D_800D6890;
L1_D_800D3FA8 = D_800D75B0;
L1_D_800D3FAC = D_800D75B4;
L1_D_800D3FB0 = D_800D75B8;
L1_D_800D3FD4 = D_800D75DC;
L1_D_800D3FD8 = D_800D75E0;
L1_D_800D3FE0 = D_800D75E8;
L1_D_800D3FE4 = D_800D75EC;
L1_D_800D3FEC = D_800D75F4;
L1_D_800D3FF0 = D_800D75F8;
L1_D_800D4050 = D_800D7658;
L1_D_800D4058 = D_800D7660;
L1_D_800D4068 = D_800D7670;
L1_D_800D406C = D_800D7674;
L1_D_800D4070 = D_800D7678;
L1_D_800D4074 = D_800D767C;
L1_D_800D4080 = D_800D7688;
L1_D_800D40D8 = D_800D76E0;
L1_D_800D40F8 = D_800D7700;
L1_D_800D40FC = D_800D7704;
L1_D_800D4100 = D_800D7708;
L1_D_800D4104 = D_800D770C;
L1_D_800D4108 = D_800D7710;
L1_D_800D410C = D_800D7714;
L1_D_800D4110 = D_800D7718;
L1_D_800D4114 = D_800D771C;
L1_D_800D424C = D_800D7854;
L1_D_800D4250 = D_800D7858;
L1_D_800D4384 = D_800D798C;
L1_D_800D4385 = D_800D798D;
L1_D_800D4386 = D_800D798E;
L1_D_800D4387 = D_800D798F;
L1_D_800D4388 = D_800D7990;
L1_D_800D4389 = D_800D7991;
L1_D_800D438A = D_800D7992;
L1_D_800D438B = D_800D7993;
L1_D_800D438C = D_800D7994;
L1_D_800D438D = D_800D7995;
L1_D_800D438E = D_800D7996;
L1_D_800D438F = D_800D7997;
L1_D_800D4390 = D_800D7998;
L1_D_800D43A8 = D_800D79B0;
L1_D_800D43AC = D_800D79B4;
L1_D_800D43C0 = D_800D79C8;
L1_D_800D43C4 = D_800D79CC;
L1_D_800D43CC = D_800D79D4;
L1_D_800D43D0 = D_800D79D8;
L1_D_800D43E4 = D_800D79EC;
L1_D_800D43F0 = D_800D79F8;
L1_D_800D43F4 = D_800D79FC;
L1_D_800D43F8 = D_800D7A00;
L1_D_800D4400 = D_800D7A08;
L1_D_800D4404 = D_800D7A0C;
L1_D_800D440C = D_800D7A14;
L1_D_800D4410 = D_800D7A18;
L1_D_800D4414 = D_800D7A1C;
L1_D_800D4424 = D_800D7A2C;
L1_D_800D4440 = D_800D7A48;
L1_D_800D4444 = D_800D7A4C;
L1_D_800D4450 = D_800D7A58;
L1_D_800D4454 = D_800D7A5C;
L1_D_800D4458 = D_800D7A60;
L1_D_800D445C = D_800D7A64;
L1_D_800D4464 = D_800D7A6C;
L1_D_800D4468 = D_800D7A70;
L1_D_800D446C = D_800D7A74;
L1_D_800D4474 = D_800D7A80;
L1_D_800D4484 = D_800D7A94;
L1_D_800D4564 = D_800D7B74;
L1_D_800D45C4 = D_800D7BD4;
L1_D_800D45F4 = D_800D7C04;
L1_D_800D4688 = D_800D7C98;
L1_D_800D46D8 = D_800D7CE8;
L1_D_800D4958 = D_800D7F68;
L1_D_800D4984 = D_800D7F94;
L1_D_800D5DA4 = D_800D93B4;
L1_D_800D5E80 = D_800D9490;
L1_D_800D5ED0 = D_800D94E0;
L1_D_800D5ED8 = D_800D94E8;
L1_D_800D5EF0 = D_800D9500;
L1_D_800D5F40 = D_800D9550;
L1_D_800D5F48 = D_800D9558;
L1_D_800D74F8 = D_800DAB08;
L1_D_800D74FC = D_800DAB0C;
L1_D_800D7500 = D_800DAB10;
L1_D_800D7550 = D_800DAB60;
L1_D_800D7554 = D_800DAB64;
L1_D_800D7588 = D_800DAB98;
L1_D_800D77B8 = D_800DADC8;
L1_D_800D77E8 = D_800DADF8;
L1_D_800D7838 = D_800DAE48;
L1_D_800D7888 = D_800DAE98;
L1_D_800D78D8 = D_800DAEE8;
L1_D_800D7930 = D_800DAF40;
L1_D_800D7980 = D_800DAF90;
L1_D_800D79D0 = D_800DAFE0;
L1_D_800D79D4 = D_800DAFE4;
L1_D_800D7A1C = D_800DB02C;
L1_D_800D7A20 = D_800DB030;
L1_D_800D7AB8 = D_800DB0C8;
L1_D_800D7B08 = D_800DB118;
L1_D_800D7BE8 = D_800DB1F8;
L1_D_800D7BF0 = D_800DB200;
L1_D_800D7C24 = D_800DB234;
L1_D_800D7C64 = D_800DB274;
L1_D_800D7CB4 = D_800DB2C4;
L1_D_800D7CB8 = D_800DB2C8;
L1_D_800D7D08 = D_800DB318;
L1_D_800D7DF8 = D_800DB408;
L1_D_800D7DFC = D_800DB40C;
L1_D_800D7E9C = D_800DB4AC;
L1_D_800D7EEC = D_800DB4FC;
L1_D_800D7FDC = D_800DB5EC;
L1_D_800D811C = D_800DB72C;
L1_D_800D8138 = D_800DB748;
L1_D_800D8150 = D_800DB760;
L1_D_800D8154 = D_800DB764;
L1_D_800D861C = D_800DBC2C;
L1_D_800D8620 = D_800DBC30;
L1_D_800D8624 = D_800DBC34;
L1_D_800D8674 = D_800DBC84;
L1_D_800D86C4 = D_800DBCD4;
L1_D_800D86C8 = D_800DBCD8;
L1_D_800D86DC = D_800DBCEC;
L1_D_800D86E0 = D_800DBCF0;
L1_D_800D86E4 = D_800DBCF4;
L1_D_800D86E8 = D_800DBCF8;
L1_D_800D8BE8 = D_800DC1F8;
L1_D_800D8C7C = D_800DC28C;
L1_D_800D8C90 = D_800DC2A0;
L1_D_800D8C94 = D_800DC2A4;
L1_D_800D8E74 = D_800DC484;
L1_D_800D8E8C = D_800DC49C;
L1_D_800D8EA4 = D_800DC4B4;
L1_D_800D8EA8 = D_800DC4B8;
L1_D_800D8EE8 = D_800DC4F8;
L1_D_800D8FE8 = D_800DC5F8;
L1_D_800D8FF8 = D_800DC608;
L1_D_800D90C0 = D_800DC6D0;
L1_D_800D911C = D_800DC72C;
L1_D_800D91E4 = D_800DC7F4;
L1_D_800D91E7 = D_800DC7F7;
L1_D_800D91E8 = D_800DC7F8;
L1_D_800D91F0 = D_800DC800;
L1_D_800D91F8 = D_800DC808;
L1_D_800D91FC = D_800DC80C;
L1_D_800D9200 = D_800DC810;
L1_D_800D9208 = D_800DC818;
L1_D_800D920C = D_800DC81C;
L1_D_800D9210 = D_800DC820;
L1_D_800D9214 = D_800DC824;
L1_D_800D9218 = D_800DC828;
L1_D_800D9232 = D_800DC842;
L1_D_800D9268 = D_800DC884;
L1_D_800D9278 = D_800DC894;
L1_D_800DA270 = D_800DD88C;
L1_D_800DA5C0 = D_800DDBDC;
L1_D_800DA5C4 = D_800DDBE0;
L1_D_800DB884 = D_800DEEA0;
L1_D_800DCB44 = D_800DFE40;
L1_D_800DCB4C = D_800DFE48;
L1_D_800DD7F4 = D_800E0AF0;
L1_D_800DDC44 = D_800E0AF4;
L1_D_800DDC48 = D_800E0AF8;
L1_D_800DDC4C = D_800E0AFC;
L1_D_800DDC50 = D_800E0B00;
L1_D_800DDC54 = D_800E0B04;
L1_D_800DDC58 = D_800E0B08;
L1_D_800DDC5C = D_800E0B0C;
L1_D_800DDC60 = D_800E0B10;
L1_D_800DDC64 = D_800E0B14;
L1_D_800DDC68 = D_800E0B18;
L1_D_800DDC6C = D_800E0B1C;
L1_D_800DDCC0 = D_800E0B70;
L1_D_800DDCC4 = D_800E0B74;
L1_D_800DDCC8 = D_800E0B78;
L1_D_800DDCCC = D_800E0B7C;
L1_D_800DDD8C = D_800E0C3C;
L1_D_800DDD90 = D_800E0C40;
L1_D_800DDD94 = D_800E0C44;
L1_D_800DDD98 = D_800E0C48;
L1_D_800DDDA0 = D_800E0C50;
L1_D_800DDDA4 = D_800E0C54;
L1_D_800DDDA8 = D_800E0C58;
L1_D_800DDDAC = D_800E0C5C;
L1_D_800DDDB0 = D_800E0C60;
L1_D_800DDDB4 = D_800E0C64;
L1_D_800DDDB8 = D_800E0C68;
L1_D_800DDDBC = D_800E0C6C;
L1_D_800DDDCC = D_800E0C7C;
L1_D_800DDDDC = D_800E0C8C;
L1_D_800DDDEC = D_800E0C9C;
L1_D_800DDE04 = D_800E0CB4;
L1_D_800DDE08 = D_800E0CB8;
L1_D_800DDE10 = D_800E0CC0;
L1_D_800DDE30 = D_800E0CE0;
L1_D_800DDE34 = D_800E0CE4;
L1_D_800DDEE0 = D_800E0D90;
L1_D_800DDEE4 = D_800E0D94;
L1_D_800DDEE8 = D_800E0D98;
L1_D_800DDEEC = D_800E0D9C;
L1_D_800DDEF0 = D_800E0DA0;
L1_D_800DDF08 = D_800E0DB8;
L1_D_800DDF24 = D_800E0DD4;
L1_D_800DDFEC = D_800E0E9C;
L1_D_800DE000 = D_800E0EB0;
L1_D_800DE004 = D_800E0EB4;
L1_D_800DE018 = D_800E0EC8;
L1_D_800DE0C4 = D_800E0F74;
L1_D_800DE0C8 = D_800E0F78;
L1_D_800DE0D4 = D_800E0F84;
L1_D_800DE0D8 = D_800E0F88;
L1_D_800DE0DC = D_800E0F8C;
L1_D_800DE0E0 = D_800E0F90;
L1_D_800DE0E4 = D_800E0F94;
L1_D_800DE0E8 = D_800E0F98;
L1_D_800DE8E8 = D_800E1798;
L1_D_800DF0E8 = D_800E1F98;
L1_D_800DF0EC = D_800E1F9C;
L1_D_800DF0F0 = D_800E1FA0;
L1_D_800DF0F8 = D_800E1FA8;
L1_D_800DF10C = D_800E1FBC;
L1_D_800DF12C = D_800E1FDC;
L1_D_800DF1F4 = D_800E20A4;
L1_D_800DF200 = D_800E20B0;
L1_D_800DF540 = D_800E23F0;
L1_D_800DF5B8 = D_800E2468;
L1_D_800DF684 = D_800E2534;
L1_D_800E2438 = D_800E6150;
L1_D_800E2448 = D_800E6160;
L1_D_800E2DA8 = D_800E6AC0;
L1_D_800E2DBC = D_800E6AD4;
L1_D_800E2DE0 = D_800E6AF8;
L1_D_800E2DE4 = D_800E6AFC;
L1_D_800E2DF4 = D_800E6B0C;
L1_D_800E2E44 = D_800E6B5C;
L1_D_800E2E48 = D_800E6B60;
L1_D_800E2E4C = D_800E6B64;
L1_D_800E2F2C = D_800E6C44;
L1_D_800E2F38 = D_800E6C50;
L1_D_800E2F3C = D_800E6C54;
L1_D_800E2F54 = D_800E6C6C;
L1_D_800E2F58 = D_800E6C70;
L1_D_800E2F5C = D_800E6C74;
L1_D_800F0F5C = D_800F4C74;
L1_D_800F0F80 = D_800F4C98;
L1_D_800F1180 = D_800F4FE0;
L1_D_800F11A0 = D_800F5000;
L1_D_800F11D0 = D_800F5030;
L1_D_800F11F0 = D_800F5050;
L1_D_800F128C = D_800F50EC;
L1_D_800F1294 = D_800F50F4;
L1_D_800F12D4 = D_800F5134;
L1_D_800F12EC = D_800F514C;
L1_D_800F12F4 = D_800F5154;
L1_D_800F1314 = D_800F5174;
L1_D_800F1354 = D_800F51B4;
L1_D_800F136C = D_800F51CC;
L1_D_800F1374 = D_800F51D4;
L1_D_800F138C = D_800F51EC;
L1_D_800F1398 = D_800F51F8;
L1_D_800F13A8 = D_800F5208;
L1_D_800F1DCC = D_800F5C2C;
L1_D_800F25D8 = D_800F6438;
L1_D_800F2FBC = D_800F6E1C;
L1_D_800F3848 = D_800F76A8;
L1_D_800F3B48 = D_800F79A8;
L1_D_800F3E98 = D_800F7CF8;
L1_D_800F40DC = D_800F7F3C;
L1_D_800F40E0 = D_800F7F40;
L1_D_800F40F8 = D_800F7F58;
L1_D_800F40FC = D_800F7F5C;
L1_D_800F4114 = D_800F7F74;
L1_D_800F413C = D_800F7F9C;
L1_D_800F415C = D_800F7FBC;
L1_D_800F4264 = D_800F80C4;
L1_D_800F4268 = D_800F80C8;
L1_D_800F426C = D_800F80CC;
L1_D_800F4270 = D_800F80D0;
L1_D_800F5A64 = D_800F98C4;
L1_D_800F5A65 = D_800F98C5;
L1_D_800F5A66 = D_800F98C6;
L1_D_800F5A68 = D_800F98C8;
L1_D_800F5A6C = D_800F98CC;
L1_D_800F6040 = D_800F9EA0;
L1_D_800F6064 = D_800F9EC4;
L1_D_800F6068 = D_800F9EC8;
L1_D_800F606C = D_800F9ECC;
L1_D_800F6070 = D_800F9ED0;
L1_D_800F7664 = D_800FB4C4;
L1_D_800F7E64 = D_800FBCC4;
L1_D_800F7EC4 = D_800FBD24;
L1_D_800F7EC8 = D_800FBD28;
L1_D_800F7EC9 = D_800FBD29;
L1_D_800F7ECA = D_800FBD2A;
L1_D_800F7ECC = D_800FBD2C;
L1_D_800F7ECE = D_800FBD2E;
L1_D_800F7ED0 = D_800FBD30;
L1_D_800F7ED2 = D_800FBD32;
L1_D_800F7EE4 = D_800FBD44;
L1_D_800F7EE8 = D_800FBD48;
L1_D_800F7EEC = D_800FBD4C;
L1_D_800F7EF4 = D_800FBD54;
L1_D_800F7EF8 = D_800FBD58;
L1_D_800F7EFC = D_800FBD5C;
L1_D_800F7F00 = D_800FBD60;
L1_D_800F7F04 = D_800FBD64;
L1_D_800F7F08 = D_800FBD68;
L1_D_800F7F10 = D_800FBD70;
L1_D_800F7F1C = D_800FBD7C;
L1_D_800F7F64 = D_800FBDC4;
L1_D_800F7F68 = D_800FBDC8;
L1_D_800F7F6C = D_800FBDCC;
L1_D_800F7F70 = D_800FBDD0;
L1_D_800F7F74 = D_800FBDD4;
L1_D_800F7F81 = D_800FBDE1;
L1_D_800F7F84 = D_800FBDE4;
L1_D_800F7FCC = D_800FBE2C;
L1_D_800F8014 = D_800FBE74;
L1_D_800F81F4 = D_800FC054;
L1_D_800F81F8 = D_800FC058;
L1_D_800F8204 = D_800FC064;
L1_D_800F8208 = D_800FC068;
L1_D_800F8214 = D_800FC074;
L1_D_800F8614 = D_800FC474;
L1_D_800FC614 = D_80100474;
L1_D_800FC616 = D_80100476;
L1_D_800FC624 = D_80100484;
L1_D_800FC628 = D_80100488;
L1_D_800FC62C = D_8010048C;
L1_D_800FC630 = D_80100490;
L1_D_800FC640 = D_801004A0;
L1_D_800FC644 = D_801004A4;
L1_D_800FC648 = D_801004A8;
L1_D_800FC650 = D_801004B0;
L1_D_800FC654 = D_801004B4;
L1_D_800FC658 = D_801004B8;
L1_D_800FC65C = D_801004BC;
L1_D_800FC660 = D_801004C0;
L1_D_800FC664 = D_801004C4;
L1_D_800FC670 = D_801004D0;
L1_D_800FC67C = D_801004DC;
L1_D_800FC6A0 = D_80100500;
L1_D_800FC6B0 = D_80100510;
L1_D_800FC6C0 = D_80100520;
L1_D_800FC780 = D_801005E0;
L1_D_800FC784 = D_801005E4;
L1_D_800FC788 = D_801005E8;
L1_D_800FC790 = D_801005F0;
L1_D_800FC794 = D_801005F4;
L1_D_800FCF94 = D_80100DF4;
L1_D_800FCF98 = D_80100DF8;
L1_D_800FCF9C = D_80100DFC;
L1_D_800FCFA0 = D_80100E00;
L1_D_800FCFA4 = D_80100E04;
L1_D_800FCFA8 = D_80100E08;
L1_D_800FCFAC = D_80100E0C;
L1_D_800FCFB0 = D_80100E10;
L1_D_800FCFB4 = D_80100E14;
L1_D_800FD038 = D_80100E98;
L1_D_800FD0B8 = D_80100F18;
L1_D_800FD0F8 = D_80100F58;
L1_D_800FD138 = D_80100F98;
L1_D_800FD178 = D_80100FD8;
L1_D_800FD17C = D_80100FDC;
L1_D_800FD190 = D_80100FF0;
L1_D_800FD191 = D_80100FF1;
L1_D_800FD195 = D_80100FF5;
L1_D_800FD197 = D_80100FF7;
L1_D_800FD19A = D_80100FFA;
L1_D_800FD19B = D_80100FFB;
L1_D_800FD19F = D_80100FFF;
L1_D_800FD1A1 = D_80101001;
L1_D_800FD1A2 = D_80101002;
L1_D_800FD1A4 = D_80101004;
L1_D_800FD1A6 = D_80101004 + 0x2;
L1_D_800FD1A8 = D_80101008;
L1_D_800FD1AC = D_8010100C;
L1_D_800FD1BC = D_8010101C;
L1_D_800FD1C0 = D_80101020;
L1_D_800FD1C4 = D_80101024;
L1_D_800FD1C8 = D_80101028;
L1_D_800FD208 = D_80101068;
L1_D_800FD248 = D_801010A8;
L1_D_800FD24C = D_801010AC;
L1_D_800FD254 = D_801010B4;
L1_D_800FD258 = D_801010B8;
L1_D_800FD25C = D_801010BC;
L1_D_800FD260 = D_801010C0;
L1_D_800FD264 = D_801010C4;
L1_D_800FD266 = D_801010C6;
L1_D_800FD268 = D_801010C8;
L1_D_800FD26A = D_801010CA;
L1_D_800FD26C = D_801010CC;
L1_D_800FD3E4 = D_80101244;
L1_D_800FD3E8 = D_80101248;
L1_D_800FD400 = D_80101260;
L1_D_800FD440 = D_801012A0;
L1_D_800FD442 = D_801012A2;
L1_D_800FD444 = D_801012A4;
L1_D_800FD446 = D_801012A6;
L1_D_800FD448 = D_801012A8;
L1_D_800FD44A = D_801012AA;
L1_D_800FD44C = D_801012AC;
L1_D_800FD44E = D_801012AE;
L1_D_800FD450 = D_801012B0;
L1_D_800FD452 = D_801012B2;
L1_D_800FD454 = D_801012B4;
L1_D_800FD456 = D_801012B6;
L1_D_800FD458 = D_801012B8;
L1_D_800FD45A = D_801012BA;
L1_D_800FD45D = D_801012BD;
L1_D_800FD45E = D_801012BE;
L1_D_800FD460 = D_801012C0;
L1_D_800FD462 = D_801012C2;
L1_D_800FD464 = D_801012C4;
L1_D_800FD466 = D_801012C6;
L1_D_800FD46A = D_801012CA;
L1_D_800FD46C = D_801012CC;
L1_D_800FD46E = D_801012CE;
L1_D_800FD470 = D_801012D0;
L1_D_800FD472 = D_801012D2;
L1_D_800FD476 = D_801012D6;
L1_D_800FD824 = D_80101684;
L1_D_800FD980 = D_801017E0;
L1_D_800FD984 = D_801017E4;
L1_D_800FD988 = D_801017E8;
L1_D_800FD98C = D_801017EC;
L1_D_800FD990 = D_801017F0;
L1_D_800FD994 = D_801017F4;
L1_D_800FD998 = D_801017F8;
L1_D_800FD99C = D_801017FC;
L1_D_800FD9A0 = D_80101800;
L1_D_800FD9A4 = D_80101804;
L1_D_800FD9AC = D_8010180C;
L1_D_800FD9C0 = D_80101820;
L1_D_800FD9C8 = D_80101828;
L1_D_800FD9D0 = D_80101830;
L1_D_800FD9D8 = D_80101838;
L1_D_800FD9DC = D_8010183C;
L1_D_800FD9E0 = D_80101840;
L1_D_800FD9F4 = D_80101854;
L1_D_800FDA04 = D_80101864;
L1_D_800FDA08 = D_80101868;
L1_D_800FDA0C = D_8010186C;
L1_D_800FDA24 = D_80101884;
L1_D_800FDB2C = D_8010198C;
L1_DebugPage_ArtProfile = func_80041A18;
func_80041D10 = L1_DebugPage_Camera;
L1_DebugPage_ContourMask = func_80075BD4;
L1_DebugPage_FPWeapon = func_8007B7BC;
L1_DebugPage_Framerate = func_80041A54;
L1_DebugPage_Loadpoint = func_80031DD0;
func_80041AA0 = L1_DebugPage_ObjectCount;
L1_DebugPage_Profile = func_800419DC;
func_8002FD64 = L1_DebugScreen_DrawPage;
L1_DeliverEvent = func_800960A8;
func_80032C60 = L1_DevMenu_Draw;
func_80032A08 = L1_DevMenu_HandleInput;
func_80032E28 = L1_DevMenu_Init;
L1_DisableEvent = func_8009D054;
L1_EVENT_OBJ_11C = func_80087EEC;
L1_EVENT_OBJ_90 = func_80087E60;
L1_EVENT_OBJ_CC = func_80087E9C;
L1_EVENT_OBJ_F4 = func_80087EC4;
L1_EnableEvent = func_8008114C;
L1_FlushCache = func_8009D364;
L1_FntFlush = func_80089FC0;
L1_FntLoad = func_80089C68;
L1_FntOpen = func_80089D08;
L1_FntPrint = func_8008A2DC;
L1_GPU_cw = func_80090A8C;
L1_GS_001_OBJ_1F8 = func_80086D38;
L1_GS_001_OBJ_74 = func_80086BB4;
L1_GS_107_OBJ_4B8 = func_80079218;
L1_GS_107_OBJ_51C = func_8007927C;
L1_GetClut = func_80084078;
L1_GetTPage = func_800840F8;
func_8002F780 = L1_Gfx_Init;
L1_GsClearOt = func_8008B448;
L1_GsDefDispBuff = func_8008C728;
L1_GsGetActiveBuff = func_800870B0;
L1_GsGetHeadpUnit = func_800907C4;
L1_GsGetLs = func_8007C5D8;
L1_GsGetLsUnit = func_8008EF30;
L1_GsGetLwUnit = func_8008F200;
L1_GsGetTimInfo = func_8008E2C8;
L1_GsInit3D = func_8008C6A8;
L1_GsInitGraph = func_80086B40;
L1_GsInitGraph2 = func_80086CD0;
L1_GsInitVcount = func_80087FB0;
L1_GsLinkAnim = func_80090458;
L1_GsLinkObject4 = func_80087FF0;
L1_GsMapCoordUnit = func_8008FA60;
L1_GsMapModelingData = func_8008DC08;
L1_GsMapUnit = func_8008FAE0;
L1_GsScanAnim = func_800903B0;
L1_GsScanUnit = func_8009060C;
L1_GsSetAmbient = func_8009093C;
L1_GsSetDrawBuffClip = func_80095400;
L1_GsSetDrawBuffOffset = func_800870C0;
L1_GsSetFlatLight = func_80078D60;
L1_GsSetRefView2 = func_80087290;
L1_GsSortClear = func_80086F58;
L1_GsSortObject4 = func_8007D8F4;
L1_GsSortOt = func_80089B68;
L1_GsSortUnit = func_8008ED5C;
L1_GsSwapDispBuff = func_8008B4A8;
L1_GsTMDdivF3NL = func_8008CD18;
L1_GsTMDdivG3NL = func_8008CF08;
L1_GsTMDdivNF3 = func_8008C2B8;
L1_GsTMDdivNG3 = func_8008C4A8;
L1_GsTMDdivTF3L = func_8008D108;
L1_GsTMDdivTF3LFG = func_8008B558;
L1_GsTMDdivTF3NL = func_8008AB28;
L1_GsTMDdivTG3NL = func_8008ADD8;
L1_GsTMDdivTNF3 = func_8008D6B8;
L1_GsTMDdivTNG3 = func_8008D968;
L1_GsTMDfastF3GL = func_8008B028;
L1_GsTMDfastF3GLFG = func_8008C7E8;
L1_GsTMDfastF3GNL = func_8008BD88;
L1_GsTMDfastF3L = func_8007EF60;
L1_GsTMDfastF3LFG = func_8007F0A8;
L1_GsTMDfastF3NL = func_8007EE20;
L1_GsTMDfastG3GL = func_8008B248;
L1_GsTMDfastG3GLFG = func_8008CA08;
L1_GsTMDfastG3GNL = func_8008C148;
L1_GsTMDfastG3L = func_8007E9BC;
L1_GsTMDfastG3LFG = func_8007EB4C;
L1_GsTMDfastG3NL = func_8007E87C;
L1_GsTMDfastNF3 = func_8007ECE4;
L1_GsTMDfastNG3 = func_8007E734;
L1_GsTMDfastTF3L = func_8007E454;
L1_GsTMDfastTF3LFG = func_8007E5C4;
L1_GsTMDfastTF3NL = func_8007E2F0;
L1_GsTMDfastTG3L = func_8007D588;
L1_GsTMDfastTG3LFG = func_8007D73C;
L1_GsTMDfastTG3NL = func_8007D42C;
L1_GsTMDfastTNF3 = func_8007E184;
L1_GsTMDfastTNG3 = func_8007D2B4;
L1_GsU_00000008 = func_8009B924;
L1_GsU_00000009 = func_8009BAA4;
L1_GsU_0000000c = func_8009AFE4;
L1_GsU_0000000d = func_8009B1A4;
L1_GsU_0000000f = func_8009B374;
L1_GsU_00000209 = func_8009BC34;
L1_GsU_0000020d = func_8009B554;
L1_GsU_00200009 = func_8009BDD4;
L1_GsU_0020000d = func_8009B744;
L1_GsU_01000000 = func_8009A044;
L1_GsU_0100000c = func_80099BA4;
L1_GsU_0100000d = func_80099E14;
L1_GsU_02000000 = func_80099A64;
L1_GsU_02000001 = func_80099AF4;
L1_GsU_03000000 = D_8009A174;
L1_GsU_03000001 = func_8009A8B4;
L1_GsU_03000010 = func_8009AA94;
L1_GsU_03000011 = func_8009AC84;
L1_Gssub_make_matrix = func_8008E6D8;
L1_HookEntryInt = func_800950C0;
L1_INTR_DMA_OBJ_1CC = func_8009529C;
L1_INTR_DMA_OBJ_278 = func_80095348;
L1_INTR_DMA_OBJ_4C = func_8009511C;
L1_INTR_VB_OBJ_58 = func_80094FC8;
L1_INTR_VB_OBJ_C4 = func_80095034;
L1_INTR_VB_OBJ_F0 = func_80095060;
L1_ISO9660_OBJ_2D8 = func_80085C0C;
L1_ISO9660_OBJ_2F8 = func_80085C2C;
L1_ISO9660_OBJ_5BC = func_80085EF0;
L1_ISO9660_OBJ_660 = func_80085F94;
L1_ISO9660_OBJ_8FC = func_80086230;
L1_InitGeom = func_80089AE0;
L1_InitHeap3 = func_8008DBA8;
L1_LoadClut = func_8008E1E8;
L1_LoadClut2 = func_8008E258;
L1_LoadTPage = func_80097C78;
func_80075F18 = L1_Math_Abs;
func_80075F54 = L1_Math_Max;
func_80076008 = L1_Math_Max3;
func_80075FA0 = L1_Math_Min3;
L1_Menu_ResetState = func_8002915C;
L1_MulMatrix = func_8007CC38;
L1_MulMatrix2 = func_8007CD48;
L1_OpenEvent = func_80081270;
L1_PADIF_OBJ_120 = func_80097678;
L1_PADIF_OBJ_1CC = func_80097724;
L1_PADIF_OBJ_290 = func_800977E8;
L1_PADIF_OBJ_48 = func_800975A0;
L1_PADPORTD_OBJ_160 = func_80088440;
L1_PADPORTD_OBJ_1C8 = func_800884A8;
L1_PADPORTD_OBJ_2BC = func_8008859C;
L1_PADPORTD_OBJ_2CC = func_800885AC;
L1_PADPORTD_OBJ_388 = func_80088668;
L1_PADPORTD_OBJ_604 = func_800888E4;
L1_PADPORTD_OBJ_63C = func_8008891C;
L1_PADSEQD_OBJ_144 = func_800964FC;
L1_PADSEQD_OBJ_34 = func_800963EC;
L1_PADSEQD_OBJ_488 = func_80096840;
L1_PATCHGTE_OBJ_DC = D_80097C74;
L1_PCcreat = func_80087090;
L1_PClseek = func_800862B4;
L1_PCopen = func_80085914;
L1_PCread = func_800851DC;
L1_PadInitDirect = func_800882E0;
func_8004557C = L1_Pad_StickToSpeed;
func_8002F314 = L1_Pad_Update;
func_8004239C = L1_PauseMenu_Open;
L1_PopMatrix = func_80079434;
L1_PushMatrix = func_80079390;
L1_ResetEntryInt = func_800953A0;
func_80042D7C = L1_RestartPrompt_Open;
L1_ReturnFromException = func_80095390;
L1_RotAverage3 = func_800987B8;
L1_RotAverageNclip3 = func_80098728;
L1_RotAverageNclipColorCol3 = func_80099134;
L1_RotAverageNclipColorDpq3 = func_80097DC8;
L1_RotAverageNclipColorDpq3_1 = func_80098220;
L1_RotMatrix = func_8008FE90;
L1_RotMatrixY = func_8008E538;
L1_RotMatrixYXZ = func_80090120;
L1_RotMatrixYXZ_gte = func_8008EACC;
L1_RotTrans = func_80090A5C;
L1_ScaleMatrix = func_800907FC;
L1_SetBackColor = func_8009BF74;
L1_SetColorMatrix = func_80079360;
L1_SetDefDispEnv = func_8008CCD8;
L1_SetDefDrawEnv = func_8008CC08;
L1_SetDrawMode = func_80083F78;
L1_SetDumpFnt = func_80089C28;
L1_SetFarColor = func_8009C674;
L1_SetLightMatrix = func_80090A1C;
L1_SetLineF4 = func_80083F58;
L1_SetRotMatrix = func_800909CC;
L1_SetTransMatrix = func_800909FC;
L1_SpuClearReverbWorkArea = func_800960D8;
L1_SpuFree = func_800962F8;
L1_SpuGetVoiceEnvelope = func_8009C2E4;
L1_SpuInitMalloc = func_8009D384;
L1_SpuIsTransferCompleted = func_800992F4;
L1_SpuMalloc = func_80099794;
L1_SpuRead = func_80099294;
L1_SpuSetCommonAttr = func_80092954;
L1_SpuSetKey = func_8009C334;
L1_SpuSetNoiseClock = func_8009C524;
L1_SpuSetTransferMode = func_80099204;
L1_SpuSetTransferStartAddr = func_80099234;
L1_SpuSetVoiceAttr = func_80095838;
L1_SpuStart = func_800937B4;
L1_SquareRoot0 = func_800792D0;
L1_SquareRoot12 = func_8008E8D8;
L1_SsEnd = func_80088230;
L1_SsPitchFromNote = func_80091880;
L1_SsSeqCalledTbyT = func_80095E38;
L1_SsSetSerialAttr = func_80083E68;
L1_SsSetSerialVol = func_80083CBC;
L1_SsSetTickMode = func_80087990;
L1_SsUtAllKeyOff = func_80087830;
L1_SsVabClose = func_80088180;
L1_SsVabOpenHead = func_8008E148;
L1_SsVabTransBody = func_8008DEF8;
L1_SsVabTransCompleted = func_8008DFC8;
L1_SsVoKeyOn = func_80083914;
L1_SysDeqIntRP = func_80097478;
L1_SysEnqIntRP = func_80097488;
L1_TestEvent = func_8009D374;
L1_TransposeMatrix = func_8008E7A8;
L1_VSYNC_OBJ_178 = func_80086460;
L1_VS_VH2_OBJ_34 = func_8008E17C;
L1_VSync = func_800862E8;
func_80075C44 = L1_Vec_Dot;
func_80075CC0 = L1_Vec_ProjectXZ;
func_80075D68 = L1_Vec_Scale;
L1_WaitEvent = func_8009D044;
L1__SN_read = func_800938BC;
L1__SN_write = func_800954A0;
L1__SpuInit = func_800936CC;
L1__SpuSetAnyVoice = func_8009D3E4;
L1__SsGetSeqData = func_8009D9E4;
L1__SsInit = func_80090A9C;
L1__SsReadDeltaValue = func_8009E524;
L1__SsSeqGetEof = func_8009D7A0;
L1__SsSeqPlay = func_8009D6A4;
L1__SsSndCrescendo = func_8009C904;
L1__SsSndNextSep = func_8009E424;
L1__SsSndPause = func_8009CD34;
L1__SsSndPlay = func_8009C8D4;
L1__SsSndReplay = func_8009CDD4;
L1__SsSndTempo = func_8009CB14;
L1__SsVmAlloc = func_800926A4;
L1__SsVmDoAllocate = func_8009108C;
L1__SsVmFlush = func_80090BFC;
L1__SsVmInit = func_8009BF94;
L1__SsVmKeyOffNow = func_80091E7C;
L1__SsVmKeyOnNow = func_800919AC;
L1__SsVmSelectToneAndVag = func_8009C574;
L1__SsVmVSetUp = func_80090B3C;
L1__dirFailAuto = func_80096760;
L1__gp = D_800ADB50;
L1__padInitDirSeq = func_800963B8;
L1__patch_gte = func_80097B98;
L1__spu_gcSPU = func_8009D064;
L1_bzero = func_80096878;
L1_calloc3 = func_8008DC78;
L1_chkRC2wait = func_800974B8;
L1_exit = func_80084098;
L1_free3 = func_8008DDA8;
PROVIDE(L1_func_800274F4 = func_80027618);
PROVIDE(func_80027618 = L1_func_800274F4);
func_80028494 = L1_func_80028370;
PROVIDE(L1_func_8002847C = func_800285A0);
PROVIDE(func_800285A0 = L1_func_8002847C);
func_8002879C = L1_func_80028678;
L1_func_800286EC = func_80028810;
func_80028850 = L1_func_8002872C;
func_80028934 = L1_func_80028810;
func_8002897C = L1_func_80028858;
func_80028A7C = L1_func_80028958;
L1_func_800289C0 = func_80028AE4;
func_80028C7C = L1_func_80028B58;
func_80028D2C = L1_func_80028C08;
func_80028EE0 = L1_func_80028DBC;
func_80029188 = L1_func_80029064;
PROVIDE(L1_func_800291B0 = func_800292D4);
PROVIDE(func_800292D4 = L1_func_800291B0);
func_800295D8 = L1_func_800294B4;
func_80029628 = L1_func_80029504;
L1_func_8002967C = func_800297A0;
func_800297A8 = L1_func_80029684;
func_8002998C = L1_func_80029868;
L1_func_800299CC = func_80029AF0;
PROVIDE(L1_func_80029A34 = func_80029B58);
PROVIDE(func_80029B58 = L1_func_80029A34);
func_8002A4EC = L1_func_8002A3C8;
func_8002A740 = L1_func_8002A61C;
func_8002A844 = L1_func_8002A720;
func_8002A978 = L1_func_8002A854;
func_8002ABB8 = L1_func_8002AA94;
L1_func_8002AAC4 = func_8002ABE8;
func_8002AC20 = L1_func_8002AAFC;
func_8002ADB4 = L1_func_8002AC90;
L1_func_8002ADF0 = func_8002AF14;
func_8002AF58 = L1_func_8002AE34;
L1_func_8002AF08 = func_8002B02C;
func_8002B11C = L1_func_8002AFF8;
L1_func_8002B064 = func_8002B188;
func_8002B1C4 = L1_func_8002B0A0;
func_8002B2A0 = L1_func_8002B17C;
PROVIDE(L1_func_8002B29C = func_8002B3C0);
PROVIDE(func_8002B3C0 = L1_func_8002B29C);
func_8002B7C0 = L1_func_8002B69C;
L1_func_8002BB34 = func_8002BC58;
func_8002BC8C = L1_func_8002BB68;
func_8002BD3C = L1_func_8002BC18;
func_8002BF48 = L1_func_8002BE24;
func_8002C058 = L1_func_8002BF34;
func_8002C28C = L1_func_8002C168;
L1_func_8002C2D8 = func_8002C3FC;
func_8002C5B4 = L1_func_8002C490;
L1_func_8002C664 = func_8002C788;
func_8002C7E0 = L1_func_8002C6BC;
L1_func_8002C83C = func_8002C960;
L1_func_8002C844 = func_8002C968;
func_8002D214 = L1_func_8002D0F0;
func_8002D2F8 = L1_func_8002D1D4;
func_8002D608 = L1_func_8002D4E4;
func_8002D728 = L1_func_8002D604;
func_8002D82C = L1_func_8002D708;
func_8002DE28 = L1_func_8002DD6C;
L1_func_8002E0E8 = func_8002E1B0;
L1_func_8002E190 = func_8002E258;
func_8002E278 = L1_func_8002E1B0;
func_8002E3EC = L1_func_8002E318;
L1_func_8002E3A0 = func_8002E474;
L1_func_8002E410 = func_8002E4E4;
L1_func_8002E430 = func_8002E504;
L1_func_8002E48C = func_8002E560;
L1_func_8002E4B4 = func_8002E588;
L1_func_8002E4D4 = func_8002E5A8;
func_8002E5B0 = L1_func_8002E4DC;
L1_func_8002E534 = func_8002E608;
L1_func_8002E5C4 = func_8002E698;
PROVIDE(L1_func_8002E798 = func_8002E874);
PROVIDE(func_8002E874 = L1_func_8002E798);
L1_func_8002F0A4 = func_8002F180;
L1_func_8002F114 = func_8002F1F0;
L1_func_8002F53C = func_8002F618;
func_8002F640 = L1_func_8002F564;
func_8002F700 = L1_func_8002F624;
L1_func_8002F7CC = func_8002F8A8;
PROVIDE(L1_func_8002FFD8 = func_80030094);
PROVIDE(func_80030094 = L1_func_8002FFD8);
func_800301D4 = L1_func_80030118;
func_80030368 = L1_func_800302AC;
L1_func_80030304 = func_800303C0;
L1_func_80030324 = func_800303E0;
func_800303F0 = L1_func_80030334;
func_80030470 = L1_func_800303B4;
PROVIDE(L1_func_8003052C = func_800305E8);
PROVIDE(func_800305E8 = L1_func_8003052C);
L1_func_800305B4 = func_80030670;
L1_func_80030610 = func_800306CC;
func_8003072C = L1_func_80030670;
L1_func_800306A8 = func_80030764;
L1_func_800306F0 = func_800307AC;
func_80030854 = L1_func_80030798;
L1_func_80030868 = func_80030924;
PROVIDE(L1_func_80030994 = func_80030A50);
PROVIDE(func_80030A50 = L1_func_80030994);
func_80030BC0 = L1_func_80030B04;
func_80030DC4 = L1_func_80030D08;
func_80030E5C = L1_func_80030DA0;
L1_func_80030EB0 = func_80030F6C;
func_80030FDC = L1_func_80030F20;
func_80031064 = L1_func_80030FA8;
L1_func_800310B4 = func_80031170;
L1_func_80031678 = func_80031780;
L1_func_80031F18 = func_80032020;
func_8003217C = L1_func_80032074;
func_800322F8 = L1_func_800321F0;
func_80032598 = L1_func_8003246C;
L1_func_800324C0 = func_800325EC;
func_800325FC = L1_func_800324D0;
L1_func_80032648 = func_80032774;
func_80032850 = L1_func_80032724;
func_80032894 = L1_func_80032768;
L1_func_80032880 = func_800329AC;
func_80032F78 = L1_func_80032E4C;
PROVIDE(L1_func_80032EFC = func_80033028);
PROVIDE(func_80033028 = L1_func_80032EFC);
func_800331BC = L1_func_80033090;
func_800333D0 = L1_func_800332A4;
func_80033474 = L1_func_80033348;
func_80033500 = L1_func_800333D4;
func_8003354C = L1_func_800334F4;
L1_func_80033F38 = func_8003466C;
func_800352B0 = L1_func_800349F8;
func_800358E8 = L1_func_80035030;
L1_func_800350F0 = func_800359A8;
PROVIDE(L1_func_800352B8 = func_80035BA0);
PROVIDE(func_80035BA0 = L1_func_800352B8);
func_8003624C = L1_func_80035964;
func_800362D4 = L1_func_800359EC;
func_800364A4 = L1_func_80035BBC;
func_800366D0 = L1_func_80035DE8;
func_800367EC = L1_func_80035F04;
func_80036AA4 = L1_func_800361BC;
func_80036C10 = L1_func_80036328;
func_80036E9C = L1_func_800365B4;
func_80036F58 = L1_func_80036670;
L1_func_800368A8 = func_80037190;
L1_func_80036938 = func_80037220;
func_800378BC = L1_func_80036E10;
L1_func_800373FC = func_80037EA8;
func_800381D0 = L1_func_80037768;
func_8003825C = L1_func_800377F4;
func_80038364 = L1_func_800378FC;
func_8003848C = L1_func_80037A24;
func_80038534 = L1_func_80037ACC;
L1_func_80037B6C = func_800385D4;
func_80038AFC = L1_func_800380DC;
PROVIDE(L1_func_800381CC = func_80038BEC);
PROVIDE(func_80038BEC = L1_func_800381CC);
func_80038E24 = L1_func_80038404;
func_800399E8 = L1_func_80038984;
func_80039C68 = L1_func_80038C04;
func_80039CF0 = L1_func_80038C8C;
L1_func_800390F8 = func_8003A15C;
PROVIDE(L1_func_800391B0 = func_8003A214);
PROVIDE(func_8003A214 = L1_func_800391B0);
L1_func_800393AC = func_8003A410;
func_8003A448 = L1_func_800393E4;
L1_func_80039520 = func_8003A584;
L1_func_800395E8 = func_8003A64C;
func_8003A7E4 = L1_func_800397A8;
PROVIDE(L1_func_8003982C = func_8003A868);
PROVIDE(func_8003A868 = L1_func_8003982C);
func_8003AA70 = L1_func_80039A34;
PROVIDE(L1_func_80039A9C = func_8003AAD8);
PROVIDE(func_8003AAD8 = L1_func_80039A9C);
PROVIDE(L1_func_8003A51C = func_8003B558);
PROVIDE(func_8003B558 = L1_func_8003A51C);
PROVIDE(L1_func_8003A68C = func_8003B6C8);
PROVIDE(func_8003B6C8 = L1_func_8003A68C);
L1_func_8003A71C = func_8003B758;
func_8003B8D4 = L1_func_8003A898;
func_8003BA50 = L1_func_8003AA14;
PROVIDE(L1_func_8003AC1C = func_8003BC58);
PROVIDE(func_8003BC58 = L1_func_8003AC1C);
func_8003C530 = L1_func_8003B4F4;
PROVIDE(L1_func_8003B53C = func_8003C578);
PROVIDE(func_8003C578 = L1_func_8003B53C);
L1_func_8003B750 = func_8003C78C;
PROVIDE(L1_func_8003B808 = func_8003C844);
PROVIDE(func_8003C844 = L1_func_8003B808);
func_8003C97C = L1_func_8003B940;
func_8003CCD4 = L1_func_8003BC98;
func_8003CEA4 = L1_func_8003BE68;
func_8003CFF4 = L1_func_8003BFB8;
L1_func_8003C1BC = func_8003D1F8;
func_8003D6B4 = L1_func_8003C6B0;
func_8003D6E8 = L1_func_8003C6E4;
func_8003D890 = L1_func_8003C88C;
func_8003D8A8 = L1_func_8003C8A4;
func_8003D9C8 = L1_func_8003C9C4;
L1_func_8003CA4C = func_8003DA50;
func_8003DAC0 = L1_func_8003CABC;
L1_func_8003CC8C = func_8003DC90;
PROVIDE(L1_func_8003D76C = func_8003E700);
PROVIDE(func_8003E700 = L1_func_8003D76C);
func_8003EDEC = L1_func_8003DE58;
func_8003F0EC = L1_func_8003E158;
func_8003F428 = L1_func_8003E494;
PROVIDE(L1_func_8003E5A0 = func_8003F534);
PROVIDE(func_8003F534 = L1_func_8003E5A0);
func_8003F9B8 = L1_func_8003EA24;
func_8003FA94 = L1_func_8003EB00;
PROVIDE(L1_func_8003EC44 = func_8003FBD8);
PROVIDE(func_8003FBD8 = L1_func_8003EC44);
func_800406FC = L1_func_8003F768;
func_80040C60 = L1_func_8003FCE4;
func_80040F18 = L1_func_8003FF9C;
L1_func_8004009C = func_80041018;
PROVIDE(L1_func_80040778 = func_80041558);
PROVIDE(func_80041558 = L1_func_80040778);
func_80041758 = L1_func_80040978;
func_80041888 = L1_func_80040AA8;
func_80041E3C = L1_func_8004105C;
func_80041F9C = L1_func_800411BC;
L1_func_8004133C = func_8004211C;
func_800421D4 = L1_func_800413F4;
L1_func_800414AC = func_8004228C;
L1_func_80041578 = func_80042358;
func_800425A4 = L1_func_800417C4;
L1_func_800419CC = func_80042870;
func_800428DC = L1_func_80041A38;
func_80042A44 = L1_func_80041BA0;
func_80042ACC = L1_func_80041C28;
func_80042B94 = L1_func_80041CF0;
func_80042C60 = L1_func_80041DBC;
func_80042D1C = L1_func_80041E78;
func_80042EC4 = L1_func_80042020;
func_80043030 = L1_func_8004218C;
PROVIDE(L1_func_800425E4 = func_80043488);
PROVIDE(func_80043488 = L1_func_800425E4);
L1_func_80042A94 = func_80043938;
L1_func_80042B28 = func_800439CC;
func_80043BC0 = L1_func_80042D1C;
L1_func_80042E34 = func_80043CD8;
L1_func_80042E6C = func_80043D10;
func_80043F1C = L1_func_80043078;
func_800440A4 = L1_func_80043200;
L1_func_800433A8 = func_8004424C;
L1_func_800433F4 = func_80044298;
PROVIDE(L1_func_80043610 = func_800444B4);
PROVIDE(func_800444B4 = L1_func_80043610);
PROVIDE(L1_func_80043B14 = func_800449B8);
PROVIDE(func_800449B8 = L1_func_80043B14);
L1_func_80043EE0 = func_80044D84;
func_80045724 = L1_func_800448F4;
func_800457EC = L1_func_800449BC;
func_80045890 = L1_func_80044A60;
L1_func_80044B3C = func_8004596C;
L1_func_80044BAC = func_800459DC;
L1_func_80044BBC = func_800459EC;
PROVIDE(L1_func_80044BCC = func_800459FC);
PROVIDE(func_800459FC = L1_func_80044BCC);
func_80045EB4 = L1_func_80045084;
func_80045F7C = L1_func_8004514C;
func_80046174 = L1_func_80045344;
PROVIDE(L1_func_80045A28 = func_80046848);
PROVIDE(func_80046848 = L1_func_80045A28);
func_8004708C = L1_func_8004626C;
PROVIDE(L1_func_800463C8 = func_800471E8);
PROVIDE(func_800471E8 = L1_func_800463C8);
func_80048138 = L1_func_80047318;
PROVIDE(L1_func_800474AC = func_800482CC);
PROVIDE(func_800482CC = L1_func_800474AC);
func_800483DC = L1_func_800475BC;
L1_func_800477C0 = func_800485E0;
L1_func_8004782C = func_8004864C;
L1_func_8004783C = func_8004865C;
func_80048824 = L1_func_80047A04;
func_80048970 = L1_func_80047B50;
func_80048BDC = L1_func_80047DBC;
L1_func_80047ECC = func_80048CEC;
func_800490E8 = L1_func_800483D8;
func_8004912C = L1_func_8004841C;
PROVIDE(L1_func_80048794 = func_800494A4);
PROVIDE(func_800494A4 = L1_func_80048794);
func_8004985C = L1_func_80048B4C;
func_80049AF4 = L1_func_80048DE4;
func_80049B70 = L1_func_80048E60;
L1_func_80048FE8 = func_80049CF8;
L1_func_8004900C = func_80049D1C;
func_8004A0D0 = L1_func_800493C0;
func_8004A180 = L1_func_80049470;
func_8004A44C = L1_func_8004973C;
func_8004A5F4 = L1_func_800498E4;
func_8004A798 = L1_func_80049A88;
L1_func_80049B7C = func_8004A88C;
func_8004A894 = L1_func_80049B84;
PROVIDE(L1_func_80049D60 = func_8004AA70);
PROVIDE(func_8004AA70 = L1_func_80049D60);
L1_func_8004A294 = func_8004AFA4;
L1_func_8004A304 = func_8004B014;
L1_func_8004A338 = func_8004B048;
L1_func_8004A370 = func_8004B080;
L1_func_8004A380 = func_8004B090;
L1_func_8004A398 = func_8004B0A8;
L1_func_8004A8A8 = func_8004B570;
func_8004B5AC = L1_func_8004A8E4;
PROVIDE(L1_func_8004A9E4 = func_8004B6AC);
PROVIDE(func_8004B6AC = L1_func_8004A9E4);
func_8004BBD4 = L1_func_8004AF0C;
L1_func_8004B028 = func_8004BCF0;
L1_func_8004B04C = func_8004BD14;
L1_func_8004B06C = func_8004BD34;
L1_func_8004B084 = func_8004BD4C;
func_8004BD78 = L1_func_8004B0B0;
func_8004BE5C = L1_func_8004B194;
L1_func_8004B270 = func_8004BF38;
L1_func_8004B334 = func_8004D504;
func_8004D58C = L1_func_8004B3BC;
func_8004D75C = L1_func_8004B58C;
func_8004DBCC = L1_func_8004B9FC;
func_8004DCD0 = L1_func_8004BB00;
func_8004DE40 = L1_func_8004BC70;
func_8004DF78 = L1_func_8004BDA8;
L1_func_8004BE84 = func_8004E054;
L1_func_8004BF70 = func_8004E140;
func_8004E37C = L1_func_8004C0C0;
PROVIDE(L1_func_8004C368 = func_8004E624);
PROVIDE(func_8004E624 = L1_func_8004C368);
func_8004E754 = L1_func_8004C498;
L1_func_8004C50C = func_8004E7C8;
func_8004E814 = L1_func_8004C558;
L1_func_8004C5C8 = func_8004E884;
L1_func_8004C698 = func_8004E954;
L1_func_8004C768 = func_8004EA24;
L1_func_8004C824 = func_8004EAE0;
func_8004EAE8 = L1_func_8004C82C;
func_8004EC00 = L1_func_8004C944;
func_8004ED18 = L1_func_8004CA5C;
func_8004EDE8 = L1_func_8004CB2C;
func_8004EEB0 = L1_func_8004CBF4;
func_8004EF94 = L1_func_8004CCD8;
func_8004EFD0 = L1_func_8004CD14;
func_8004F05C = L1_func_8004CDA0;
L1_func_8004CE38 = func_8004F0F4;
func_8004F130 = L1_func_8004CE74;
func_8004F1BC = L1_func_8004CF00;
PROVIDE(L1_func_8004D048 = func_8004F304);
PROVIDE(func_8004F304 = L1_func_8004D048);
func_8004F4D0 = L1_func_8004D214;
func_8004F58C = L1_func_8004D2D0;
L1_func_8004D5A8 = func_8004F864;
func_8004F9E8 = L1_func_8004D72C;
func_8004FA2C = L1_func_8004D770;
func_8004FB00 = L1_func_8004D844;
func_8004FB48 = L1_func_8004D88C;
func_8004FC34 = L1_func_8004D978;
L1_func_8004DA60 = func_8004FD1C;
func_8004FE94 = L1_func_8004DBCC;
func_80050064 = L1_func_8004DD9C;
func_800502C0 = L1_func_8004DFF8;
func_80050344 = L1_func_8004E07C;
func_800505CC = L1_func_8004E304;
func_800505F0 = L1_func_8004E328;
PROVIDE(L1_func_8004E5D8 = func_8005079C);
PROVIDE(func_8005079C = L1_func_8004E5D8);
L1_func_8004E78C = func_80050950;
func_80050958 = L1_func_8004E794;
func_80050A60 = L1_func_8004E89C;
func_80050B30 = L1_func_8004E96C;
func_80050B70 = L1_func_8004E9AC;
L1_func_8004EA68 = func_80050C80;
func_80050CD0 = L1_func_8004EAB8;
func_80050D38 = L1_func_8004EB20;
func_80050E88 = L1_func_8004EC70;
L1_func_8004F134 = func_80051370;
func_80051384 = L1_func_8004F148;
func_80051584 = L1_func_8004F348;
L1_func_8004F3D8 = func_80051614;
PROVIDE(L1_func_8004F3E8 = func_80051624);
PROVIDE(func_80051624 = L1_func_8004F3E8);
PROVIDE(L1_func_8004F880 = func_80051ABC);
PROVIDE(func_80051ABC = L1_func_8004F880);
PROVIDE(L1_func_8004FD3C = func_80051F78);
PROVIDE(func_80051F78 = L1_func_8004FD3C);
func_800523BC = L1_func_80050180;
func_800525C8 = L1_func_8005038C;
PROVIDE(L1_func_800503D8 = func_80052614);
PROVIDE(func_80052614 = L1_func_800503D8);
func_80052C80 = L1_func_80050960;
func_80052CBC = L1_func_8005099C;
func_80052D04 = L1_func_800509E4;
func_80052D30 = L1_func_80050A10;
PROVIDE(L1_func_80050A70 = func_80052D90);
PROVIDE(func_80052D90 = L1_func_80050A70);
func_80053A48 = L1_func_80051728;
func_80054604 = L1_func_800523E4;
func_80054850 = L1_func_80052630;
func_80054A28 = L1_func_80052808;
func_80054D4C = L1_func_80052B2C;
L1_func_80052BEC = func_80054E0C;
func_80055070 = L1_func_80053004;
func_800550EC = L1_func_80053080;
func_80055710 = L1_func_80053684;
L1_func_800536F0 = func_8005577C;
L1_func_80053790 = func_8005581C;
func_80055890 = L1_func_80053804;
func_80055A08 = L1_func_8005397C;
func_80055AB8 = L1_func_80053A2C;
func_80055B08 = L1_func_80053A7C;
func_80055BF0 = L1_func_80053B64;
L1_func_80053BD0 = func_80055C5C;
func_80055C6C = L1_func_80053BE0;
func_80055E70 = L1_func_80053DE4;
func_80055F64 = L1_func_80053ED8;
func_8005621C = L1_func_80054098;
func_80056250 = L1_func_800540CC;
func_8005629C = L1_func_80054118;
func_800562F0 = L1_func_8005416C;
func_800563EC = L1_func_80054268;
func_80056490 = L1_func_8005430C;
func_80056540 = L1_func_800543BC;
L1_func_80054414 = func_80056598;
func_80056814 = L1_func_80054604;
func_800568AC = L1_func_8005469C;
func_800569D4 = L1_func_800547C4;
func_80056A4C = L1_func_8005483C;
func_80056B74 = L1_func_80054964;
func_80056CD8 = L1_func_80054AC8;
func_80056E08 = L1_func_80054BF8;
func_80056FB4 = L1_func_80054DA4;
func_80057048 = L1_func_80054E38;
func_80057144 = L1_func_80054F34;
func_800571EC = L1_func_80054FDC;
func_80057270 = L1_func_80055060;
func_8005737C = L1_func_8005516C;
func_80057414 = L1_func_80055204;
func_800574AC = L1_func_8005529C;
func_8005750C = L1_func_800552FC;
func_8005756C = L1_func_8005535C;
func_800575D0 = L1_func_800553C0;
func_80057720 = L1_func_80055510;
func_800577A8 = L1_func_80055598;
func_80057880 = L1_func_80055670;
func_800579D8 = L1_func_800557C8;
PROVIDE(L1_func_800557F4 = func_80057A04);
PROVIDE(func_80057A04 = L1_func_800557F4);
func_80057A24 = L1_func_80055814;
PROVIDE(L1_func_80055BA8 = func_80057DD8);
PROVIDE(func_80057DD8 = L1_func_80055BA8);
func_80058054 = L1_func_80055E24;
func_80058188 = L1_func_80055F58;
func_80058284 = L1_func_80056054;
func_80058340 = L1_func_80056110;
PROVIDE(L1_func_80056154 = func_80058384);
PROVIDE(func_80058384 = L1_func_80056154);
func_80058588 = L1_func_80056358;
func_800585EC = L1_func_800563BC;
func_80058674 = L1_func_80056444;
func_800586DC = L1_func_800564AC;
func_80058768 = L1_func_80056538;
func_800587A0 = L1_func_80056570;
func_8005880C = L1_func_800565DC;
func_80058844 = L1_func_80056614;
func_80058928 = L1_func_800566F8;
func_80058A6C = L1_func_8005683C;
func_80058AC4 = L1_func_80056894;
func_80058F4C = L1_func_80056D1C;
func_800591C0 = L1_func_80056F90;
func_800592A4 = L1_func_80057074;
func_80059328 = L1_func_800570F8;
func_800593C4 = L1_func_80057194;
func_800593E8 = L1_func_800571B8;
PROVIDE(L1_func_800572F4 = func_80059524);
PROVIDE(func_80059524 = L1_func_800572F4);
func_800595D4 = L1_func_800573A4;
func_80059640 = L1_func_80057410;
func_8005966C = L1_func_8005743C;
func_800596AC = L1_func_8005747C;
func_8005982C = L1_func_800575FC;
L1_func_80057648 = func_80059878;
PROVIDE(L1_func_80057750 = func_80059980);
PROVIDE(func_80059980 = L1_func_80057750);
func_80059CE0 = L1_func_80057AB0;
L1_func_80057AD8 = func_80059D08;
func_80059D5C = L1_func_80057B2C;
L1_func_80057B94 = func_80059DC4;
L1_func_80057BFC = func_80059E2C;
L1_func_80058694 = func_8005A8C4;
func_8005AA8C = L1_func_8005885C;
func_8005AC88 = L1_func_80058A58;
func_8005AD40 = L1_func_80058B10;
func_8005AD9C = L1_func_80058B6C;
L1_func_80058D00 = func_8005AF30;
func_8005AF8C = L1_func_80058D5C;
func_8005B02C = L1_func_8005AD6C;
L1_func_8005ADB0 = func_8005B070;
PROVIDE(L1_func_8005ADD4 = func_8005B094);
PROVIDE(func_8005B094 = L1_func_8005ADD4);
PROVIDE(L1_func_8005AEF8 = func_8005B1B8);
PROVIDE(func_8005B1B8 = L1_func_8005AEF8);
func_8005B7C8 = L1_func_8005B508;
func_8005B844 = L1_func_8005B584;
func_8005B86C = L1_func_8005B5AC;
func_8005B98C = L1_func_8005B6CC;
func_8005BA2C = L1_func_8005B76C;
func_8005BA7C = L1_func_8005B7BC;
func_8005BB2C = L1_func_8005B86C;
func_8005BC2C = L1_func_8005B96C;
func_8005BCF0 = L1_func_8005BA30;
func_8005BDA8 = L1_func_8005BAE8;
func_8005BF40 = L1_func_8005BC80;
func_8005C1B0 = L1_func_8005BEF0;
func_8005C3CC = L1_func_8005C10C;
PROVIDE(L1_func_8005C214 = func_8005C4D4);
PROVIDE(func_8005C4D4 = L1_func_8005C214);
func_8005C5FC = L1_func_8005C33C;
L1_func_8005C864 = func_8005CB24;
L1_func_8005C894 = func_8005CB54;
func_8005CB84 = L1_func_8005C8C4;
func_8005CCE0 = L1_func_8005CA20;
L1_func_8005CB38 = func_8005CDF8;
func_8005D188 = L1_func_8005CED0;
PROVIDE(L1_func_8005CFC8 = func_8005D280);
PROVIDE(func_8005D280 = L1_func_8005CFC8);
func_8005D568 = L1_func_8005D2B0;
L1_func_8005D58C = func_8005D844;
func_8005D87C = L1_func_8005D5C4;
func_8005D8E8 = L1_func_8005D630;
L1_func_8005D654 = func_8005D90C;
func_8005D94C = L1_func_8005D694;
func_8005DA18 = L1_func_8005D760;
L1_func_8005DA90 = func_8005DD48;
PROVIDE(L1_func_8005DB7C = func_8005DE34);
PROVIDE(func_8005DE34 = L1_func_8005DB7C);
func_8005DEF8 = L1_func_8005DC40;
L1_func_8005DF40 = func_8005E1F8;
func_8005E234 = L1_func_8005DF7C;
func_8005E2D8 = L1_func_8005E020;
func_8005E4E0 = L1_func_8005E228;
PROVIDE(L1_func_8005E424 = func_8005E6DC);
PROVIDE(func_8005E6DC = L1_func_8005E424);
func_8005ED94 = L1_func_8005EADC;
func_8005EE24 = L1_func_8005EB6C;
func_8005EF3C = L1_func_8005EC84;
func_8005F0B0 = L1_func_8005EE6C;
L1_func_8005F3B0 = func_8005F5EC;
func_8005FB24 = L1_func_8005F93C;
func_8005FC90 = L1_func_8005FAA8;
L1_func_80060094 = func_8006026C;
L1_func_800600EC = func_800602C4;
func_80060614 = L1_func_8006043C;
func_80060688 = L1_func_800604B0;
L1_func_8006060C = func_800607E4;
func_800607EC = L1_func_80060614;
func_80060970 = L1_func_80060798;
func_80060ABC = L1_func_800608E4;
func_80060C98 = L1_func_80060AC0;
L1_func_80060E28 = func_80060FFC;
L1_func_80061018 = func_800611C8;
PROVIDE(L1_func_80061068 = func_8006125C);
PROVIDE(func_8006125C = L1_func_80061068);
func_800617BC = L1_func_800615C8;
L1_func_80061700 = func_800618F4;
func_800618FC = L1_func_80061708;
L1_func_80061DC0 = func_80061DD8;
func_80061EF0 = L1_func_80061EC4;
func_800622E0 = L1_func_80062300;
L1_func_80062394 = func_80062374;
func_80062764 = L1_func_80062784;
func_80062B48 = L1_func_80062B68;
func_80062F18 = L1_func_80062F38;
PROVIDE(L1_func_80062FAC = func_80062F8C);
PROVIDE(func_80062F8C = L1_func_80062FAC);
func_80063210 = L1_func_800632AC;
func_80063314 = L1_func_800633B0;
func_80063424 = L1_func_800634C0;
func_8006361C = L1_func_800636B8;
func_80063714 = L1_func_800637B0;
L1_func_80063858 = func_800637BC;
L1_func_80063ADC = func_80063A40;
func_80063A84 = L1_func_80063B20;
func_80063C10 = L1_func_80063CAC;
func_80063CA4 = L1_func_80063D40;
L1_func_80063ED4 = func_80063E38;
L1_func_80063EF8 = func_80063E5C;
func_80063E98 = L1_func_80063F34;
func_80063EE8 = L1_func_80063F84;
func_80064090 = L1_func_8006412C;
func_800640E0 = L1_func_8006417C;
func_80064180 = L1_func_8006439C;
func_800642C0 = L1_func_800644DC;
func_80064400 = L1_func_8006461C;
L1_func_80064660 = func_80064444;
func_80064630 = L1_func_8006484C;
func_800647F4 = L1_func_80064A10;
func_80064A0C = L1_func_80064C28;
L1_func_80064E40 = func_80064C24;
func_80064E98 = L1_func_80065510;
L1_func_80065588 = func_80064F10;
func_80064F40 = L1_func_800655B8;
func_80064F9C = L1_func_80065614;
L1_func_800658B4 = func_8006523C;
func_800652B0 = L1_func_80065928;
PROVIDE(L1_func_80065A20 = func_800653A8);
PROVIDE(func_800653A8 = L1_func_80065A20);
func_80065A20 = L1_func_80066098;
func_80065C30 = L1_func_800662A8;
func_80065E40 = L1_func_800664B8;
func_8006608C = L1_func_80066704;
L1_func_8006692C = func_800662B4;
L1_func_80066968 = func_800662F0;
func_8006632C = L1_func_800669A4;
L1_func_80066A60 = func_800663E8;
L1_func_80066B14 = func_80066A78;
L1_func_80067F18 = func_80068914;
func_80069B80 = L1_func_800689F0;
L1_func_80069318 = func_8006A654;
L1_func_80069328 = func_8006A664;
L1_func_800693DC = func_8006A744;
func_8006A75C = L1_func_80069478;
L1_func_8006981C = func_8006AAB4;
L1_func_80069850 = func_8006AB60;
L1_func_800698B8 = func_8006AB94;
L1_func_8006B198 = func_8006BF84;
L1_func_8006B1DC = func_8006BFC8;
L1_func_8006B230 = func_8006C01C;
func_8006C060 = L1_func_8006B274;
PROVIDE(L1_func_8006B2C4 = func_8006C0B0);
PROVIDE(func_8006C0B0 = L1_func_8006B2C4);
func_8006D280 = L1_func_8006C494;
func_8006D6E0 = L1_func_8006C8F4;
PROVIDE(L1_func_8006CB88 = func_8006D974);
PROVIDE(func_8006D974 = L1_func_8006CB88);
PROVIDE(L1_func_8006CEA4 = func_8006DC90);
PROVIDE(func_8006DC90 = L1_func_8006CEA4);
func_8006E1AC = L1_func_8006D3C0;
PROVIDE(L1_func_8006D470 = func_8006E25C);
PROVIDE(func_8006E25C = L1_func_8006D470);
func_8006EB0C = L1_func_8006DD20;
PROVIDE(L1_func_8006E054 = func_8006EE40);
PROVIDE(func_8006EE40 = L1_func_8006E054);
func_8006F40C = L1_func_8006E620;
func_8006F7CC = L1_func_8006E9E0;
func_8006FAA8 = L1_func_8006ECBC;
func_8006FC94 = L1_func_8006EEA8;
func_8006FE20 = L1_func_8006F034;
PROVIDE(L1_func_8006F168 = func_8006FF54);
PROVIDE(func_8006FF54 = L1_func_8006F168);
func_80070498 = L1_func_8006F6AC;
PROVIDE(L1_func_8006F784 = func_80070570);
PROVIDE(func_80070570 = L1_func_8006F784);
func_80070790 = L1_func_8006F9A4;
func_80070840 = L1_func_8006FA54;
func_800708F0 = L1_func_8006FB04;
func_80070CC0 = L1_func_8006FED4;
func_80070E5C = L1_func_80070070;
func_800710B8 = L1_func_800702CC;
func_80071394 = L1_func_800705A8;
func_800714DC = L1_func_800706F0;
func_80072424 = L1_func_80071638;
PROVIDE(L1_func_80072190 = func_80072F7C);
PROVIDE(func_80072F7C = L1_func_80072190);
func_800731F8 = L1_func_8007240C;
PROVIDE(L1_func_800726D0 = func_800734BC);
PROVIDE(func_800734BC = L1_func_800726D0);
func_80073B34 = L1_func_80072D48;
func_80073C14 = L1_func_80072E28;
PROVIDE(L1_func_8007369C = func_80074488);
PROVIDE(func_80074488 = L1_func_8007369C);
func_800751D4 = L1_func_800743E8;
PROVIDE(L1_func_800746D0 = func_800754BC);
PROVIDE(func_800754BC = L1_func_800746D0);
func_80075DD4 = L1_func_80074FE8;
func_800760AC = L1_func_800752C0;
PROVIDE(L1_func_800752E8 = func_800760D4);
PROVIDE(func_800760D4 = L1_func_800752E8);
L1_func_800753A4 = func_80076190;
L1_func_800753F0 = func_800761DC;
func_80076248 = L1_func_8007545C;
func_800763A8 = L1_func_800755BC;
func_80076468 = L1_func_8007567C;
func_800765AC = L1_func_800757C0;
L1_func_800758C0 = func_800766AC;
func_800766DC = L1_func_800758F0;
func_8007670C = L1_func_80075920;
func_80076B34 = L1_func_80075D48;
func_80076C88 = L1_func_80075E9C;
func_80076D0C = L1_func_80075F20;
L1_func_80075FE4 = func_80076DD0;
func_80076E00 = L1_func_80076014;
L1_func_800760B4 = func_80076EA0;
func_80076EF0 = L1_func_80076104;
func_80076F70 = L1_func_80076184;
L1_func_80077764 = func_800794E0;
L1_func_800779FC = func_80079778;
L1_func_80077CCC = func_80079A48;
L1_func_80077D50 = func_80079ACC;
L1_func_80077FC4 = func_80079D40;
L1_func_800781B4 = func_80079F30;
L1_func_80078534 = func_8007A2B0;
L1_func_800785A8 = func_8007A324;
L1_func_800787FC = func_8007A578;
L1_func_80078840 = func_8007A5BC;
L1_func_800788E0 = func_8007A65C;
L1_func_800792B8 = func_8007B588;
L1_func_80079390 = func_8007B660;
L1_func_800793EC = func_8007B6BC;
L1_func_800794A0 = func_8007B770;
L1_func_800794D4 = func_8007B7A4;
L1_func_80079588 = func_8007B858;
L1_func_800797A8 = func_8007BA78;
L1_func_8007980C = func_8007BAC8;
L1_func_800798A8 = func_8007BBBC;
L1_func_800798D4 = func_8007BC14;
L1_func_80079B94 = func_8007BED4;
L1_func_80079C04 = func_8007BF44;
L1_func_80079C54 = func_8007BF94;
L1_func_80079D84 = func_8007C0E8;
L1_func_80079DB8 = func_8007C144;
L1_func_80079E10 = func_8007C19C;
L1_func_80079F84 = func_8007C310;
L1_func_8007A040 = func_8007C404;
L1_func_8007A17C = func_8007C540;
L1_func_8007A1B0 = func_8007C574;
L1_func_8007A1FC = func_8007C5C0;
L1_func_8007A4E4 = func_8007C8A8;
L1_func_8007A554 = func_8007C918;
L1_func_8007A580 = func_8007C944;
L1_func_8007A614 = func_8007C9D8;
L1_func_8007A694 = func_8007CA58;
L1_func_8007AA94 = func_8007CE58;
L1_func_8007AC7C = func_8007D040;
L1_func_8007CE30 = func_8007F1F4;
L1_func_8007D184 = func_8007F548;
L1_func_8007D1E8 = func_8007F5AC;
L1_func_8007D260 = func_8007F624;
L1_func_8007D2B4 = func_8007F678;
L1_func_8007D914 = func_8007FCD8;
L1_func_8007DA88 = func_8007FE4C;
L1_func_8007DE50 = func_80080214;
L1_func_8007E610 = func_800809D4;
L1_func_8007E6A4 = func_80080A68;
L1_func_8007EB7C = func_80080F40;
L1_func_8007EC78 = func_8008103C;
L1_func_8007ED98 = func_8008115C;
L1_func_8007EE34 = func_800811F8;
L1_func_8007EE64 = func_80081228;
L1_func_8007EEBC = func_80081280;
L1_func_8007EECC = func_80081290;
L1_func_8007F040 = func_80081404;
L1_func_8007F0D8 = func_8008149C;
L1_func_8007F140 = func_80081504;
L1_func_8007F25C = func_80081620;
L1_func_8007F2EC = func_800816B0;
L1_func_8007F34C = func_80081710;
L1_func_8007F414 = func_800817D8;
L1_func_8007F4C0 = func_80081884;
L1_func_8007F530 = func_800818F4;
L1_func_8007F5F0 = func_800819B4;
L1_func_8007FAE8 = func_80081EAC;
L1_func_8007FCE0 = func_800820A4;
L1_func_8007FF50 = func_80082314;
L1_func_8007FF70 = func_80082334;
L1_func_80080008 = func_800823CC;
L1_func_800800A0 = func_80082464;
L1_func_800800BC = func_80082480;
L1_func_8008013C = func_80082500;
L1_func_80080154 = func_80082518;
L1_func_80080234 = func_800825F8;
L1_func_80080464 = func_80082828;
L1_func_800806A0 = func_80082A64;
L1_func_80080920 = func_80082CE4;
L1_func_80080944 = func_80082D08;
L1_func_80080958 = func_80082D1C;
L1_func_80080998 = func_80082D5C;
L1_func_800809E0 = func_80082DA4;
L1_func_80080A10 = func_80082DD4;
L1_func_80080A34 = func_80082DF8;
L1_func_80080CE4 = func_800830A8;
L1_func_80080F44 = func_80083308;
L1_func_80081094 = func_80083458;
L1_func_800811D0 = func_80083594;
L1_func_80081204 = func_800835C8;
L1_func_80081348 = func_8008370C;
L1_func_800813E8 = func_800837AC;
L1_func_80081410 = func_800837D4;
L1_func_80081448 = func_8008380C;
L1_func_80081458 = func_8008381C;
L1_func_800814CC = func_80083890;
L1_func_800815A0 = func_80083964;
L1_func_80081A08 = func_80083DCC;
L1_func_80081B74 = func_80083F38;
L1_func_80081C54 = func_80084018;
L1_func_80081C84 = func_80084048;
L1_func_80081CE4 = func_800840A8;
L1_func_80081D14 = func_800840D8;
L1_func_80082638 = func_800849FC;
L1_func_800828AC = func_80084C70;
L1_func_8008297C = func_80084D40;
L1_func_80082B64 = func_80084F28;
L1_func_80082D00 = func_800850C4;
L1_func_80082E04 = func_800851C8;
L1_func_80082ED8 = func_8008529C;
L1_func_80082EE8 = func_800852AC;
L1_func_80082EF8 = func_800852BC;
L1_func_80082F04 = func_800852C8;
L1_func_80082F24 = func_800852E8;
L1_func_80082F44 = func_80085308;
L1_func_80082F64 = func_80085328;
L1_func_80082F78 = func_8008533C;
L1_func_80082F8C = func_80085350;
L1_func_800830C8 = func_8008548C;
L1_func_800831FC = func_800855C0;
L1_func_80083348 = func_8008570C;
L1_func_80083368 = func_8008572C;
L1_func_80083388 = func_8008574C;
L1_func_800833AC = func_80085770;
L1_func_800833CC = func_80085790;
L1_func_800834D0 = func_80085894;
L1_func_80083F14 = func_800862D8;
L1_func_80084134 = func_800864F8;
L1_func_80084164 = func_80086528;
L1_func_80084194 = func_80086558;
L1_func_800841C4 = func_80086588;
L1_func_800841F8 = func_800865BC;
L1_func_80084228 = func_800865EC;
L1_func_80084238 = func_800865FC;
L1_func_80084250 = func_80086614;
L1_func_80084328 = func_800866EC;
L1_func_800844F8 = func_800868BC;
L1_func_80084640 = func_80086A04;
L1_func_800846E0 = func_80086AA4;
L1_func_80084758 = func_80086B1C;
L1_func_80084E0C = func_800871D0;
L1_func_800855BC = func_80087980;
L1_func_8008571C = func_80087AE0;
L1_func_8008596C = func_80087D30;
L1_func_800859B8 = func_80087D7C;
L1_func_80085B5C = func_80087F20;
L1_func_80085BD0 = func_80087F94;
L1_func_800865BC = func_80088980;
L1_func_80086688 = func_80088A4C;
L1_func_80086780 = func_80088B44;
L1_func_80086854 = func_80088C18;
L1_func_8008688C = func_80088C50;
L1_func_800868D4 = func_80088C98;
L1_func_80086928 = func_80088CEC;
L1_func_80086A40 = func_80088E04;
L1_func_80086A6C = func_80088E30;
L1_func_80086AD4 = func_80088E98;
L1_func_80086C64 = func_80089028;
L1_func_80086D30 = func_800890F4;
L1_func_80086D74 = func_80089138;
L1_func_800870A8 = func_8008946C;
L1_func_80087198 = func_8008955C;
L1_func_800873A8 = func_8008976C;
L1_func_80087620 = func_800899E4;
L1_func_800876B0 = func_80089A74;
L1_func_800876E4 = func_80089AA8;
L1_func_80088C44 = func_8008B008;
L1_func_8008A404 = func_8008C7C8;
L1_func_8008A904 = func_8008CCC8;
L1_func_8008C5A4 = func_8008E978;
L1_func_8008C5C4 = func_8008E998;
L1_func_8008C5D8 = func_8008E9AC;
L1_func_8008C638 = func_8008EA0C;
L1_func_8008CCB8 = func_8008EE8C;
L1_func_8008D2EC = func_8008F4C0;
L1_func_8008DAAC = func_8008FC80;
L1_func_8008DB68 = func_8008FD3C;
L1_func_8008DBDC = func_8008FDB0;
L1_func_8008E03C = func_800904A0;
L1_func_8008E378 = func_800907DC;
L1_func_8008FAE8 = func_80091F3C;
L1_func_80090004 = func_80092458;
L1_func_80090164 = func_800925B8;
L1_func_80090880 = func_80092CD4;
L1_func_80090B00 = func_80092F54;
L1_func_80090CC0 = func_80093114;
L1_func_80090D7C = func_800931D0;
L1_func_80090FFC = func_80093450;
L1_func_80091080 = func_800934D4;
L1_func_800910C4 = func_80093518;
L1_func_80091168 = func_800935BC;
L1_func_800911C0 = func_80093614;
L1_func_800911E8 = func_8009363C;
L1_func_80091210 = func_80093664;
L1_func_80091450 = func_800938A4;
L1_func_80091480 = func_800938D4;
L1_func_800919DC = func_80093E30;
L1_func_80091C5C = func_800940B0;
L1_func_80091F24 = func_80094378;
L1_func_80092330 = func_80094784;
L1_func_80092404 = func_80094858;
L1_func_800924F4 = func_80094948;
L1_func_800926D4 = func_80094B28;
L1_func_8009283C = func_80094C90;
L1_func_8009293C = func_80094D90;
L1_func_80092A34 = func_80094E88;
L1_func_80092F24 = func_80095378;
L1_func_80092F5C = func_800953B0;
L1_func_8009302C = func_80095480;
L1_func_80093C64 = func_800960B8;
L1_func_80093E24 = func_80096278;
L1_func_80093F24 = func_80096378;
L1_func_80093F4C = func_800963A0;
L1_func_80094434 = func_80096888;
L1_func_80094440 = func_80096894;
L1_func_800944C4 = func_80096918;
L1_func_80094734 = func_80096B88;
L1_func_8009476C = func_80096BC0;
L1_func_80094840 = func_80096C94;
L1_func_800948E8 = func_80096D3C;
L1_func_80094CE0 = func_80097134;
L1_func_80094D48 = func_8009719C;
L1_func_80094D64 = func_800971B8;
L1_func_80094E2C = func_80097280;
L1_func_80094EC4 = func_80097318;
L1_func_80094F18 = func_8009736C;
L1_func_80094F78 = func_800973CC;
L1_func_80094F98 = func_800973EC;
L1_func_80094FAC = func_80097400;
L1_func_80094FCC = func_80097420;
L1_func_80094FEC = func_80097440;
L1_func_8009500C = func_80097460;
L1_func_80095104 = func_80097558;
L1_func_800957F0 = func_80097C44;
L1_func_80095914 = func_80097D68;
L1_func_80095934 = func_80097D88;
L1_func_80095954 = func_80097DA8;
L1_func_80095A44 = func_80097E98;
L1_func_80095A64 = func_80097EB8;
L1_func_80095D7C = func_800981D0;
L1_func_80095ECC = func_80098320;
L1_func_80096270 = func_800986C4;
L1_func_800963C4 = func_80098818;
L1_func_80096738 = func_80098B8C;
L1_func_800967BC = func_80098C10;
L1_func_80096BC0 = func_80099014;
L1_func_80096C54 = func_800990A8;
L1_func_80096C9C = func_800990F0;
L1_func_80096F50 = func_800993A4;
L1_func_80099EB0 = func_8009C304;
L1_func_8009A0A0 = func_8009C4F4;
L1_func_8009A1F0 = func_8009C644;
L1_func_8009A3B0 = func_8009C804;
L1_func_8009A9E0 = func_8009CE34;
L1_func_8009AB60 = func_8009CFB4;
L1_func_8009B940 = func_8009DD94;
L1_func_8009BEAC = func_8009E300;
L1_func_8009BF10 = func_8009E364;
L1_func_8009BFC0 = func_8009E414;
L1_func_800AACFC = func_800ADF6C;
L1_func_800AAEF8 = func_800AE168;
L1_gPsi = D_800B320C;
L1_g_Args = D_800B31EC;
L1_g_CamPosX = D_800B329C;
L1_g_CamPosY = D_800B32A0;
L1_g_CamRotX = D_800B3264;
L1_g_CamTargetX = D_800B3258;
L1_g_Camera = D_800B3254;
L1_g_CheatCodeProgress = D_800B4120;
L1_g_CheatCodes = D_8009F110;
L1_g_CutScene = D_8009F150;
L1_g_DebugPageNames = D_8009F2A4;
L1_g_DebugTextX = D_8009F46C;
L1_g_DebugTextY = D_8009F46E;
L1_g_DevMenu = D_800D662C;
L1_g_FrameCap = D_800B40A4;
L1_g_FrameRate = D_8009F200;
L1_g_GodMode = D_8009F18E;
L1_g_Invincible = D_8009EEDC;
L1_g_MenuUpdateFunc = D_800D7A24;
L1_g_PadAxes = D_800B4464;
L1_g_PadAxesPrev = D_800B4468;
L1_g_PadHeld = D_800B444C;
L1_g_PadPressed = D_800B4454;
L1_g_PadPrev = D_800B4458;
L1_g_Player = D_800B4108;
L1_g_Projection = D_800B3300;
L1_g_Weapons = D_800B3314;
L1_gteMIMefunc = func_8008E858;
L1_gte_rotate_z_matrix = func_800954B8;
L1_jtbl_800A6F68 = jtbl_800A9FF0;
L1_jtbl_800A7168 = jtbl_800AA1F0;
L1_jtbl_800A74B0 = jtbl_800AA538;
L1_jtbl_800A7764 = jtbl_800AA7EC;
L1_jtbl_800A7ED8 = jtbl_800AAFA4;
L1_jtbl_800A8028 = jtbl_800AB0F4;
L1_jtbl_800A8088 = jtbl_800AB154;
L1_jtbl_800A859C = jtbl_800AB668;
L1_jtbl_800A8B20 = jtbl_800ABC74;
L1_jtbl_800A8BE8 = jtbl_800ABD3C;
L1_jtbl_800A98E4 = jtbl_800ACB40;
L1_jtbl_800A9AEC = jtbl_800ACD5C;
L1_jtbl_800A9DF8 = jtbl_800AD068;
L1_jtbl_800AA190 = jtbl_800AD400;
L1_jtbl_800AA1F0 = jtbl_800AD460;
L1_jtbl_800AA270 = jtbl_800AD4E0;
L1_jtbl_800AA2A8 = jtbl_800AD518;
L1_jtbl_800AA330 = jtbl_800AD5A0;
L1_jtbl_800AA540 = jtbl_800AD7B0;
L1_jtbl_800AA560 = jtbl_800AD7D0;
L1_jtbl_800AA780 = jtbl_800AD9F0;
L1_jtbl_800AA860 = jtbl_800ADAD0;
L1_jtbl_800AA880 = jtbl_800ADAF0;
L1_malloc3 = func_8008DCF8;
L1_memchr = func_8008DFB8;
L1_memcpy = func_8008E848;
L1_memmove = func_8009382C;
L1_memset = func_8008E838;
L1_note2pitch = func_800917CC;
L1_note2pitch2 = func_80091818;
L1_printf = func_80081260;
L1_rand = func_80083E58;
L1_ratan2 = func_8008E3B8;
L1_rcos = func_8009C694;
L1_rsin = func_8009C734;
L1_setRC2wait = func_80097498;
L1_setjmp = func_800950B0;
L1_sin_1 = func_8009C770;
L1_sprintf = func_80084138;
L1_start = func_8002C92C;
L1_startIntrDMA = func_800950D0;
L1_startIntrVSync = func_80094F70;
L1_strcat = func_800862A4;
L1_strcmp = func_8008DFF8;
L1_strcpy = func_80084068;
L1_strlen = func_80084038;
L1_strncmp = func_80094F60;
L1_strncpy = func_80090A4C;
L1_strstr = func_8008E138;
L1_strtok = func_8008E008;
L1_strtol = func_8008E128;
L1_toupper = func_80083F28;
L1_vmNoiseOff = func_80092914;
L1_vmNoiseOn = func_8009125C;
L2_D_800A03C0 = D_8009E5DC;
L2_D_800A0425 = D_8009E641;
L2_D_800A0426 = D_8009E642;
L2_D_800A0438 = D_8009E654;
L2_D_800A0C92 = D_8009EEAE;
L2_D_800A0CC0 = D_8009EEDC;
L2_D_800A0CC4 = D_8009EEE0;
L2_D_800A0CD4 = D_8009EEF0;
L2_D_800A0CDC = D_8009EEF8;
L2_D_800A0CF7 = D_8009EF13;
L2_D_800A0CFC = D_8009EF18;
L2_D_800A0EF4 = D_8009F110;
L2_D_800A0F34 = D_8009F150;
L2_D_800A0F68 = D_8009F184;
L2_D_800A0F88 = D_8009F1A4;
L2_D_800A0F8C = D_8009F1A8;
L2_D_800A0F9C = D_8009F1B8;
L2_D_800A0FAB = D_8009F1C7;
L2_D_800A0FD0 = D_8009F1EC;
L2_D_800A0FE0 = D_8009F1FC;
L2_D_800A101F = D_8009F23B;
L2_D_800A106C = D_8009F288;
L2_D_800A1070 = D_8009F28C;
L2_D_800A1078 = D_8009F294;
L2_D_800A11E8 = D_8009F3F8;
L2_D_800A11F0 = D_8009F400;
L2_D_800A11FE = D_8009F40E;
L2_D_800A1200 = D_8009F410;
L2_D_800A1204 = D_8009F414;
L2_D_800A1208 = D_8009F418;
L2_D_800A1230 = D_8009F440;
L2_D_800A123C = D_8009F44C;
L2_D_800A1240 = D_8009F450;
L2_D_800A1242 = D_8009F452;
L2_D_800A1244 = D_8009F454;
L2_D_800A1248 = D_8009F458;
L2_D_800A124C = D_8009F45C;
L2_D_800A1250 = D_8009F460;
L2_D_800A1254 = D_8009F464;
L2_D_800A1258 = D_8009F468;
L2_D_800A125A = D_8009F46A;
L2_D_800A125C = D_8009F46C;
L2_D_800A125E = D_8009F46E;
L2_D_800A14A8 = D_8009F6BC;
L2_D_800A14AC = D_8009F6F8;
L2_D_800A14DC = D_8009F738;
L2_D_800A14E4 = D_8009F704;
L2_D_800A14E8 = D_8009F708;
L2_D_800A14FC = D_8009F734;
L2_D_800A1504 = D_8009F73C;
L2_D_800A1508 = D_8009F740;
L2_D_800A1568 = D_8009F744;
L2_D_800A156C = D_8009F748;
L2_D_800A1580 = D_8009F74C;
L2_D_800A1588 = D_8009F750;
L2_D_800A15F0 = D_8009F794;
L2_D_800A15F8 = D_8009F730;
L2_D_800A1604 = D_8009F7CC;
L2_D_800A1618 = D_8009F7D0;
L2_D_800A1634 = D_8009F828;
L2_D_800A167C = D_8009F870;
L2_D_800A1680 = D_8009F874;
L2_D_800A19A0 = D_8009FAD8;
L2_D_800A1A1C = D_8009FB54;
L2_D_800A3E74 = D_800A198C;
L2_D_800A3E8C = D_800A19A4;
L2_D_800A40AC = D_800A1B5C;
L2_D_800AC49C = D_800A9F48;
L2_D_800AC6FC = D_800AA1A8;
L2_D_800ADA08 = D_800AB494;
L2_D_800ADA50 = D_800AB4DC;
L2_D_800ADA58 = D_800AB4E4;
L2_D_800ADC24 = D_800AB6B0;
L2_D_800AE308 = D_800ABDCC;
L2_D_800AE5A4 = D_800AC0AC;
L2_D_800AE968 = D_800AC470;
L2_D_800AF064 = D_800AC8AC;
L2_D_800AF140 = D_800AC988;
L2_D_800AF160 = D_800AC9A8;
L2_D_800AF188 = D_800AC9D0;
L2_D_800B0F58 = D_800AE7B0;
L2_D_800B1018 = D_800AE870;
L2_D_800B102C = D_800AE884;
L2_D_800B1DC4 = D_800AF5FC;
L2_D_800B1F2C = D_800AF748;
L2_D_800B1F30 = D_800AF74C;
L2_D_800B1FA0 = D_800AF7BC;
L2_D_800B4E3C = D_800B2018;
L2_D_800B56B4 = D_800B2890;
L2_D_800B5738 = D_800B2914;
L2_D_800B5739 = D_800B2915;
L2_D_800B5F3C = D_800B3118;
L2_D_800B5F49 = D_800B3125;
L2_D_800B5F4A = D_800B3126;
L2_D_800B5F4B = D_800B3127;
L2_D_800B5F50 = D_800B312C;
L2_D_800B5FB4 = D_800B3190;
L2_D_800B6010 = D_800B31EC;
L2_D_800B6030 = D_800B320C;
L2_D_800B603C = D_800B3218;
L2_D_800B605C = D_800B3238;
L2_D_800B6060 = D_800B323C;
L2_D_800B6064 = D_800B3240;
L2_D_800B60C0 = D_800B329C;
L2_D_800B6104 = D_800B32E0;
L2_D_800B6138 = D_800B3314;
L2_D_800B6A94 = D_800B3BB8;
L2_D_800B6C78 = D_800B3D9C;
L2_D_800B6C8C = D_800B3DB0;
L2_D_800B6C94 = D_800B3DB8;
L2_D_800B6CA8 = D_800B3DCC;
L2_D_800B6D4C = D_800B3E70;
L2_D_800B6FC4 = D_800B40E8;
L2_D_800B6FE0 = D_800B4104;
L2_D_800B6FE4 = D_800B4108;
L2_D_800B6FFC = D_800B4120;
L2_D_800B70F4 = D_800B4218;
L2_D_800B7140 = D_800B4264;
L2_D_800B7160 = D_800B4284;
L2_D_800B7170 = D_800B4294;
L2_D_800B7284 = D_800B43A8;
L2_D_800B7288 = D_800B43AC;
L2_D_800B72A4 = D_800B43C8;
L2_D_800B72B4 = D_800B43D8;
L2_D_800B72B8 = D_800B43DC;
L2_D_800B72BC = D_800B43E0;
L2_D_800B72C0 = D_800B43E4;
L2_D_800B72C8 = D_800B43EC;
L2_D_800B7318 = D_800B443C;
L2_D_800B7324 = D_800B4448;
L2_D_800B7328 = D_800B444C;
L2_D_800B7330 = D_800B4454;
L2_D_800B7334 = D_800B4458;
L2_D_800B7338 = D_800B445C;
L2_D_800B733C = D_800B4460;
L2_D_800B7340 = D_800B4464;
L2_D_800B7344 = D_800B4468;
L2_D_800C625C = D_800C525C;
L2_D_800CD020 = D_800CDEFC;
L2_D_800D5318 = D_800D61F4;
L2_D_800D55A0 = D_800D647C;
L2_D_800D55A4 = D_800D6480;
L2_D_800D55A8 = D_800D6484;
L2_D_800D55AC = D_800D6488;
L2_D_800D56BC = D_800D6598;
L2_D_800D56D0 = D_800D65AC;
L2_D_800D56D4 = D_800D65B0;
L2_D_800D56D8 = D_800D65B4;
L2_D_800D56EC = D_800D65C8;
L2_D_800D58E0 = D_800D67BC;
L2_D_800D6978 = D_800D7854;
L2_D_800D6B48 = D_800D7A24;
L2_D_800D6BB8 = D_800D7A70;
L2_D_800D6D20 = D_800D7BD4;
L2_D_800D70B4 = D_800D7F68;
L2_D_800D8500 = D_800D93B4;
L2_D_800D85DC = D_800D9490;
L2_D_800D869C = D_800D9550;
L2_D_800D9C5C = D_800DAB10;
L2_D_800D9F14 = D_800DADC8;
L2_D_800D9FE4 = D_800DAE98;
L2_D_800DA034 = D_800DAEE8;
L2_D_800DA12C = D_800DAFE0;
L2_D_800DA264 = D_800DB118;
L2_D_800DA410 = D_800DB2C4;
L2_D_800DA414 = D_800DB2C8;
L2_D_800DA894 = D_800DB748;
L2_D_800DA8AC = D_800DB760;
L2_D_800DAD80 = D_800DBC34;
L2_D_800DADD0 = D_800DBC84;
L2_D_800DAE20 = D_800DBCD4;
L2_D_800DAE24 = D_800DBCD8;
L2_D_800DB814 = D_800DC608;
L2_D_800DBA48 = D_800DC7F4;
L2_D_800DBA6C = D_800DC818;
L2_D_800DBA70 = D_800DC81C;
L2_D_800DBA98 = D_800DC844;
L2_D_800DBAAC = D_800DC858;
L2_D_800DBAD8 = D_800DC884;
L2_D_800DCAE0 = D_800DD88C;
L2_D_800E0068 = D_800E0AF4;
L2_D_800E006C = D_800E0AF8;
L2_D_800E0070 = D_800E0AFC;
L2_D_800E0074 = D_800E0B00;
L2_D_800E0078 = D_800E0B04;
L2_D_800E007C = D_800E0B08;
L2_D_800E0080 = D_800E0B0C;
L2_D_800E0084 = D_800E0B10;
L2_D_800E0088 = D_800E0B14;
L2_D_800E008C = D_800E0B18;
L2_D_800E00E4 = D_800E0B70;
L2_D_800E00E8 = D_800E0B74;
L2_D_800E00EC = D_800E0B78;
L2_D_800E01B0 = D_800E0C3C;
L2_D_800E01B4 = D_800E0C40;
L2_D_800E01B8 = D_800E0C44;
L2_D_800E01BC = D_800E0C48;
L2_D_800E01C4 = D_800E0C50;
L2_D_800E01C8 = D_800E0C54;
L2_D_800E01D0 = D_800E0C5C;
L2_D_800E01D4 = D_800E0C60;
L2_D_800E01D8 = D_800E0C64;
L2_D_800E01DC = D_800E0C68;
L2_D_800E0228 = D_800E0CB4;
L2_D_800E022C = D_800E0CB8;
L2_D_800E0304 = D_800E0D90;
L2_D_800E0308 = D_800E0D94;
L2_D_800E030C = D_800E0D98;
L2_D_800E0310 = D_800E0D9C;
L2_D_800E032C = D_800E0DB8;
L2_D_800E0410 = D_800E0E9C;
L2_D_800E04FC = D_800E0F88;
L2_D_800E0500 = D_800E0F8C;
L2_D_800E0504 = D_800E0F90;
L2_D_800E0D10 = D_800E1798;
L2_D_800E1510 = D_800E1F98;
L2_D_800E1514 = D_800E1F9C;
L2_D_800E680C = D_800E6C70;
L2_D_800E6810 = D_800E6C74;
L2_D_800F4010 = D_800F4C74;
L2_D_800F430C = D_800F4F04;
L2_D_800F4458 = D_800F5050;
L2_D_800F44DC = D_800F50D4;
L2_func_8002680C = func_8002680C;
L2_func_80026B00 = func_80026B00;
L2_func_80026C90 = func_80026C90;
L2_func_80026F5C = func_80026F30;
L2_func_80027274 = func_80027248;
func_800274F4 = L2_func_80027520;
func_80028810 = L2_func_800288B4;
L2_func_800288F4 = func_80028850;
L2_func_800289D8 = func_80028934;
func_8002915C = L2_func_80029200;
L2_func_80029A30 = func_8002998C;
func_8002ABE8 = L2_func_8002AC8C;
func_8002AF14 = L2_func_8002AFB8;
func_8002B02C = L2_func_8002B0D0;
func_8002B188 = L2_func_8002B22C;
L2_func_8002B464 = func_8002B3C0;
func_8002BC58 = L2_func_8002BCFC;
L2_func_8002BDE0 = func_8002BD3C;
func_8002BF08 = L2_func_8002BFAC;
L2_func_8002C330 = func_8002C28C;
func_8002C788 = L2_func_8002C82C;
L2_func_8002CA04 = func_8002C960;
L2_func_8002D39C = func_8002D2F8;
L2_func_8002D6AC = func_8002D608;
func_8002E1B0 = L2_func_8002E24C;
func_8002E208 = L2_func_8002E2A4;
L2_func_8002E2F4 = func_8002E258;
func_8002E260 = L2_func_8002E2FC;
func_8002E474 = L2_func_8002E508;
L2_func_8002E578 = func_8002E4E4;
func_8002E504 = L2_func_8002E598;
func_8002E560 = L2_func_8002E5F4;
L2_func_8002E61C = func_8002E588;
L2_func_8002E63C = func_8002E5A8;
func_8002E608 = L2_func_8002E69C;
func_8002F180 = L2_func_8002F214;
func_8002F298 = L2_func_8002F32C;
func_8002F2D0 = L2_func_8002F364;
func_8002F550 = L2_func_8002F5E4;
L2_func_8002F68C = func_8002F5F8;
func_8002F618 = L2_func_8002F6AC;
L2_func_8002F814 = func_8002F780;
func_8002FEC0 = L2_func_8002FF60;
func_800303C0 = L2_func_80030454;
L2_func_80030474 = func_800303E0;
L2_func_80030704 = func_80030670;
L2_func_800307C0 = func_8003072C;
L2_func_800307F8 = func_80030764;
L2_func_80031F34 = func_80031E9C;
L2_func_800320B8 = func_80032020;
L2_func_800320C8 = func_80032030;
L2_func_800321C4 = func_8003212C;
func_80032258 = L2_func_800322F0;
func_80032450 = L2_func_800324E8;
L2_func_8003251C = func_80032484;
L2_func_80032684 = func_800325EC;
L2_func_80033254 = func_800331BC;
L2_func_80033568 = func_80033448;
L2_func_80035C7C = func_80035BA0;
L2_func_800368C8 = func_800367EC;
L2_func_8003838C = func_8003848C;
func_800395CC = L2_func_800393F8;
func_80039920 = L2_func_8003974C;
func_80039940 = L2_func_8003976C;
L2_func_8003978C = func_80039960;
func_800399B8 = L2_func_800398F0;
func_80039CA8 = L2_func_80039C5C;
L2_func_80039CA4 = func_80039CF0;
func_8003A15C = L2_func_8003A110;
func_8003A410 = L2_func_8003A3C4;
L2_func_8003A3FC = func_8003A448;
func_8003A64C = L2_func_8003A600;
L2_func_8003AA8C = func_8003AAD8;
L2_func_8003D7CC = func_8003D890;
L2_func_80041918 = func_800419DC;
L2_func_80041954 = func_80041A18;
func_8004211C = L2_func_80042058;
func_80042160 = L2_func_8004209C;
func_8004228C = L2_func_800421C8;
L2_func_800426E8 = func_800427AC;
func_80042870 = L2_func_800427AC;
L2_func_80042A08 = func_80042ACC;
func_80043938 = L2_func_80043874;
L2_func_80043908 = func_800439CC;
L2_func_80043AFC = func_80043BC0;
func_80043CD8 = L2_func_80043C14;
L2_func_80043C4C = func_80043D10;
L2_func_80043E58 = func_80043F1C;
func_800456E8 = L2_func_80045624;
L2_func_80045848 = func_80045924;
L2_func_80045890 = func_8004596C;
func_800459A4 = L2_func_800458C8;
L2_func_80045900 = func_800459DC;
L2_func_80045910 = func_800459EC;
func_80045F64 = L2_func_80045E88;
L2_func_80046098 = func_80046174;
L2_func_80046174 = func_80046250;
L2_func_800462CC = func_800463A8;
L2_func_80046638 = func_80046708;
func_800467A8 = L2_func_800466D8;
L2_func_800481FC = func_800482CC;
func_800485E0 = L2_func_80048510;
L2_func_8004857C = func_8004864C;
func_8004865C = L2_func_8004858C;
L2_func_80048B04 = func_80048BD4;
L2_func_800497E4 = func_8004985C;
func_80049CF8 = L2_func_80049C80;
L2_func_8004A814 = func_8004A88C;
L2_func_8004AF2C = func_8004AFA4;
func_8004AFAC = L2_func_8004AF34;
func_8004AFF0 = L2_func_8004AF78;
func_8004B014 = L2_func_8004AF9C;
func_8004B048 = L2_func_8004AFD0;
func_8004B080 = L2_func_8004B008;
func_8004B090 = L2_func_8004B018;
func_8004B4E4 = L2_func_8004B46C;
func_8004B524 = L2_func_8004B4AC;
func_8004B570 = L2_func_8004B4F8;
func_8004BCF0 = L2_func_8004BC78;
L2_func_8004BC9C = func_8004BD14;
func_8004BD24 = L2_func_8004BCAC;
func_8004BD34 = L2_func_8004BCBC;
func_8004BD4C = L2_func_8004BCD4;
L2_func_8004BDD8 = func_8004BE50;
func_8004BF38 = L2_func_8004BEC0;
func_8004D504 = L2_func_8004D48C;
L2_func_8004DC58 = func_8004DCD0;
L2_func_8004E0C4 = func_8004E054;
func_8004E140 = L2_func_8004E1B0;
func_8004E7C8 = L2_func_8004E88C;
L2_func_8004EBA4 = func_8004EAE0;
func_8004F0F4 = L2_func_8004F24C;
L2_func_8004F288 = func_8004F130;
L2_func_8004F314 = func_8004F1BC;
L2_func_800501B0 = func_80050064;
L2_func_80050A9C = func_80050950;
L2_func_80050AA4 = func_80050958;
func_80050C80 = L2_func_80050D78;
func_80051370 = L2_func_80051444;
L2_func_800516E8 = func_80051614;
L2_func_80054E34 = func_80054E0C;
L2_func_80054E54 = func_80054E2C;
func_80055160 = L2_func_80055188;
func_800556DC = L2_func_80055698;
func_8005577C = L2_func_80055738;
func_80055AE4 = L2_func_80055938;
func_80055BCC = L2_func_80055A20;
L2_func_80055AB0 = func_80055C5C;
func_80055E38 = L2_func_80055C8C;
func_80056124 = L2_func_80055F78;
func_800562D0 = L2_func_800560EC;
func_80058730 = L2_func_80058570;
L2_func_8005966C = func_8005982C;
L2_func_800596B8 = func_80059878;
func_8005995C = L2_func_8005979C;
func_80059C54 = L2_func_80059A94;
func_80059D08 = L2_func_80059B48;
func_80059DC4 = L2_func_80059C04;
func_80059E2C = L2_func_80059C6C;
L2_func_8005AE6C = func_8005B02C;
func_8005B070 = L2_func_8005AEB0;
L2_func_8005B608 = func_8005B7C8;
L2_func_8005BA6C = func_8005BC2C;
L2_func_8005C964 = func_8005CB24;
L2_func_8005C994 = func_8005CB54;
func_8005D844 = L2_func_8005D5CC;
L2_func_8005D604 = func_8005D87C;
L2_func_8005D670 = func_8005D8E8;
L2_func_8005D6D4 = func_8005D94C;
func_8005DD48 = L2_func_8005DAD0;
func_8005E1F8 = L2_func_8005DF80;
func_8005EF6C = L2_func_8005ECF4;
func_8005F040 = L2_func_8005EDC8;
L2_func_8005EF48 = func_8005F1C0;
L2_func_8005F374 = func_8005F5EC;
L2_func_8005F74C = func_8005F9C4;
L2_func_8005FFF4 = func_8006026C;
func_800605E8 = L2_func_80060370;
L2_func_80060594 = func_80060688;
L2_func_8006066C = func_80060760;
L2_func_800606F0 = func_800607E4;
L2_func_800606F8 = func_800607EC;
L2_func_8006087C = func_80060970;
func_80060FE0 = L2_func_80060EC4;
L2_func_800617E4 = func_800618F4;
L2_func_800617EC = func_800618FC;
func_800619A0 = L2_func_800619F0;
L2_func_80061CE8 = func_80061CA4;
L2_func_80061E1C = func_80061DD8;
L2_func_800637D0 = func_800637BC;
func_80063A40 = L2_func_80063A54;
func_80063E38 = L2_func_80063E4C;
L2_func_80063EFC = func_80063EE8;
func_80064F10 = L2_func_80064F24;
L2_func_80064FB0 = func_80064F9C;
func_8006523C = L2_func_80065250;
L2_func_800660A0 = func_8006608C;
L2_func_800662C8 = func_800662B4;
L2_func_80066304 = func_800662F0;
func_800663E8 = L2_func_800663FC;
func_80069C04 = L2_func_80069A48;
func_8006A654 = L2_func_80069DD8;
L2_func_80069DE8 = func_8006A664;
L2_func_80069EBC = func_8006A744;
L2_func_8006B2F0 = func_8006B358;
L2_func_8006BE78 = func_8006AB60;
L2_func_8006BF24 = func_8006AB94;
L2_func_8006C250 = func_8006B368;
L2_func_8006D6D0 = func_8006B378;
L2_func_8006D93C = func_80069F64;
L2_func_8006D994 = func_80069CBC;
L2_func_8006DA70 = func_8006A030;
L2_func_8006DAC8 = func_80069D30;
L2_func_8006DBB0 = func_8006A0FC;
L2_func_8006DC08 = func_80069DA0;
L2_func_8006DCF0 = func_8006A1C8;
L2_func_8006DD48 = func_80069E10;
L2_func_8006DE2C = func_8006A294;
L2_func_8006DE84 = func_80069E7C;
L2_func_8006E034 = func_8006B230;
L2_func_8006E8F4 = func_8006BF58;
L2_func_8006E97C = func_8006BFC8;
L2_func_8006E9D0 = func_8006C01C;
L2_func_80072648 = func_8006FC94;
L2_func_800727D4 = func_8006FE20;
func_80075BD4 = L2_func_80078588;
func_80075C24 = L2_func_800785D8;
func_80076190 = L2_func_80078B44;
func_800761DC = L2_func_80078B90;
func_8007668C = L2_func_80079040;
L2_func_80079060 = func_800766AC;
func_800766B8 = L2_func_8007906C;
func_80076CF8 = L2_func_800796AC;
func_80076D8C = L2_func_80079740;
func_80076DD0 = L2_func_80079784;
func_80076EA0 = L2_func_80079854;
func_80077118 = L2_func_80079B2C;
L2_func_8007A190 = func_8007777C;
func_8007788C = L2_func_8007A2A0;
L2_func_8007A4D4 = func_80077AC0;
func_80077C64 = L2_func_8007A678;
L2_func_8007D6E0 = func_8007B858;
L2_func_8007E33C = func_8007C540;
L2_func_8007E370 = func_8007C574;
L2_func_8007F098 = func_8007D2B4;
L2_func_8007F210 = func_8007D42C;
L2_func_8007F36C = func_8007D588;
L2_func_8007F520 = func_8007D73C;
L2_func_8007FF68 = func_8007E184;
L2_func_800800D4 = func_8007E2F0;
L2_func_80080238 = func_8007E454;
L2_func_800803A8 = func_8007E5C4;
L2_func_80080518 = func_8007E734;
L2_func_80080660 = func_8007E87C;
L2_func_800807A0 = func_8007E9BC;
L2_func_80080930 = func_8007EB4C;
L2_func_80080AC8 = func_8007ECE4;
L2_func_80080C04 = func_8007EE20;
L2_func_80080D44 = func_8007EF60;
L2_func_80080E8C = func_8007F0A8;
L2_func_80081390 = func_8007F5AC;
L2_func_80083044 = func_80081260;
L2_func_80083064 = func_80081280;
L2_func_80083074 = func_80081290;
L2_func_80083280 = func_8008149C;
L2_func_80083494 = func_800816B0;
L2_func_800855E0 = func_800837FC;
L2_func_800855F0 = func_8008380C;
L2_func_80085600 = func_8008381C;
L2_func_80085C3C = func_80083E58;
L2_func_80085D5C = func_80083F78;
L2_func_80085E4C = func_80084068;
L2_func_80085E7C = func_80084098;
L2_func_80085E8C = func_800840A8;
L2_func_80085EDC = func_800840F8;
L2_func_80085F1C = func_80084138;
L2_func_80086EA8 = func_800850C4;
L2_func_80086FAC = func_800851C8;
L2_func_800870CC = func_800852E8;
L2_func_80087120 = func_8008533C;
L2_func_80087134 = func_80085350;
L2_func_800873A4 = func_800855C0;
L2_func_80087574 = func_80085790;
L2_func_80089774 = func_80087990;
L2_func_80089AF4 = func_80087D10;
L2_func_80089BB4 = func_80087DD0;
L2_func_80089D04 = func_80087F20;
L2_func_80089D64 = func_80087F80;
L2_func_80089D94 = func_80087FB0;
L2_func_8008A0C4 = func_800882E0;
L2_func_8008A724 = func_80088940;
L2_func_8008AAD0 = func_80088CEC;
L2_func_8008C0C0 = func_8008A2DC;
L2_func_8008C48C = func_8008A6A8;
L2_func_8008C6CC = func_8008A8E8;
L2_func_8008C90C = func_8008AB28;
L2_func_8008CBBC = func_8008ADD8;
L2_func_8008CE0C = func_8008B028;
L2_func_8008D02C = func_8008B248;
L2_func_8008D33C = func_8008B558;
L2_func_8008D66C = func_8008B888;
L2_func_8008D92C = func_8008BB48;
L2_func_8008DB6C = func_8008BD88;
L2_func_8008DCEC = func_8008BF08;
L2_func_8008DF2C = func_8008C148;
L2_func_8008E09C = func_8008C2B8;
L2_func_8008E28C = func_8008C4A8;
L2_func_8008E5CC = func_8008C7E8;
L2_func_8008E7EC = func_8008CA08;
L2_func_8008EAFC = func_8008CD18;
L2_func_8008ECEC = func_8008CF08;
L2_func_8008EEEC = func_8008D108;
L2_func_8008F21C = func_8008D438;
L2_func_8008F49C = func_8008D6B8;
L2_func_8008F74C = func_8008D968;
L2_func_800912A4 = func_8008F4C0;
D_1F8003D4 = 0x1F8003D4;
D_1F8003D8 = 0x1F8003D8;
D_1F8003DC = 0x1F8003DC;
L1_D_800AB540_b = L1_D_800AB540;
L1_D_800AB540_c = L1_D_800AB540;
L1_D_8009CE24 = L1_D_8009CE20 + 4;
