/* Generated by tools/port_level.py: LEVEL01 names (L1_ prefix) bound to level02's symbols. */
L1_AddPrim = func_8008D8EC;
L1_ApplyBonusCheats = func_8002E15C;
L1_ApplyMatrix = func_800905CC;
L1_ApplyMatrixLV = func_8007E8BC;
L1_ApplyMatrixSV = func_80092750;
L1_Args_GetFlag115 = func_8002E2FC;
L1_CALLOC3_OBJ_54 = func_8008FAB0;
func_800503BC = L1_Camera_ResetZoom;
func_8002C408 = L1_CdBin_Disable;
func_8002C44C = L1_CdBin_Enable;
func_8002C568 = L1_CdBin_SetLevel;
L1_CdInit = func_80089BB4;
L1_CdSearchFile = func_80087718;
L1_ChangeClearPAD = func_80096E74;
L1_ChangeClearRCnt = func_80096E84;
func_8002DDD4 = L1_Cheat_CheckCodes;
L1_Cheat_DoAction = func_8002DB48;
L1_Cheat_ResetCodes = func_8002E2A4;
L1_CloseEvent = func_800855E0;
L1_D_80082604 = func_800867AC;
L1_D_80095808 = D_80099A40;
L1_D_8009C180 = D_800A03B8;
L1_D_8009C184 = D_800A03BC;
L1_D_8009C1EC = D_800A0424;
L1_D_8009C1ED = D_800A0425;
L1_D_8009C1F0 = D_800A0428;
L1_D_8009C1F4 = D_800A042C;
L1_D_8009C1F8 = D_800A0430;
L1_D_8009C200 = D_800A0438;
L1_D_8009C204 = D_800A043C;
L1_D_8009C208 = D_800A0440;
L1_D_8009C20A = D_800A0442;
L1_D_8009C20C = D_800A0444;
L1_D_8009CA56 = D_800A0C8E;
L1_D_8009CA58 = D_800A0C90;
L1_D_8009CA59 = D_800A0C91;
L1_D_8009CA5A = D_800A0C92;
L1_D_8009CA5C = D_800A0C94;
L1_D_8009CA5E = D_800A0C96;
L1_D_8009CA60 = D_800A0C98;
L1_D_8009CA64 = D_800A0C9C;
L1_D_8009CA68 = D_800A0CA0;
L1_D_8009CA70 = D_800A0CA8;
L1_D_8009CA74 = D_800A0CAC;
L1_D_8009CA78 = D_800A0CB0;
L1_D_8009CA7C = D_800A0CB4;
L1_D_8009CA80 = D_800A0CB8;
L1_D_8009CA84 = D_800A0CBC;
L1_D_8009CA8C = D_800A0CC4;
L1_D_8009CA90 = D_800A0CC8;
L1_D_8009CA94 = D_800A0CCC;
L1_D_8009CA98 = D_800A0CD0;
L1_D_8009CA9C = D_800A0CD4;
L1_D_8009CAA0 = D_800A0CD8;
L1_D_8009CAA4 = D_800A0CDC;
L1_D_8009CAA8 = D_800A0CE0;
L1_D_8009CAAC = D_800A0CE4;
L1_D_8009CABD = D_800A0CF5;
L1_D_8009CABE = D_800A0CF6;
L1_D_8009CABF = D_800A0CF7;
L1_D_8009CAC0 = D_800A0CF8;
L1_D_8009CAC4 = D_800A0CFC;
L1_D_8009CACC = D_800A0D04;
L1_D_8009CAD0 = D_800A0D08;
L1_D_8009CD00 = D_800A0F38;
L1_D_8009CD30 = D_800A0F68;
L1_D_8009CD3C = D_800A0F74;
L1_D_8009CD4C = D_800A0F84;
L1_D_8009CD50 = D_800A0F88;
L1_D_8009CD54 = D_800A0F8C;
L1_D_8009CD58 = D_800A0F90;
L1_D_8009CD5C = D_800A0F94;
L1_D_8009CD5E = D_800A0F96;
L1_D_8009CD60 = D_800A0F98;
L1_D_8009CD62 = D_800A0F9A;
L1_D_8009CD6C = D_800A0FA4;
L1_D_8009CD6E = D_800A0FA6;
L1_D_8009CD78 = D_800A0FB0;
L1_D_8009CD80 = D_800A0FB8;
L1_D_8009CD88 = D_800A0FC0;
L1_D_8009CD8C = D_800A0FC4;
L1_D_8009CD98 = D_800A0FD0;
L1_D_8009CDA0 = D_800A0FD8;
L1_D_8009CDA2 = D_800A0FDA;
L1_D_8009CDA8 = D_800A0FE0;
L1_D_8009CDD0 = D_800A1008;
L1_D_8009CDDC = D_800A1014;
L1_D_8009CDE4 = D_800A101C;
L1_D_8009CDE5 = D_800A101D;
L1_D_8009CDE6 = D_800A101E;
L1_D_8009CDE7 = D_800A101F;
L1_D_8009CDE8 = D_800A1020;
L1_D_8009CDEC = D_800A1024;
L1_D_8009CDF0 = D_800A1028;
L1_D_8009CE20 = D_800A1058;
L1_D_8009CE28 = D_800A1060;
L1_D_8009CE38 = D_800A1070;
L1_D_8009CE3C = D_800A1074;
L1_D_8009CE48 = D_800A1080;
L1_D_8009CEB0 = D_800A10E8;
L1_D_8009CEE0 = D_800A1118;
L1_D_8009CF10 = D_800A1148;
L1_D_8009CF14 = D_800A114C;
L1_D_8009CF2C = D_800A1164;
L1_D_8009CF30 = D_800A1168;
L1_D_8009CF34 = D_800A116C;
L1_D_8009CF48 = D_800A1180;
L1_D_8009CF4C = D_800A1184;
L1_D_8009CF50 = D_800A1188;
L1_D_8009CF54 = D_800A118C;
L1_D_8009CF68 = D_800A11A8;
L1_D_8009CF6C = D_800A11AC;
L1_D_8009CF70 = D_800A11B0;
L1_D_8009CF74 = D_800A11B4;
L1_D_8009CF7C = D_800A11BC;
L1_D_8009CF80 = D_800A11C0;
L1_D_8009CF8C = D_800A11CC;
L1_D_8009CF90 = D_800A11D0;
L1_D_8009CF94 = D_800A11D4;
L1_D_8009CF98 = D_800A11D8;
L1_D_8009CF9C = D_800A11DC;
L1_D_8009CFA8 = D_800A11E8;
L1_D_8009CFB0 = D_800A11F0;
L1_D_8009CFB4 = D_800A11F4;
L1_D_8009CFBB = D_800A11FB;
L1_D_8009CFBE = D_800A11FE;
L1_D_8009CFC0 = D_800A1200;
L1_D_8009CFC4 = D_800A1204;
L1_D_8009CFC8 = D_800A1208;
L1_D_8009CFCC = D_800A120C;
L1_D_8009CFE4 = D_800A1224;
L1_D_8009CFE8 = D_800A1228;
L1_D_8009CFEC = D_800A122C;
L1_D_8009CFF0 = D_800A1230;
L1_D_8009CFF6 = D_800A1236;
L1_D_8009CFF8 = D_800A1238;
L1_D_8009CFFC = D_800A123C;
L1_D_8009D000 = D_800A1240;
L1_D_8009D002 = D_800A1242;
L1_D_8009D004 = D_800A1244;
L1_D_8009D008 = D_800A1248;
L1_D_8009D00C = D_800A124C;
L1_D_8009D00E = D_800A124E;
L1_D_8009D010 = D_800A1250;
L1_D_8009D014 = D_800A1254;
L1_D_8009D018 = D_800A1258;
L1_D_8009D01A = D_800A125A;
L1_D_8009D020 = D_800A1260;
L1_D_8009D038 = D_800A1278;
L1_D_8009D03C = D_800A127C;
L1_D_8009D040 = D_800A1280;
L1_D_8009D084 = D_800A12C4;
L1_D_8009D088 = D_800A12C8;
L1_D_8009D09C = D_800A12DC;
L1_D_8009D0FC = D_800A133C;
L1_D_8009D104 = D_800A1344;
L1_D_8009D106 = D_800A1346;
L1_D_8009D108 = D_800A1348;
L1_D_8009D10A = D_800A134A;
L1_D_8009D10C = D_800A134C;
L1_D_8009D124 = D_800A1364;
L1_D_8009D130 = D_800A1370;
L1_D_8009D26C = D_800A14A8;
L1_D_8009D280 = D_800A14CC;
L1_D_8009D2A8 = D_800A14AC;
L1_D_8009D35C = D_800A1634;
L1_D_8009D368 = D_800A1640;
L1_D_8009D374 = D_800A164C;
L1_D_8009D384 = D_800A165C;
L1_D_8009D394 = D_800A166C;
L1_D_8009D3A4 = D_800A167C;
L1_D_8009D3A8 = D_800A1680;
L1_D_8009D3AC = D_800A1684;
L1_D_8009D3B0 = D_800A1688;
L1_D_8009D3BC = D_800A1694;
L1_D_8009D3F0 = D_800A16C8;
L1_D_8009D3F4 = D_800A16CC;
L1_D_8009D3F8 = D_800A16D0;
L1_D_8009D3FC = D_800A16D4;
L1_D_8009D444 = D_800A171C;
L1_D_8009D5A8 = D_800A194C;
L1_D_8009D5AC = D_800A1950;
L1_D_8009D5F8 = D_800A19B4;
L1_D_8009D5FC = D_800A19B8;
L1_D_8009D600 = D_800A19BC;
L1_D_8009D610 = D_800A19CC;
L1_D_8009D620 = D_800A19DC;
L1_D_8009D660 = D_800A1A1C;
L1_D_8009D7A4 = D_800A1B60;
L1_D_8009D7A8 = D_800A1B64;
L1_D_8009D8B8 = D_800A1C74;
L1_D_8009D8BE = D_800A1C7A;
L1_D_8009D8C4 = D_800A1C80;
L1_D_8009D8C8 = D_800A1C84;
L1_D_8009D8CC = D_800A1C88;
L1_D_8009D8D4 = D_800A1C90;
L1_D_8009D8E4 = D_800A1C98;
L1_D_8009D8E8 = D_800A1C9C;
L1_D_8009D8F0 = D_800A1CA4;
L1_D_8009D8F4 = D_800A1CA8;
L1_D_8009D8F8 = D_800A1CAC;
L1_D_8009D8FC = D_800A1CB0;
L1_D_8009D900 = D_800A1CB4;
L1_D_8009D904 = D_800A1CB8;
L1_D_8009D90C = D_800A1CC0;
L1_D_8009D910 = D_800A1CC4;
L1_D_8009D914 = D_800A1CC8;
L1_D_8009D918 = D_800A1CCC;
L1_D_8009D91C = D_800A1CD0;
L1_D_8009D920 = D_800A1CD4;
L1_D_8009D924 = D_800A1CD8;
L1_D_8009D928 = D_800A1CDC;
L1_D_8009DB50 = D_800A1EF0;
L1_D_8009E410 = D_800A3998;
L1_D_8009E480 = D_800A3A1C;
L1_D_8009E490 = D_800A3A3C;
L1_D_8009E9B4 = D_800A3E64;
L1_D_8009E9B8 = D_800A3E68;
L1_D_8009E9BC = D_800A3E6C;
L1_D_8009E9C0 = D_800A3E70;
L1_D_8009E9C4 = D_800A3E74;
L1_D_8009E9D8 = D_800A3E88;
L1_D_8009EADC = D_800A40B0;
L1_D_8009EB5C = D_800A4130;
L1_D_8009EB7C = D_800A4150;
L1_D_8009EB88 = D_800A415C;
L1_D_8009EB8C = D_800A4160;
L1_D_8009EE0C = D_800A43E0;
L1_D_8009EE3D = D_800A4411;
L1_D_8009EE8C = D_800A4460;
L1_D_8009EEC4 = D_800A4498;
L1_D_8009EEC8 = D_800A449C;
L1_D_8009EED0 = D_800A44A4;
L1_D_8009EED4 = D_800A44A8;
L1_D_8009EED8 = D_800A44AC;
L1_D_8009EEDC = D_800A44B0;
L1_D_8009EEF0 = D_800A44CC;
L1_D_8009EEF4 = D_800A44D0;
L1_D_8009EEF8 = D_800A44D4;
L1_D_8009EF1C = D_800A44F8;
L1_D_8009EF94 = D_800A4570;
L1_D_8009EF98 = D_800A4574;
L1_D_8009EF9C = D_800A4578;
L1_D_8009EFA0 = D_800A457C;
L1_D_8009EFA4 = D_800A4580;
L1_D_8009EFA8 = D_800A4584;
L1_D_8009EFC8 = D_800A45A4;
L1_D_8009F008 = D_800A45E4;
L1_D_8009F00C = D_800A45E8;
L1_D_8009F010 = D_800A45EC;
L1_D_8009F012 = D_800A45EE;
L1_D_8009F013 = D_800A45EF;
L1_D_8009F014 = D_800A45F0;
L1_D_8009F016 = D_800A45F2;
L1_D_8009F018 = D_800A45F4;
L1_D_8009F01C = D_800A45F8;
L1_D_8009F07C = D_800A4658;
L1_D_8009F084 = D_800A4660;
L1_D_8009F090 = D_800A466C;
L1_D_8009F09C = D_800A4678;
L1_D_8009F0BC = D_800A4698;
L1_D_8009F0D0 = D_800A46AC;
L1_D_8009F0E4 = D_800A46C0;
L1_D_8009F0E6 = D_800A46C2;
L1_D_8009F10C = D_800A46E8;
L1_D_8009F114 = D_800A46F0;
L1_D_8009F118 = D_800A46F4;
L1_D_8009F11C = D_800A46F8;
L1_D_8009F120 = D_800A46FC;
L1_D_8009F124 = D_800A4700;
L1_D_8009F128 = D_800A4704;
L1_D_8009F12C = D_800A4708;
L1_D_8009F130 = D_800A470C;
L1_D_8009F134 = D_800A4710;
L1_D_8009F138 = D_800A4714;
L1_D_8009F13C = D_800A4718;
L1_D_8009F140 = D_800A471C;
L1_D_8009F144 = D_800A4720;
L1_D_8009F148 = D_800A4724;
L1_D_8009F14C = D_800A4728;
L1_D_8009F150 = D_800A472C;
L1_D_8009F160 = D_800A473C;
L1_D_8009F170 = D_800A474C;
L1_D_8009F178 = D_800A4754;
L1_D_8009F17C = D_800A4758;
L1_D_8009F18C = D_800A4768;
L1_D_8009F190 = D_800A476C;
L1_D_8009F194 = D_800A4770;
L1_D_8009F198 = D_800A4774;
L1_D_8009F1B0 = D_800A478C;
L1_D_8009F230 = D_800A480C;
L1_D_8009F234 = D_800A4810;
L1_D_8009F248 = D_800A4824;
L1_D_8009F24C = D_800A4828;
L1_D_8009F250 = D_800A482C;
L1_D_8009F254 = D_800A4830;
L1_D_8009F2B8 = D_800A4894;
L1_D_8009F2BA = D_800A4896;
L1_D_8009F2BC = D_800A4898;
L1_D_8009F2E8 = D_800A48C4;
L1_D_8009F2F4 = D_800A48D0;
L1_D_800A0340 = D_800A591C;
L1_D_800A0344 = D_800A5920;
L1_D_800A0348 = D_800A5924;
L1_D_800A034C = D_800A5928;
L1_D_800A0350 = D_800A592C;
L1_D_800A0370 = D_800A594C;
L1_D_800A4370 = D_800A994C;
L1_D_800A4374 = D_800A9950;
L1_D_800A4378 = D_800A9954;
L1_D_800A437C = D_800A9958;
L1_D_800A4380 = D_800A995C;
L1_D_800A4382 = D_800A995E;
L1_D_800A4384 = D_800A9960;
L1_D_800A4390 = D_800A996C;
L1_D_800A4394 = D_800A9970;
L1_D_800A43B0 = D_800A998C;
L1_D_800A43C8 = D_800A99A4;
L1_D_800A43CC = D_800A99A8;
L1_D_800A43D0 = D_800A99AC;
L1_D_800A43D4 = D_800A99B0;
L1_D_800A43D8 = D_800A99B4;
L1_D_800A43DC = D_800A99B8;
L1_D_800A43E0 = D_800A99BC;
L1_D_800A43E4 = D_800A99C0;
L1_D_800A43E8 = D_800A99C4;
L1_D_800A43EC = D_800A99C8;
L1_D_800A43F0 = D_800A99CC;
L1_D_800A43F4 = D_800A99D0;
L1_D_800A43F8 = D_800A99D4;
L1_D_800A43FC = D_800A99D8;
L1_D_800A4400 = D_800A99DC;
L1_D_800A4404 = D_800A99E0;
L1_D_800A4408 = D_800A99E4;
L1_D_800A440C = D_800A99E8;
L1_D_800A4410 = D_800A99EC;
L1_D_800A4414 = D_800A99F0;
L1_D_800A4418 = D_800A99F4;
L1_D_800A441C = D_800A99F8;
L1_D_800A4420 = D_800A99FC;
L1_D_800A4428 = D_800A9A04;
L1_D_800A442C = D_800A9A08;
L1_D_800A4430 = D_800A9A0C;
L1_D_800A4440 = D_800A9A1C;
L1_D_800A4450 = D_800A9A2C;
L1_D_800A4460 = D_800A9A3C;
L1_D_800A446C = D_800A9A48;
L1_D_800A4470 = D_800A9A4C;
L1_D_800A4474 = D_800A9A50;
L1_D_800A4478 = D_800A9A54;
L1_D_800A447C = D_800A9A58;
L1_D_800A45D0 = D_800A9BAC;
L1_D_800A45D4 = D_800A9BB0;
L1_D_800A45D8 = D_800A9BB4;
L1_D_800A4EA0 = D_800AA47C;
L1_D_800A4FD8 = D_800AA5B4;
L1_D_800A4FDC = D_800AA5B8;
L1_D_800A4FF0 = D_800AA5CC;
L1_D_800A5000 = D_800AA5DC;
L1_D_800A5010 = D_800AA5EC;
L1_D_800A56A0 = D_800AAC7C;
L1_D_800A5834 = D_800AAE10;
L1_D_800A59D0 = D_800AAFAC;
L1_D_800A59D4 = D_800AAFB0;
L1_D_800A59D8 = D_800AAFB4;
L1_D_800A59DC = D_800AAFB8;
L1_D_800A59E0 = D_800AAFBC;
L1_D_800A5B60 = D_800AB13C;
L1_D_800A5B6C = D_800AB148;
L1_D_800A5B90 = D_800AB16C;
L1_D_800A5BA8 = D_800AB184;
L1_D_800A5CB0 = D_800AB28C;
L1_D_800A5CB4 = D_800AB290;
L1_D_800A5CB8 = D_800AB294;
L1_D_800A5CBC = D_800AB298;
L1_D_800A5CC0 = D_800AB29C;
L1_D_800A5CC8 = D_800AB2A4;
L1_D_800A5CCC = D_800AB2A8;
L1_D_800A5CD0 = D_800AB2AC;
L1_D_800A5CD4 = D_800AB2B0;
L1_D_800A5CD8 = D_800AB2B4;
L1_D_800A5CDC = D_800AB2B8;
L1_D_800A5CE0 = D_800AB2BC;
L1_D_800A5CE4 = D_800AB2C0;
L1_D_800A5CE8 = D_800AB2C4;
L1_D_800A5CEC = D_800AB2C8;
L1_D_800A5CF0 = D_800AB2CC;
L1_D_800A5D00 = D_800AB2DC;
L1_D_800A5D04 = D_800AB2E0;
L1_D_800A5D08 = D_800AB2E4;
L1_D_800A5D18 = D_800AB2F4;
L1_D_800A5D1C = D_800AB2F8;
L1_D_800A5D20 = D_800AB2FC;
L1_D_800A5D24 = D_800AB300;
L1_D_800A5D28 = D_800AB304;
L1_D_800A5D2C = D_800AB308;
L1_D_800A5D34 = D_800AB310;
L1_D_800A5D44 = D_800AB320;
L1_D_800A5D48 = D_800AB324;
L1_D_800A5D4C = D_800AB328;
L1_D_800A5D7A = D_800AB356;
L1_D_800A5D7C = D_800AB358;
L1_D_800A5D80 = D_800AB35C;
L1_D_800A5D98 = D_800AB374;
L1_D_800A5D9C = D_800AB378;
L1_D_800A5DA0 = D_800AB37C;
L1_D_800A5DA4 = D_800AB380;
L1_D_800A5DA8 = D_800AB384;
L1_D_800A5DAC = D_800AB388;
L1_D_800A5DB0 = D_800AB38C;
L1_D_800A5DB4 = D_800AB390;
L1_D_800A5DB5 = D_800AB391;
L1_D_800A5DBC = D_800AB398;
L1_D_800A5E3C = D_800AB418;
L1_D_800A5E5C = D_800AB438;
L1_D_800A5EA0 = D_800AB47C;
L1_D_800A5EDC = D_800AB4B8;
L1_D_800A5F5C = D_800AB538;
L1_D_800A5FDC = D_800AB5B8;
L1_D_800A605C = D_800AB638;
L1_D_800A6060 = D_800AB63C;
L1_D_800A6064 = D_800AB640;
L1_D_800A6068 = D_800AB644;
L1_D_800A606C = D_800AB648;
L1_D_800A6070 = D_800AB64C;
L1_D_800A6074 = D_800AB650;
L1_D_800A6075 = D_800AB651;
L1_D_800A6078 = D_800AB654;
L1_D_800A6090 = D_800AB66C;
L1_D_800A6094 = D_800AB670;
L1_D_800A6098 = D_800AB674;
L1_D_800A609C = D_800AB678;
L1_D_800A60A0 = D_800AB67C;
L1_D_800A60B0 = D_800AB68C;
L1_D_800A60D0 = D_800AB6AC;
L1_D_800A60D4 = D_800AB6B0;
L1_D_800A60E0 = D_800AB6BC;
L1_D_800A60E4 = D_800AB6C0;
L1_D_800A6104 = D_800AB6E0;
L1_D_800A6110 = D_800AB6EC;
L1_D_800A6114 = D_800AB6F0;
L1_D_800A6118 = D_800AB6F4;
L1_D_800A611C = D_800AB6F8;
L1_D_800A6120 = D_800AB6FC;
L1_D_800A6140 = D_800AB71C;
L1_D_800A6170 = D_800AB74C;
L1_D_800A6174 = D_800AB750;
L1_D_800A6178 = D_800AB754;
L1_D_800A6180 = D_800AB75C;
L1_D_800A6198 = D_800AB774;
L1_D_800A62A0 = D_800AB87C;
L1_D_800A66A0 = D_800ABC7C;
L1_D_800A6EB0 = D_800AC48C;
L1_D_800A6ED0 = D_800AC4AC;
L1_D_800A6EF8 = D_800AC4D4;
L1_D_800A6F00 = D_800AC4DC;
L1_D_800A6F1C = D_800AC4F8;
L1_D_800A7048 = D_800AC624;
L1_D_800A7060 = D_800AC63C;
L1_D_800A70A0 = D_800AC67C;
L1_D_800A70C8 = D_800AC6A4;
L1_D_800A70D4 = D_800AC6B0;
L1_D_800A70F8 = D_800AC6D4;
L1_D_800A7190 = D_800AC76C;
L1_D_800A71EC = D_800AC7C8;
L1_D_800A71F0 = D_800AC7CC;
L1_D_800A71F4 = D_800AC7D0;
L1_D_800A71F8 = D_800AC7D4;
L1_D_800A7214 = D_800AC7F0;
L1_D_800A7260 = D_800AC83C;
L1_D_800A7290 = D_800AC86C;
L1_D_800A72E8 = D_800AC8C4;
L1_D_800A7300 = D_800AC8DC;
L1_D_800A7310 = D_800AC8EC;
L1_D_800A7320 = D_800AC8FC;
L1_D_800A7324 = D_800AC900;
L1_D_800A7330 = D_800AC90C;
L1_D_800A7344 = D_800AC920;
L1_D_800A735C = D_800AC938;
L1_D_800A73BC = D_800AC998;
L1_D_800A73D8 = D_800AC9B4;
L1_D_800A7418 = D_800AC9F4;
L1_D_800A7424 = D_800ACA00;
L1_D_800A7474 = D_800ACA50;
L1_D_800A747C = D_800ACA58;
L1_D_800A7498 = D_800ACA74;
L1_D_800A74D4 = D_800ACAB0;
L1_D_800A74E0 = D_800ACABC;
L1_D_800A7510 = D_800ACAEC;
L1_D_800A75D0 = D_800ACBAC;
L1_D_800A7678 = D_800ACC54;
L1_D_800A76A0 = D_800ACC7C;
L1_D_800A76E4 = D_800ACCC0;
L1_D_800A76F8 = D_800ACCD4;
L1_D_800A770C = D_800ACCE8;
L1_D_800A7714 = D_800ACCF0;
L1_D_800A7728 = D_800ACD04;
L1_D_800A773C = D_800ACD18;
L1_D_800A7750 = D_800ACD2C;
L1_D_800A775C = D_800ACD38;
L1_D_800A7778 = D_800ACD54;
L1_D_800A7784 = D_800ACD60;
L1_D_800A7788 = D_800ACD64;
L1_D_800A77A0 = D_800ACD7C;
L1_D_800A77B4 = D_800ACD90;
L1_D_800A77CC = D_800ACDA8;
L1_D_800A79F0 = D_800ACFCC;
L1_D_800A7A0C = D_800ACFE8;
L1_D_800A7A24 = D_800AD000;
L1_D_800A7A30 = D_800AD00C;
L1_D_800A7CF0 = D_800AD31C;
L1_D_800A7D08 = D_800AD334;
L1_D_800A7D20 = D_800AD34C;
L1_D_800A7D44 = D_800AD370;
L1_D_800A7D64 = D_800AD390;
L1_D_800A7D74 = D_800AD3B4;
L1_D_800A7D90 = D_800AD3D0;
L1_D_800A7DC0 = D_800AD400;
L1_D_800A7DE8 = D_800AD428;
L1_D_800A7DF4 = D_800AD434;
L1_D_800A7E14 = D_800AD454;
L1_D_800A7E34 = D_800AD474;
L1_D_800A7E50 = D_800AD490;
L1_D_800A7E74 = D_800AD4B4;
L1_D_800A7E90 = D_800AD4D0;
L1_D_800A7EC4 = D_800AD504;
L1_D_800A7EFC = D_800AD53C;
L1_D_800A7F1C = D_800AD55C;
L1_D_800A7F2C = D_800AD56C;
L1_D_800A7FF8 = D_800AD638;
L1_D_800A8000 = D_800AD640;
L1_D_800A80A4 = D_800AD6E4;
L1_D_800A80B0 = D_800AD6F0;
L1_D_800A80BC = D_800AD6FC;
L1_D_800A80C8 = D_800AD708;
L1_D_800A811C = D_800AD75C;
L1_D_800A81F8 = D_800AD838;
L1_D_800A8210 = D_800AD850;
L1_D_800A8224 = D_800AD864;
L1_D_800A8238 = D_800AD878;
L1_D_800A824C = D_800AD88C;
L1_D_800A8260 = D_800AD8A0;
L1_D_800A8274 = D_800AD8B4;
L1_D_800A8280 = D_800AD8C0;
L1_D_800A828C = D_800AD8CC;
L1_D_800A82B4 = D_800AD8F4;
L1_D_800A82DC = D_800AD91C;
L1_D_800A8304 = D_800AD944;
L1_D_800A8308 = D_800AD948;
L1_D_800A8310 = D_800AD950;
L1_D_800A8318 = D_800AD958;
L1_D_800A8320 = D_800AD960;
L1_D_800A832C = D_800AD96C;
L1_D_800A8340 = D_800AD980;
L1_D_800A8370 = D_800AD9B0;
L1_D_800A8390 = D_800AD9D0;
L1_D_800A83B0 = D_800AD9F0;
L1_D_800A83BC = D_800AD9FC;
L1_D_800A83C8 = D_800ADA08;
L1_D_800A83D4 = D_800ADA14;
L1_D_800A83E0 = D_800ADA20;
L1_D_800A83E8 = D_800ADA28;
L1_D_800A83F0 = D_800ADA30;
L1_D_800A8400 = D_800ADA40;
L1_D_800A8410 = D_800ADA50;
L1_D_800A8418 = D_800ADA58;
L1_D_800A8420 = D_800ADA60;
L1_D_800A842C = D_800ADA6C;
L1_D_800A8444 = D_800ADA84;
L1_D_800A844C = D_800ADA8C;
L1_D_800A8458 = D_800ADA98;
L1_D_800A8460 = D_800ADAA0;
L1_D_800A8464 = D_800ADAA4;
L1_D_800A8468 = D_800ADAA8;
L1_D_800A8478 = D_800ADAB8;
L1_D_800A8484 = D_800ADAC4;
L1_D_800A8490 = D_800ADAD0;
L1_D_800A849C = D_800ADADC;
L1_D_800A84A8 = D_800ADAE8;
L1_D_800A84B4 = D_800ADAF4;
L1_D_800A84B8 = D_800ADAF8;
L1_D_800A84D0 = D_800ADB10;
L1_D_800A84D8 = D_800ADB18;
L1_D_800A84E4 = D_800ADB24;
L1_D_800A84F0 = D_800ADB30;
L1_D_800A84FC = D_800ADB3C;
L1_D_800A850C = D_800ADB4C;
L1_D_800A851C = D_800ADB5C;
L1_D_800A8528 = D_800ADB68;
L1_D_800A8534 = D_800ADB74;
L1_D_800A8544 = D_800ADB84;
L1_D_800A857C = D_800ADBBC;
L1_D_800A85C4 = D_800ADC04;
L1_D_800A85D4 = D_800ADC14;
L1_D_800A85F8 = D_800ADC38;
L1_D_800A86C0 = D_800ADD30;
L1_D_800A86CC = D_800ADD3C;
L1_D_800A8764 = D_800ADDC4;
L1_D_800A87EC = D_800ADE4C;
L1_D_800A880C = D_800ADE6C;
L1_D_800A8820 = D_800ADE80;
L1_D_800A8858 = D_800ADEB8;
L1_D_800A887C = D_800ADEDC;
L1_D_800A8884 = D_800ADEE4;
L1_D_800A8894 = D_800ADEF4;
L1_D_800A88A4 = D_800ADF04;
L1_D_800A88D0 = D_800ADF30;
L1_D_800A89A4 = D_800AE034;
L1_D_800A89F0 = D_800AE080;
L1_D_800A8A2C = D_800AE0BC;
L1_D_800A8AA8 = D_800AE138;
L1_D_800A8C08 = D_800AE298;
L1_D_800A8C28 = D_800AE2B8;
L1_D_800A8C48 = D_800AE2D8;
L1_D_800A8CB0 = D_800AE340;
L1_D_800A8CC4 = D_800AE354;
L1_D_800A8CEC = D_800AE37C;
L1_D_800A8CF8 = D_800AE388;
L1_D_800A8D14 = D_800AE3A4;
L1_D_800A8D44 = D_800AE3C4;
L1_D_800A8D58 = D_800AE3D8;
L1_D_800A8F94 = D_800AE554;
L1_D_800A8FAC = D_800AE56C;
L1_D_800A9390 = D_800AE950;
L1_D_800A9488 = D_800AEA0C;
L1_D_800A9498 = D_800AEA1C;
L1_D_800A9794 = D_800AF124;
L1_D_800A97BC = D_800AF14C;
L1_D_800A98C8 = D_800AF2A4;
L1_D_800A99D0 = D_800AF3E4;
L1_D_800A99EC = D_800AF400;
L1_D_800A9A08 = D_800AF41C;
L1_D_800A9A60 = D_800AF474;
L1_D_800A9A84 = D_800AF498;
L1_D_800A9AA8 = D_800AF4BC;
L1_D_800A9B6C = D_800AF580;
L1_D_800A9B78 = D_800AF58C;
L1_D_800A9BE8 = D_800AF5FC;
L1_D_800A9C08 = D_800AF61C;
L1_D_800A9C78 = D_800AF68C;
L1_D_800A9C8C = D_800AF6A0;
L1_D_800A9CA0 = D_800AF6B4;
L1_D_800A9CAC = D_800AF6C0;
L1_D_800A9CC0 = D_800AF6D4;
L1_D_800A9CC4 = D_800AF6D8;
L1_D_800A9CDC = D_800AF6F0;
L1_D_800A9D00 = D_800AF714;
L1_D_800A9D18 = D_800AF72C;
L1_D_800A9D30 = D_800AF744;
L1_D_800A9D44 = D_800AF758;
L1_D_800A9D78 = D_800AF78C;
L1_D_800A9D90 = D_800AF7A4;
L1_D_800A9EB0 = D_800AF8C4;
L1_D_800A9EC8 = D_800AF8DC;
L1_D_800A9EE0 = D_800AF8F4;
L1_D_800A9F10 = D_800AF924;
L1_D_800A9F2C = D_800AF940;
L1_D_800A9F44 = D_800AF958;
L1_D_800A9F60 = D_800AF974;
L1_D_800A9F80 = D_800AF994;
L1_D_800A9F8C = D_800AF9A0;
L1_D_800A9F9C = D_800AF9B0;
L1_D_800A9FC8 = D_800AF9DC;
L1_D_800A9FD0 = D_800AF9E4;
L1_D_800AA000 = D_800AFA14;
L1_D_800AA024 = D_800AFA38;
L1_D_800AA044 = D_800AFA58;
L1_D_800AA058 = D_800AFA6C;
L1_D_800AA07C = D_800AFA90;
L1_D_800AA09C = D_800AFAB0;
L1_D_800AA0B8 = D_800AFACC;
L1_D_800AA0BC = D_800AFAD0;
L1_D_800AA0BE = D_800AFAD2;
L1_D_800AA0C0 = D_800AFAD4;
L1_D_800AA0DC = D_800AFAF0;
L1_D_800AA110 = D_800AFB24;
L1_D_800AA154 = D_800AFB68;
L1_D_800AA170 = D_800AFB84;
L1_D_800AA1B0 = D_800AFBC4;
L1_D_800AA1D0 = D_800AFBE4;
L1_D_800AA3C0 = D_800AFDD4;
L1_D_800AA3E8 = D_800AFDFC;
L1_D_800AA410 = D_800AFE24;
L1_D_800AA438 = D_800AFE4C;
L1_D_800AA444 = D_800AFE58;
L1_D_800AA46C = D_800AFE80;
L1_D_800AA494 = D_800AFEA8;
L1_D_800AA4C0 = D_800AFED4;
L1_D_800AA4F0 = D_800AFF04;
L1_D_800AA518 = D_800AFF2C;
L1_D_800AA580 = D_800AFF94;
L1_D_800AA590 = D_800AFFA4;
L1_D_800AA5A0 = D_800AFFB4;
L1_D_800AA5B4 = D_800AFFC8;
L1_D_800AA70C = D_800B0120;
L1_D_800AA71C = D_800B0130;
L1_D_800AA738 = D_800B014C;
L1_D_800AA744 = D_800B0158;
L1_D_800AA760 = D_800B0174;
L1_D_800AA774 = D_800B0188;
L1_D_800AA794 = D_800B01A8;
L1_D_800AA79C = D_800B01B0;
L1_D_800AA7A8 = D_800B01BC;
L1_D_800AA7B0 = D_800B01C4;
L1_D_800AA7C0 = D_800B01D4;
L1_D_800AA800 = D_800B0214;
L1_D_800AA80C = D_800B0220;
L1_D_800AA818 = D_800B022C;
L1_D_800AA830 = D_800B0244;
L1_D_800AA84C = D_800B0260;
L1_D_800AA8A0 = D_800B02B4;
L1_D_800AA8C8 = D_800B02DC;
L1_D_800AA8E0 = D_800B02F4;
L1_D_800AA8E8 = D_800B02FC;
L1_D_800AA8F0 = D_800B0304;
L1_D_800AB4A0 = D_800B0EB8;
L1_D_800AB540 = D_800B0F58;
L1_D_800AB5E0 = D_800B0FF8;
L1_D_800AB5E4 = D_800B0FFC;
L1_D_800AB5E8 = D_800B1000;
L1_D_800AB5EC = D_800B1004;
L1_D_800AB5F0 = D_800B1008;
L1_D_800AB5F4 = D_800B100C;
L1_D_800AB5F8 = D_800B1010;
L1_D_800AB5FC = D_800B1014;
L1_D_800AB600 = D_800B1018;
L1_D_800AB604 = D_800B101C;
L1_D_800AB608 = D_800B1020;
L1_D_800AB60C = D_800B1024;
L1_D_800AB610 = D_800B1028;
L1_D_800AB614 = D_800B102C;
L1_D_800AB618 = D_800B1030;
L1_D_800AB744 = D_800B117C;
L1_D_800AB754 = D_800B118C;
L1_D_800AC284 = D_800B1CBC;
L1_D_800AC384 = D_800B1DBC;
L1_D_800AC38C = D_800B1DC4;
L1_D_800AC4C8 = D_800B1F1C;
L1_D_800AC4D0 = D_800B1F24;
L1_D_800AC4D8 = D_800B1F2C;
L1_D_800AC4DC = D_800B1F30;
L1_D_800AC4E0 = D_800B1F34;
L1_D_800AC4E4 = D_800B1F38;
L1_D_800AC4E8 = D_800B1F3C;
L1_D_800AC4EC = D_800B1F40;
L1_D_800AC54C = D_800B1FA0;
L1_D_800AC550 = D_800B1FA4;
L1_D_800AE940 = D_800B49D4;
L1_D_800AE9B8 = D_800B4A4C;
L1_D_800AE9C0 = D_800B4A54;
L1_D_800AEB1A = D_800B4BAE;
L1_D_800AEC38 = D_800B4CCC;
L1_D_800AEDA0 = D_800B4E34;
L1_D_800AEDA4 = D_800B4E38;
L1_D_800AEDA8 = D_800B4E3C;
L1_D_800AEDAC = D_800B4E40;
L1_D_800AEDB0 = D_800B4E44;
L1_D_800AEDB4 = D_800B4E48;
L1_D_800AEDB8 = D_800B4E4C;
L1_D_800AEDBC = D_800B4E50;
L1_D_800AEDD4 = D_800B4E68;
L1_D_800AEDD8 = D_800B4E6C;
L1_D_800AEDDC = D_800B4E70;
L1_D_800AEDE0 = D_800B4E74;
L1_D_800AEDE4 = D_800B4E78;
L1_D_800AEDE8 = D_800B4E7C;
L1_D_800AEDEC = D_800B4E80;
L1_D_800AEDF0 = D_800B4E84;
L1_D_800AEE10 = D_800B4EA4;
L1_D_800AEE14 = D_800B4EA8;
L1_D_800AF620 = D_800B56B4;
L1_D_800AF624 = D_800B56B8;
L1_D_800AF6A4 = D_800B5738;
L1_D_800AF6A5 = D_800B5739;
L1_D_800AF6A8 = D_800B573C;
L1_D_800AFEA8 = D_800B5F3C;
L1_D_800AFEAC = D_800B5F40;
L1_D_800AFEB0 = D_800B5F44;
L1_D_800AFEB5 = D_800B5F49;
L1_D_800AFEB6 = D_800B5F4A;
L1_D_800AFEB7 = D_800B5F4B;
L1_D_800AFEB8 = D_800B5F4C;
L1_D_800AFEB9 = D_800B5F4D;
L1_D_800AFEBC = D_800B5F50;
L1_D_800AFEC0 = D_800B5F54;
L1_D_800AFEC8 = D_800B5F5C;
L1_D_800AFF2C = D_800B5FC0;
L1_D_800AFF48 = D_800B5FDC;
L1_D_800AFF4C = D_800B5FE0;
L1_D_800AFF58 = D_800B5FEC;
L1_D_800AFF64 = D_800B5FF8;
L1_D_800AFF68 = D_800B5FFC;
L1_D_800AFF70 = D_800B6004;
L1_D_800AFF78 = D_800B600C;
L1_D_800AFF80 = D_800B6014;
L1_D_800AFF84 = D_800B6018;
L1_D_800AFF88 = D_800B601C;
L1_D_800AFF8C = D_800B6020;
L1_D_800AFF94 = D_800B6028;
L1_D_800AFF98 = D_800B602C;
L1_D_800AFFA4 = D_800B6038;
L1_D_800AFFA8 = D_800B603C;
L1_D_800AFFAC = D_800B6040;
L1_D_800AFFB0 = D_800B6044;
L1_D_800AFFB4 = D_800B6048;
L1_D_800AFFC0 = D_800B6054;
L1_D_800AFFC4 = D_800B6058;
L1_D_800AFFC8 = D_800B605C;
L1_D_800AFFCC = D_800B6060;
L1_D_800B0014 = D_800B60A8;
L1_D_800B0018 = D_800B60AC;
L1_D_800B0064 = D_800B60F8;
L1_D_800B0066 = D_800B60FA;
L1_D_800B0068 = D_800B60FC;
L1_D_800B0070 = D_800B6104;
L1_D_800B0084 = D_800B6118;
L1_D_800B008C = D_800B6120;
L1_D_800B0094 = D_800B6128;
L1_D_800B00A0 = D_800B6134;
L1_D_800B0108 = D_800B619C;
L1_D_800B05AC = D_800B6A90;
L1_D_800B05B0 = D_800B6A94;
L1_D_800B077C = D_800B6C60;
L1_D_800B0794 = D_800B6C78;
L1_D_800B0798 = D_800B6C7C;
L1_D_800B07A4 = D_800B6C88;
L1_D_800B07A8 = D_800B6C8C;
L1_D_800B07AC = D_800B6C90;
L1_D_800B07B0 = D_800B6C94;
L1_D_800B07B4 = D_800B6C98;
L1_D_800B07B8 = D_800B6C9C;
L1_D_800B07BC = D_800B6CA0;
L1_D_800B07C0 = D_800B6CA4;
L1_D_800B07C4 = D_800B6CA8;
L1_D_800B0804 = D_800B6CE8;
L1_D_800B0808 = D_800B6CEC;
L1_D_800B0848 = D_800B6D2C;
L1_D_800B0868 = D_800B6D4C;
L1_D_800B086C = D_800B6D50;
L1_D_800B087C = D_800B6D60;
L1_D_800B0A94 = D_800B6F78;
L1_D_800B0A98 = D_800B6F7C;
L1_D_800B0AA0 = D_800B6F84;
L1_D_800B0AA4 = D_800B6F88;
L1_D_800B0AA8 = D_800B6F8C;
L1_D_800B0AB4 = D_800B6F98;
L1_D_800B0AB8 = D_800B6F9C;
L1_D_800B0AC0 = D_800B6FA4;
L1_D_800B0AC8 = D_800B6FAC;
L1_D_800B0ACC = D_800B6FB0;
L1_D_800B0AD0 = D_800B6FB4;
L1_D_800B0AD4 = D_800B6FB8;
L1_D_800B0AE0 = D_800B6FC4;
L1_D_800B0AE4 = D_800B6FC8;
L1_D_800B0AE8 = D_800B6FCC;
L1_D_800B0AEC = D_800B6FD0;
L1_D_800B0AFC = D_800B6FE0;
L1_D_800B0B10 = D_800B6FF4;
L1_D_800B0B14 = D_800B6FF8;
L1_D_800B0B54 = D_800B7038;
L1_D_800B0B58 = D_800B703C;
L1_D_800B0B64 = D_800B7048;
L1_D_800B0B68 = D_800B704C;
L1_D_800B0B6A = D_800B704E;
L1_D_800B0B6C = D_800B7050;
L1_D_800B0B70 = D_800B7054;
L1_D_800B0B72 = D_800B7056;
L1_D_800B0B78 = D_800B705C;
L1_D_800B0B80 = D_800B7064;
L1_D_800B0B84 = D_800B7068;
L1_D_800B0B88 = D_800B706C;
L1_D_800B0B8C = D_800B7070;
L1_D_800B0B9C = D_800B7080;
L1_D_800B0BA0 = D_800B7084;
L1_D_800B0BB4 = D_800B7098;
L1_D_800B0BB8 = D_800B709C;
L1_D_800B0BBC = D_800B70A0;
L1_D_800B0BC0 = D_800B70A4;
L1_D_800B0C10 = D_800B70F4;
L1_D_800B0C30 = D_800B7114;
L1_D_800B0C38 = D_800B711C;
L1_D_800B0C5C = D_800B7140;
L1_D_800B0C60 = D_800B7144;
L1_D_800B0C64 = D_800B7148;
L1_D_800B0C68 = D_800B714C;
L1_D_800B0C74 = D_800B7158;
L1_D_800B0C84 = D_800B7168;
L1_D_800B0C8C = D_800B7170;
L1_D_800B0C9C = D_800B7180;
L1_D_800B0CA0 = D_800B7184;
L1_D_800B0CA4 = D_800B7188;
L1_D_800B0CA8 = D_800B718C;
L1_D_800B0CB0 = D_800B7194;
L1_D_800B0CC4 = D_800B71A8;
L1_D_800B0D50 = D_800B7234;
L1_D_800B0D94 = D_800B7278;
L1_D_800B0D9C = D_800B7280;
L1_D_800B0DA0 = D_800B7284;
L1_D_800B0DA4 = D_800B7288;
L1_D_800B0DA8 = D_800B728C;
L1_D_800B0DAC = D_800B7290;
L1_D_800B0DB0 = D_800B7294;
L1_D_800B0DB4 = D_800B7298;
L1_D_800B0DB8 = D_800B729C;
L1_D_800B0DBC = D_800B72A0;
L1_D_800B0DC0 = D_800B72A4;
L1_D_800B0DC4 = D_800B72A8;
L1_D_800B0DC8 = D_800B72AC;
L1_D_800B0DCC = D_800B72B0;
L1_D_800B0DD4 = D_800B72B8;
L1_D_800B0DDC = D_800B72C0;
L1_D_800B0DE4 = D_800B72C8;
L1_D_800B0E34 = D_800B7318;
L1_D_800B0E36 = D_800B731A;
L1_D_800B0E40 = D_800B7324;
L1_D_800B0E48 = D_800B732C;
L1_D_800B0E54 = D_800B7338;
L1_D_800B0E58 = D_800B733C;
L1_D_800B0E5E = D_800B7342;
L1_D_800B0E5F = D_800B7343;
L1_D_800B0E62 = D_800B7346;
L1_D_800B0E63 = D_800B7347;
L1_D_800B0E8C = D_800B7370;
L1_D_800B0EA0 = D_800B7384;
L1_D_800B0EFC = D_800B73E0;
L1_D_800B8EFC = D_800BF3E0;
L1_D_800B8F24 = D_800BF408;
L1_D_800B8F28 = D_800BF40C;
L1_D_800B8F68 = D_800BF44C;
L1_D_800B8F88 = D_800BF46C;
L1_D_800B8FB0 = D_800BF494;
L1_D_800C1C54 = D_800C625C;
L1_D_800CA8F4 = D_800CD020;
L1_D_800D28F4 = D_800D5020;
L1_D_800D2AF8 = D_800D5224;
L1_D_800D2AFC = D_800D5228;
L1_D_800D2BC4 = D_800D52F0;
L1_D_800D2BE8 = D_800D5314;
L1_D_800D2BEC = D_800D5318;
L1_D_800D2BF0 = D_800D531C;
L1_D_800D2D30 = D_800D545C;
L1_D_800D2E70 = D_800D559C;
L1_D_800D2E74 = D_800D55A0;
L1_D_800D2E84 = D_800D55B0;
L1_D_800D2E90 = D_800D55BC;
L1_D_800D2F48 = D_800D5674;
L1_D_800D2F68 = D_800D5694;
L1_D_800D2F8C = D_800D56B8;
L1_D_800D2F90 = D_800D56BC;
L1_D_800D2F94 = D_800D56C0;
L1_D_800D2FA4 = D_800D56D0;
L1_D_800D2FA8 = D_800D56D4;
L1_D_800D2FAC = D_800D56D8;
L1_D_800D2FB0 = D_800D56DC;
L1_D_800D2FC0 = D_800D56EC;
L1_D_800D2FC4 = D_800D56F0;
L1_D_800D2FF4 = D_800D5720;
L1_D_800D305C = D_800D5788;
L1_D_800D3068 = D_800D5794;
L1_D_800D308C = D_800D57B8;
L1_D_800D30C0 = D_800D57EC;
L1_D_800D30D4 = D_800D5800;
L1_D_800D30D8 = D_800D5804;
L1_D_800D31B8 = D_800D58E4;
L1_D_800D31C0 = D_800D58EC;
L1_D_800D31D0 = D_800D58FC;
L1_D_800D3238 = D_800D5964;
L1_D_800D3288 = D_800D59B4;
L1_D_800D3FA8 = D_800D66D4;
L1_D_800D3FAC = D_800D66D8;
L1_D_800D3FB0 = D_800D66DC;
L1_D_800D3FD4 = D_800D6700;
L1_D_800D3FD8 = D_800D6704;
L1_D_800D3FE0 = D_800D670C;
L1_D_800D3FE4 = D_800D6710;
L1_D_800D3FEC = D_800D6718;
L1_D_800D3FF0 = D_800D671C;
L1_D_800D4050 = D_800D677C;
L1_D_800D4058 = D_800D6784;
L1_D_800D4068 = D_800D6794;
L1_D_800D406C = D_800D6798;
L1_D_800D4070 = D_800D679C;
L1_D_800D4074 = D_800D67A0;
L1_D_800D4080 = D_800D67AC;
L1_D_800D40D8 = D_800D6804;
L1_D_800D40F8 = D_800D6824;
L1_D_800D40FC = D_800D6828;
L1_D_800D4100 = D_800D682C;
L1_D_800D4104 = D_800D6830;
L1_D_800D4108 = D_800D6834;
L1_D_800D410C = D_800D6838;
L1_D_800D4110 = D_800D683C;
L1_D_800D4114 = D_800D6840;
L1_D_800D424C = D_800D6978;
L1_D_800D4250 = D_800D697C;
L1_D_800D4384 = D_800D6AB0;
L1_D_800D4385 = D_800D6AB1;
L1_D_800D4386 = D_800D6AB2;
L1_D_800D4387 = D_800D6AB3;
L1_D_800D4388 = D_800D6AB4;
L1_D_800D4389 = D_800D6AB5;
L1_D_800D438A = D_800D6AB6;
L1_D_800D438B = D_800D6AB7;
L1_D_800D438C = D_800D6AB8;
L1_D_800D438D = D_800D6AB9;
L1_D_800D438E = D_800D6ABA;
L1_D_800D438F = D_800D6ABB;
L1_D_800D4390 = D_800D6ABC;
L1_D_800D43A8 = D_800D6AD4;
L1_D_800D43AC = D_800D6AD8;
L1_D_800D43C0 = D_800D6AEC;
L1_D_800D43C4 = D_800D6AF0;
L1_D_800D43CC = D_800D6AF8;
L1_D_800D43D0 = D_800D6AFC;
L1_D_800D43E4 = D_800D6B10;
L1_D_800D43F0 = D_800D6B1C;
L1_D_800D43F4 = D_800D6B20;
L1_D_800D43F8 = D_800D6B24;
L1_D_800D4400 = D_800D6B2C;
L1_D_800D4404 = D_800D6B30;
L1_D_800D440C = D_800D6B38;
L1_D_800D4410 = D_800D6B3C;
L1_D_800D4414 = D_800D6B40;
L1_D_800D4424 = D_800D6B50;
L1_D_800D4440 = D_800D6B6C;
L1_D_800D4444 = D_800D6B70;
L1_D_800D4450 = D_800D6BA0;
L1_D_800D4454 = D_800D6BA4;
L1_D_800D4458 = D_800D6BA8;
L1_D_800D445C = D_800D6BAC;
L1_D_800D4464 = D_800D6BB4;
L1_D_800D4468 = D_800D6BB8;
L1_D_800D446C = D_800D6BBC;
L1_D_800D4474 = D_800D6BC8;
L1_D_800D4484 = D_800D6BE0;
L1_D_800D4564 = D_800D6CC0;
L1_D_800D45C4 = D_800D6D20;
L1_D_800D45F4 = D_800D6D50;
L1_D_800D4688 = D_800D6DE4;
L1_D_800D46D8 = D_800D6E34;
L1_D_800D4958 = D_800D70B4;
L1_D_800D4984 = D_800D70E0;
L1_D_800D5DA4 = D_800D8500;
L1_D_800D5E80 = D_800D85DC;
L1_D_800D5ED0 = D_800D862C;
L1_D_800D5ED8 = D_800D8634;
L1_D_800D5EF0 = D_800D864C;
L1_D_800D5F40 = D_800D869C;
L1_D_800D5F48 = D_800D86A4;
L1_D_800D74F8 = D_800D9C54;
L1_D_800D74FC = D_800D9C58;
L1_D_800D7500 = D_800D9C5C;
L1_D_800D7550 = D_800D9CAC;
L1_D_800D7554 = D_800D9CB0;
L1_D_800D7588 = D_800D9CE4;
L1_D_800D77B8 = D_800D9F14;
L1_D_800D77E8 = D_800D9F44;
L1_D_800D7838 = D_800D9F94;
L1_D_800D7888 = D_800D9FE4;
L1_D_800D78D8 = D_800DA034;
L1_D_800D7930 = D_800DA08C;
L1_D_800D7980 = D_800DA0DC;
L1_D_800D79D0 = D_800DA12C;
L1_D_800D79D4 = D_800DA130;
L1_D_800D7A1C = D_800DA178;
L1_D_800D7A20 = D_800DA17C;
L1_D_800D7AB8 = D_800DA214;
L1_D_800D7B08 = D_800DA264;
L1_D_800D7BE8 = D_800DA344;
L1_D_800D7BF0 = D_800DA34C;
L1_D_800D7C24 = D_800DA380;
L1_D_800D7C64 = D_800DA3C0;
L1_D_800D7CB4 = D_800DA410;
L1_D_800D7CB8 = D_800DA414;
L1_D_800D7D08 = D_800DA464;
L1_D_800D7DF8 = D_800DA554;
L1_D_800D7DFC = D_800DA558;
L1_D_800D7E9C = D_800DA5F8;
L1_D_800D7EEC = D_800DA648;
L1_D_800D7FDC = D_800DA738;
L1_D_800D811C = D_800DA878;
L1_D_800D8138 = D_800DA894;
L1_D_800D8150 = D_800DA8AC;
L1_D_800D8154 = D_800DA8B0;
L1_D_800D861C = D_800DAD78;
L1_D_800D8620 = D_800DAD7C;
L1_D_800D8624 = D_800DAD80;
L1_D_800D8674 = D_800DADD0;
L1_D_800D86C4 = D_800DAE20;
L1_D_800D86C8 = D_800DAE24;
L1_D_800D86DC = D_800DAE38;
L1_D_800D86E0 = D_800DAE3C;
L1_D_800D86E4 = D_800DAE40;
L1_D_800D86E8 = D_800DAE44;
L1_D_800D8BE8 = D_800DB344;
L1_D_800D8C7C = D_800DB3D8;
L1_D_800D8C94 = D_800DB3F0;
L1_D_800D8E74 = D_800DB5D0;
L1_D_800D8E8C = D_800DB5F4;
L1_D_800D8EA4 = D_800DB618;
L1_D_800D8EA8 = D_800DB61C;
L1_D_800D8FF8 = D_800DB814;
L1_D_800D90C0 = D_800DB924;
L1_D_800D911C = D_800DB980;
L1_D_800D91E4 = D_800DBA48;
L1_D_800D91E7 = D_800DBA4B;
L1_D_800D91E8 = D_800DBA4C;
L1_D_800D91F0 = D_800DBA54;
L1_D_800D91F8 = D_800DBA5C;
L1_D_800D91FC = D_800DBA60;
L1_D_800D9200 = D_800DBA64;
L1_D_800D9208 = D_800DBA6C;
L1_D_800D920C = D_800DBA70;
L1_D_800D9210 = D_800DBA74;
L1_D_800D9214 = D_800DBA78;
L1_D_800D9218 = D_800DBA7C;
L1_D_800D9232 = D_800DBA96;
L1_D_800D9268 = D_800DBAD8;
L1_D_800D9278 = D_800DBAE8;
L1_D_800DA270 = D_800DCAE0;
L1_D_800DA5C0 = D_800DCE30;
L1_D_800DA5C4 = D_800DCE34;
L1_D_800DB7E4 = D_800DE054;
L1_D_800DB884 = D_800DE0F4;
L1_D_800DCAA4 = D_800DF314;
L1_D_800DCB44 = D_800DF3B4;
L1_D_800DCB4C = D_800DF3BC;
L1_D_800DD7F4 = D_800E0064;
L1_D_800DDC44 = D_800E0068;
L1_D_800DDC48 = D_800E006C;
L1_D_800DDC4C = D_800E0070;
L1_D_800DDC50 = D_800E0074;
L1_D_800DDC54 = D_800E0078;
L1_D_800DDC58 = D_800E007C;
L1_D_800DDC5C = D_800E0080;
L1_D_800DDC60 = D_800E0084;
L1_D_800DDC64 = D_800E0088;
L1_D_800DDC68 = D_800E008C;
L1_D_800DDC6C = D_800E0090;
L1_D_800DDCC0 = D_800E00E4;
L1_D_800DDCC4 = D_800E00E8;
L1_D_800DDCC8 = D_800E00EC;
L1_D_800DDCCC = D_800E00F0;
L1_D_800DDD8C = D_800E01B0;
L1_D_800DDD90 = D_800E01B4;
L1_D_800DDD94 = D_800E01B8;
L1_D_800DDD98 = D_800E01BC;
L1_D_800DDDA0 = D_800E01C4;
L1_D_800DDDA4 = D_800E01C8;
L1_D_800DDDA8 = D_800E01CC;
L1_D_800DDDAC = D_800E01D0;
L1_D_800DDDB0 = D_800E01D4;
L1_D_800DDDB4 = D_800E01D8;
L1_D_800DDDB8 = D_800E01DC;
L1_D_800DDDBC = D_800E01E0;
L1_D_800DDDCC = D_800E01F0;
L1_D_800DDDDC = D_800E0200;
L1_D_800DDDEC = D_800E0210;
L1_D_800DDE04 = D_800E0228;
L1_D_800DDE08 = D_800E022C;
L1_D_800DDE10 = D_800E0234;
L1_D_800DDE30 = D_800E0254;
L1_D_800DDE34 = D_800E0258;
L1_D_800DDEE0 = D_800E0304;
L1_D_800DDEE4 = D_800E0308;
L1_D_800DDEE8 = D_800E030C;
L1_D_800DDEEC = D_800E0310;
L1_D_800DDEF0 = D_800E0314;
L1_D_800DDF08 = D_800E032C;
L1_D_800DDF24 = D_800E0348;
L1_D_800DDFEC = D_800E0410;
L1_D_800DE000 = D_800E0424;
L1_D_800DE004 = D_800E0428;
L1_D_800DE018 = D_800E043C;
L1_D_800DE0C4 = D_800E04E8;
L1_D_800DE0C8 = D_800E04EC;
L1_D_800DE0D4 = D_800E04F8;
L1_D_800DE0D8 = D_800E04FC;
L1_D_800DE0DC = D_800E0500;
L1_D_800DE0E0 = D_800E0504;
L1_D_800DE0E4 = D_800E0508;
L1_D_800DE0E8 = D_800E0510;
L1_D_800DE8E8 = D_800E0D10;
L1_D_800DF0E8 = D_800E1510;
L1_D_800DF0EC = D_800E1514;
L1_D_800DF0F0 = D_800E1518;
L1_D_800DF0F8 = D_800E1520;
L1_D_800DF10C = D_800E1534;
L1_D_800DF12C = D_800E1554;
L1_D_800DF1F4 = D_800E161C;
L1_D_800DF200 = D_800E1628;
L1_D_800DF540 = D_800E1968;
L1_D_800DF5B8 = D_800E19E0;
L1_D_800DF684 = D_800E1AAC;
L1_D_800E02B4 = D_800E26DC;
L1_D_800E23D4 = D_800E5C30;
L1_D_800E23E8 = D_800E5C34;
L1_D_800E2438 = D_800E5CEC;
L1_D_800E2448 = D_800E5CFC;
L1_D_800E2DA8 = D_800E665C;
L1_D_800E2DBC = D_800E6670;
L1_D_800E2DE0 = D_800E6694;
L1_D_800E2DE4 = D_800E6698;
L1_D_800E2DF4 = D_800E66A8;
L1_D_800E2E44 = D_800E66F8;
L1_D_800E2E48 = D_800E66FC;
L1_D_800E2E4C = D_800E6700;
L1_D_800E2F2C = D_800E67E0;
L1_D_800E2F38 = D_800E67EC;
L1_D_800E2F3C = D_800E67F0;
L1_D_800E2F54 = D_800E6808;
L1_D_800E2F58 = D_800E680C;
L1_D_800E2F5C = D_800E6810;
L1_D_800F0F5C = D_800F4010;
L1_D_800F0F80 = D_800F4034;
L1_D_800F1180 = D_800F43E8;
L1_D_800F11A0 = D_800F4408;
L1_D_800F11D0 = D_800F4438;
L1_D_800F11F0 = D_800F4458;
L1_D_800F128C = D_800F44F4;
L1_D_800F1294 = D_800F44FC;
L1_D_800F12D4 = D_800F453C;
L1_D_800F12EC = D_800F4554;
L1_D_800F12F4 = D_800F455C;
L1_D_800F1314 = D_800F457C;
L1_D_800F1354 = D_800F45BC;
L1_D_800F136C = D_800F45D4;
L1_D_800F1374 = D_800F45DC;
L1_D_800F138C = D_800F45F4;
L1_D_800F1398 = D_800F4600;
L1_D_800F13A8 = D_800F4610;
L1_D_800F1DCC = D_800F5034;
L1_D_800F25D8 = D_800F5840;
L1_D_800F2FBC = D_800F6224;
L1_D_800F3848 = D_800F6AB0;
L1_D_800F3B48 = D_800F6DB0;
L1_D_800F3E98 = D_800F7100;
L1_D_800F40DC = D_800F7344;
L1_D_800F40E0 = D_800F7348;
L1_D_800F40F8 = D_800F7360;
L1_D_800F40FC = D_800F7364;
L1_D_800F4114 = D_800F737C;
L1_D_800F413C = D_800F73A4;
L1_D_800F415C = D_800F73C4;
L1_D_800F4264 = D_800F74CC;
L1_D_800F4268 = D_800F74D0;
L1_D_800F426C = D_800F74D4;
L1_D_800F4270 = D_800F74D8;
L1_D_800F5A64 = D_800F8CCC;
L1_D_800F5A65 = D_800F8CCD;
L1_D_800F5A66 = D_800F8CCE;
L1_D_800F5A68 = D_800F8CD0;
L1_D_800F5A6C = D_800F8CD4;
L1_D_800F6040 = D_800F92A8;
L1_D_800F6064 = D_800F92CC;
L1_D_800F6068 = D_800F92D0;
L1_D_800F606C = D_800F92D4;
L1_D_800F6070 = D_800F92D8;
L1_D_800F7664 = D_800FA8CC;
L1_D_800F7E64 = D_800FB0CC;
L1_D_800F7EC4 = D_800FB12C;
L1_D_800F7EC8 = D_800FB130;
L1_D_800F7EC9 = D_800FB131;
L1_D_800F7ECA = D_800FB132;
L1_D_800F7ECC = D_800FB134;
L1_D_800F7ECE = D_800FB136;
L1_D_800F7ED0 = D_800FB138;
L1_D_800F7ED2 = D_800FB13A;
L1_D_800F7EE4 = D_800FB14C;
L1_D_800F7EE8 = D_800FB150;
L1_D_800F7EEC = D_800FB154;
L1_D_800F7EF4 = D_800FB15C;
L1_D_800F7EF8 = D_800FB160;
L1_D_800F7EFC = D_800FB164;
L1_D_800F7F00 = D_800FB168;
L1_D_800F7F04 = D_800FB16C;
L1_D_800F7F08 = D_800FB170;
L1_D_800F7F10 = D_800FB178;
L1_D_800F7F1C = D_800FB184;
L1_D_800F7F64 = D_800FB1CC;
L1_D_800F7F68 = D_800FB1D0;
L1_D_800F7F6C = D_800FB1D4;
L1_D_800F7F70 = D_800FB1D8;
L1_D_800F7F74 = D_800FB1DC;
L1_D_800F7F81 = D_800FB1E9;
L1_D_800F7F84 = D_800FB1EC;
L1_D_800F7FCC = D_800FB234;
L1_D_800F8014 = D_800FB27C;
L1_D_800F81F4 = D_800FB45C;
L1_D_800F81F8 = D_800FB460;
L1_D_800F8204 = D_800FB46C;
L1_D_800F8208 = D_800FB470;
L1_D_800F8214 = D_800FB47C;
L1_D_800F8614 = D_800FB87C;
L1_D_800FC614 = D_800FF87C;
L1_D_800FC616 = D_800FF87E;
L1_D_800FC624 = D_800FF88C;
L1_D_800FC628 = D_800FF890;
L1_D_800FC62C = D_800FF894;
L1_D_800FC630 = D_800FF898;
L1_D_800FC640 = D_800FF8A8;
L1_D_800FC644 = D_800FF8AC;
L1_D_800FC648 = D_800FF8B0;
L1_D_800FC650 = D_800FF8B8;
L1_D_800FC654 = D_800FF8BC;
L1_D_800FC658 = D_800FF8C0;
L1_D_800FC65C = D_800FF8C4;
L1_D_800FC660 = D_800FF8C8;
L1_D_800FC664 = D_800FF8CC;
L1_D_800FC670 = D_800FF8D8;
L1_D_800FC67C = D_800FF8E4;
L1_D_800FC6A0 = D_800FF908;
L1_D_800FC6B0 = D_800FF918;
L1_D_800FC6C0 = D_800FF928;
L1_D_800FC780 = D_800FF9E8;
L1_D_800FC784 = D_800FF9EC;
L1_D_800FC788 = D_800FF9F0;
L1_D_800FC790 = D_800FF9F8;
L1_D_800FC794 = D_800FF9FC;
L1_D_800FCF94 = D_801001FC;
L1_D_800FCF98 = D_80100200;
L1_D_800FCF9C = D_80100204;
L1_D_800FCFA0 = D_80100208;
L1_D_800FCFA4 = D_8010020C;
L1_D_800FCFA8 = D_80100210;
L1_D_800FCFAC = D_80100214;
L1_D_800FCFB0 = D_80100218;
L1_D_800FCFB4 = D_8010021C;
L1_D_800FD038 = D_801002A0;
L1_D_800FD0B8 = D_80100320;
L1_D_800FD0F8 = D_80100360;
L1_D_800FD138 = D_801003A0;
L1_D_800FD178 = D_801003E0;
L1_D_800FD17C = D_801003E4;
L1_D_800FD190 = D_801003F8;
L1_D_800FD191 = D_801003F9;
L1_D_800FD195 = D_801003FD;
L1_D_800FD197 = D_801003FF;
L1_D_800FD19A = D_80100402;
L1_D_800FD19B = D_80100403;
L1_D_800FD19F = D_80100407;
L1_D_800FD1A1 = D_80100409;
L1_D_800FD1A2 = D_8010040A;
L1_D_800FD1A4 = D_8010040C;
L1_D_800FD1A6 = D_8010040C + 0x2;
L1_D_800FD1A8 = D_80100410;
L1_D_800FD1AC = D_80100414;
L1_D_800FD1BC = D_80100424;
L1_D_800FD1C0 = D_80100428;
L1_D_800FD1C4 = D_8010042C;
L1_D_800FD1C8 = D_80100430;
L1_D_800FD208 = D_80100470;
L1_D_800FD248 = D_801004B0;
L1_D_800FD24C = D_801004B4;
L1_D_800FD254 = D_801004BC;
L1_D_800FD258 = D_801004C0;
L1_D_800FD25C = D_801004C4;
L1_D_800FD260 = D_801004C8;
L1_D_800FD264 = D_801004CC;
L1_D_800FD266 = D_801004CE;
L1_D_800FD268 = D_801004D0;
L1_D_800FD26A = D_801004D2;
L1_D_800FD26C = D_801004D4;
L1_D_800FD3E4 = D_8010064C;
L1_D_800FD3E8 = D_80100650;
L1_D_800FD400 = D_80100668;
L1_D_800FD440 = D_801006A8;
L1_D_800FD442 = D_801006AA;
L1_D_800FD444 = D_801006AC;
L1_D_800FD446 = D_801006AE;
L1_D_800FD448 = D_801006B0;
L1_D_800FD44A = D_801006B2;
L1_D_800FD44C = D_801006B4;
L1_D_800FD44E = D_801006B6;
L1_D_800FD450 = D_801006B8;
L1_D_800FD452 = D_801006BA;
L1_D_800FD454 = D_801006BC;
L1_D_800FD456 = D_801006BE;
L1_D_800FD458 = D_801006C0;
L1_D_800FD45A = D_801006C2;
L1_D_800FD45D = D_801006C5;
L1_D_800FD45E = D_801006C6;
L1_D_800FD460 = D_801006C8;
L1_D_800FD462 = D_801006CA;
L1_D_800FD464 = D_801006CC;
L1_D_800FD466 = D_801006CE;
L1_D_800FD46A = D_801006D2;
L1_D_800FD46C = D_801006D4;
L1_D_800FD46E = D_801006D6;
L1_D_800FD470 = D_801006D8;
L1_D_800FD472 = D_801006DA;
L1_D_800FD476 = D_801006DE;
L1_D_800FD824 = D_80100A8C;
L1_D_800FD980 = D_80100BE8;
L1_D_800FD984 = D_80100BEC;
L1_D_800FD988 = D_80100BF0;
L1_D_800FD98C = D_80100BF4;
L1_D_800FD990 = D_80100BF8;
L1_D_800FD994 = D_80100BFC;
L1_D_800FD998 = D_80100C00;
L1_D_800FD99C = D_80100C04;
L1_D_800FD9A0 = D_80100C08;
L1_D_800FD9A4 = D_80100C0C;
L1_D_800FD9AC = D_80100C14;
L1_D_800FD9C0 = D_80100C28;
L1_D_800FD9C8 = D_80100C30;
L1_D_800FD9D0 = D_80100C38;
L1_D_800FD9D8 = D_80100C40;
L1_D_800FD9DC = D_80100C44;
L1_D_800FD9E0 = D_80100C48;
L1_D_800FD9F4 = D_80100C5C;
L1_D_800FDA04 = D_80100C6C;
L1_D_800FDA08 = D_80100C70;
L1_D_800FDA0C = D_80100C74;
L1_D_800FDA24 = D_80100C8C;
L1_D_800FDB2C = D_80100D94;
L1_DebugPage_ArtProfile = func_80041954;
func_80041C4C = L1_DebugPage_Camera;
L1_DebugPage_ContourMask = func_80078588;
L1_DebugPage_FPWeapon = func_8007D644;
L1_DebugPage_Framerate = func_80041990;
L1_DebugPage_Loadpoint = func_80031E68;
func_800419DC = L1_DebugPage_ObjectCount;
L1_DebugPage_Profile = func_80041918;
func_8002FE04 = L1_DebugScreen_DrawPage;
L1_DeliverEvent = func_80097E8C;
func_80032CF8 = L1_DevMenu_Draw;
func_80032AA0 = L1_DevMenu_HandleInput;
func_80032EC0 = L1_DevMenu_Init;
L1_DisableEvent = func_8009EE38;
L1_EVENT_OBJ_11C = func_80089CD0;
L1_EVENT_OBJ_90 = func_80089C44;
L1_EVENT_OBJ_CC = func_80089C80;
L1_EVENT_OBJ_F4 = func_80089CA8;
L1_EnableEvent = func_80082F30;
L1_FlushCache = func_8009F148;
L1_FntFlush = func_8008BDA4;
L1_FntLoad = func_8008BA4C;
L1_FntOpen = func_8008BAEC;
L1_FntPrint = func_8008C0C0;
L1_GPU_cw = func_80092870;
L1_GS_001_OBJ_1F8 = func_80088B1C;
L1_GS_001_OBJ_74 = func_80088998;
L1_GS_107_OBJ_4B8 = func_8007AC38;
L1_GS_107_OBJ_51C = func_8007AC9C;
L1_GetClut = func_80085E5C;
L1_GetTPage = func_80085EDC;
func_8002F814 = L1_Gfx_Init;
L1_GsClearOt = func_8008D22C;
L1_GsDefDispBuff = func_8008E50C;
L1_GsGetActiveBuff = func_80088E94;
L1_GsGetHeadpUnit = func_800925A8;
L1_GsGetLs = func_8007E3BC;
L1_GsGetLsUnit = func_80090D14;
L1_GsGetLwUnit = func_80090FE4;
L1_GsGetTimInfo = func_800900AC;
L1_GsInit3D = func_8008E48C;
L1_GsInitGraph = func_80088924;
L1_GsInitGraph2 = func_80088AB4;
L1_GsInitVcount = func_80089D94;
L1_GsLinkAnim = func_8009223C;
L1_GsLinkObject4 = func_80089DD4;
L1_GsMapCoordUnit = func_80091844;
L1_GsMapModelingData = func_8008F9EC;
L1_GsMapUnit = func_800918C4;
L1_GsScanAnim = func_80092194;
L1_GsScanUnit = func_800923F0;
L1_GsSetAmbient = func_80092720;
L1_GsSetDrawBuffClip = func_800971E4;
L1_GsSetDrawBuffOffset = func_80088EA4;
L1_GsSetFlatLight = func_8007A780;
L1_GsSetRefView2 = func_80089074;
L1_GsSortClear = func_80088D3C;
L1_GsSortObject4 = func_8007F6D8;
L1_GsSortOt = func_8008B94C;
L1_GsSortUnit = func_80090B40;
L1_GsSwapDispBuff = func_8008D28C;
L1_GsTMDdivF3NL = func_8008EAFC;
L1_GsTMDdivG3NL = func_8008ECEC;
L1_GsTMDdivNF3 = func_8008E09C;
L1_GsTMDdivNG3 = func_8008E28C;
L1_GsTMDdivTF3L = func_8008EEEC;
L1_GsTMDdivTF3LFG = func_8008D33C;
L1_GsTMDdivTF3NL = func_8008C90C;
L1_GsTMDdivTG3NL = func_8008CBBC;
L1_GsTMDdivTNF3 = func_8008F49C;
L1_GsTMDdivTNG3 = func_8008F74C;
L1_GsTMDfastF3GL = func_8008CE0C;
L1_GsTMDfastF3GLFG = func_8008E5CC;
L1_GsTMDfastF3GNL = func_8008DB6C;
L1_GsTMDfastF3L = func_80080D44;
L1_GsTMDfastF3LFG = func_80080E8C;
L1_GsTMDfastF3NL = func_80080C04;
L1_GsTMDfastG3GL = func_8008D02C;
L1_GsTMDfastG3GLFG = func_8008E7EC;
L1_GsTMDfastG3GNL = func_8008DF2C;
L1_GsTMDfastG3L = func_800807A0;
L1_GsTMDfastG3LFG = func_80080930;
L1_GsTMDfastG3NL = func_80080660;
L1_GsTMDfastNF3 = func_80080AC8;
L1_GsTMDfastNG3 = func_80080518;
L1_GsTMDfastTF3L = func_80080238;
L1_GsTMDfastTF3LFG = func_800803A8;
L1_GsTMDfastTF3NL = func_800800D4;
L1_GsTMDfastTG3L = func_8007F36C;
L1_GsTMDfastTG3LFG = func_8007F520;
L1_GsTMDfastTG3NL = func_8007F210;
L1_GsTMDfastTNF3 = func_8007FF68;
L1_GsTMDfastTNG3 = func_8007F098;
L1_GsU_00000008 = func_8009D708;
L1_GsU_00000009 = func_8009D888;
L1_GsU_0000000c = func_8009CDC8;
L1_GsU_0000000d = func_8009CF88;
L1_GsU_0000000f = func_8009D158;
L1_GsU_00000209 = func_8009DA18;
L1_GsU_0000020d = func_8009D338;
L1_GsU_00200009 = func_8009DBB8;
L1_GsU_0020000d = func_8009D528;
L1_GsU_01000000 = func_8009BE28;
L1_GsU_0100000c = func_8009B988;
L1_GsU_0100000d = func_8009BBF8;
L1_GsU_02000000 = func_8009B848;
L1_GsU_02000001 = func_8009B8D8;
L1_GsU_03000000 = D_8009BF58;
L1_GsU_03000001 = func_8009C698;
L1_GsU_03000010 = func_8009C878;
L1_GsU_03000011 = func_8009CA68;
L1_Gssub_make_matrix = func_800904BC;
L1_HookEntryInt = func_80096EA4;
L1_INTR_DMA_OBJ_1CC = func_80097080;
L1_INTR_DMA_OBJ_278 = func_8009712C;
L1_INTR_DMA_OBJ_4C = func_80096F00;
L1_INTR_VB_OBJ_58 = func_80096DAC;
L1_INTR_VB_OBJ_C4 = func_80096E18;
L1_INTR_VB_OBJ_F0 = func_80096E44;
L1_ISO9660_OBJ_2D8 = func_800879F0;
L1_ISO9660_OBJ_2F8 = func_80087A10;
L1_ISO9660_OBJ_5BC = func_80087CD4;
L1_ISO9660_OBJ_660 = func_80087D78;
L1_ISO9660_OBJ_8FC = func_80088014;
L1_InitGeom = func_8008B8C4;
L1_InitHeap3 = func_8008F98C;
L1_LoadClut = func_8008FFCC;
L1_LoadClut2 = func_8009003C;
L1_LoadTPage = func_80099A5C;
func_800788CC = L1_Math_Abs;
func_80078908 = L1_Math_Max;
func_800789BC = L1_Math_Max3;
func_80078954 = L1_Math_Min3;
L1_Menu_ResetState = func_80029200;
L1_MulMatrix = func_8007EA1C;
L1_MulMatrix2 = func_8007EB2C;
L1_OpenEvent = func_80083054;
L1_PADIF_OBJ_120 = func_8009945C;
L1_PADIF_OBJ_1CC = func_80099508;
L1_PADIF_OBJ_290 = func_800995CC;
L1_PADIF_OBJ_48 = func_80099384;
L1_PADPORTD_OBJ_160 = func_8008A224;
L1_PADPORTD_OBJ_1C8 = func_8008A28C;
L1_PADPORTD_OBJ_2BC = func_8008A380;
L1_PADPORTD_OBJ_2CC = func_8008A390;
L1_PADPORTD_OBJ_388 = func_8008A44C;
L1_PADPORTD_OBJ_604 = func_8008A6C8;
L1_PADPORTD_OBJ_63C = func_8008A700;
L1_PADSEQD_OBJ_144 = func_800982E0;
L1_PADSEQD_OBJ_34 = func_800981D0;
L1_PADSEQD_OBJ_488 = func_80098624;
L1_PATCHGTE_OBJ_DC = D_80099A58;
L1_PCcreat = func_80088E74;
L1_PClseek = func_80088098;
L1_PCopen = func_800876F8;
L1_PCread = func_80086FC0;
L1_PadInitDirect = func_8008A0C4;
func_800454B8 = L1_Pad_StickToSpeed;
func_8002F3A8 = L1_Pad_Update;
func_800422D8 = L1_PauseMenu_Open;
L1_PopMatrix = func_8007AE54;
L1_PushMatrix = func_8007ADB0;
L1_ResetEntryInt = func_80097184;
func_80042CB8 = L1_RestartPrompt_Open;
L1_ReturnFromException = func_80097174;
L1_RotAverage3 = func_8009A59C;
L1_RotAverageNclip3 = func_8009A50C;
L1_RotAverageNclipColorCol3 = func_8009AF18;
L1_RotAverageNclipColorDpq3 = func_80099BAC;
L1_RotAverageNclipColorDpq3_1 = func_8009A004;
L1_RotMatrix = func_80091C74;
L1_RotMatrixY = func_8009031C;
L1_RotMatrixYXZ = func_80091F04;
L1_RotMatrixYXZ_gte = func_800908B0;
L1_RotTrans = func_80092840;
L1_ScaleMatrix = func_800925E0;
L1_SetBackColor = func_8009DD58;
L1_SetColorMatrix = func_8007AD80;
L1_SetDefDispEnv = func_8008EABC;
L1_SetDefDrawEnv = func_8008E9EC;
L1_SetDrawMode = func_80085D5C;
L1_SetDumpFnt = func_8008BA0C;
L1_SetFarColor = func_8009E458;
L1_SetLightMatrix = func_80092800;
L1_SetLineF4 = func_80085D3C;
L1_SetRotMatrix = func_800927B0;
L1_SetTransMatrix = func_800927E0;
L1_SpuClearReverbWorkArea = func_80097EBC;
L1_SpuFree = func_800980DC;
L1_SpuGetVoiceEnvelope = func_8009E0C8;
L1_SpuInitMalloc = func_8009F168;
L1_SpuIsTransferCompleted = func_8009B0D8;
L1_SpuMalloc = func_8009B578;
L1_SpuRead = func_8009B078;
L1_SpuSetCommonAttr = func_80094738;
L1_SpuSetKey = func_8009E118;
L1_SpuSetNoiseClock = func_8009E308;
L1_SpuSetTransferMode = func_8009AFE8;
L1_SpuSetTransferStartAddr = func_8009B018;
L1_SpuSetVoiceAttr = func_8009761C;
L1_SpuStart = func_80095598;
L1_SquareRoot0 = func_8007ACF0;
L1_SquareRoot12 = func_800906BC;
L1_SsEnd = func_8008A014;
L1_SsPitchFromNote = func_80093664;
L1_SsSeqCalledTbyT = func_80097C1C;
L1_SsSetSerialAttr = func_80085C4C;
L1_SsSetSerialVol = func_80085AA0;
L1_SsSetTickMode = func_80089774;
L1_SsUtAllKeyOff = func_80089614;
L1_SsVabClose = func_80089F64;
L1_SsVabOpenHead = func_8008FF2C;
L1_SsVabTransBody = func_8008FCDC;
L1_SsVabTransCompleted = func_8008FDAC;
L1_SsVoKeyOn = func_800856F8;
L1_SysDeqIntRP = func_8009925C;
L1_SysEnqIntRP = func_8009926C;
L1_TestEvent = func_8009F158;
L1_TransposeMatrix = func_8009058C;
L1_VSYNC_OBJ_178 = func_80088244;
L1_VS_VH2_OBJ_34 = func_8008FF60;
L1_VSync = func_800880CC;
func_800785F8 = L1_Vec_Dot;
func_80078674 = L1_Vec_ProjectXZ;
func_8007871C = L1_Vec_Scale;
L1_WaitEvent = func_8009EE28;
L1__SN_read = func_800956A0;
L1__SN_write = func_80097284;
L1__SpuInit = func_800954B0;
L1__SpuSetAnyVoice = func_8009F1C8;
L1__SsGetSeqData = func_8009F7C8;
L1__SsInit = func_80092880;
L1__SsReadDeltaValue = func_800A0308;
L1__SsSeqGetEof = func_8009F584;
L1__SsSeqPlay = func_8009F488;
L1__SsSndCrescendo = func_8009E6E8;
L1__SsSndNextSep = func_800A0208;
L1__SsSndPause = func_8009EB18;
L1__SsSndPlay = func_8009E6B8;
L1__SsSndReplay = func_8009EBB8;
L1__SsSndTempo = func_8009E8F8;
L1__SsVmAlloc = func_80094488;
L1__SsVmDoAllocate = func_80092E70;
L1__SsVmFlush = func_800929E0;
L1__SsVmInit = func_8009DD78;
L1__SsVmKeyOffNow = func_80093C60;
L1__SsVmKeyOnNow = func_80093790;
L1__SsVmSelectToneAndVag = func_8009E358;
L1__SsVmVSetUp = func_80092920;
L1__dirFailAuto = func_80098544;
L1__gp = D_800B02F4;
L1__padInitDirSeq = func_8009819C;
L1__patch_gte = func_8009997C;
L1__spu_gcSPU = func_8009EE48;
L1_bzero = func_8009865C;
L1_calloc3 = func_8008FA5C;
L1_chkRC2wait = func_8009929C;
L1_exit = func_80085E7C;
L1_free3 = func_8008FB8C;
L1_func_80026D08 = func_80026D34;
func_80026EFC = L1_func_80026ED0;
L1_func_80026F30 = func_80026F5C;
func_80027274 = L1_func_80027248;
func_800272D0 = L1_func_800272A4;
func_800273C0 = L1_func_80027394;
L1_func_800274F4 = func_800276BC;
func_80028538 = L1_func_80028370;
func_80028840 = L1_func_80028678;
L1_func_800286EC = func_800288B4;
func_800288F4 = L1_func_8002872C;
func_800289D8 = L1_func_80028810;
func_80028A20 = L1_func_80028858;
func_80028B20 = L1_func_80028958;
L1_func_800289C0 = func_80028B88;
func_80028D20 = L1_func_80028B58;
func_80028DD0 = L1_func_80028C08;
func_80028F84 = L1_func_80028DBC;
func_8002922C = L1_func_80029064;
L1_func_800291B0 = func_80029378;
func_8002967C = L1_func_800294B4;
func_800296CC = L1_func_80029504;
func_8002984C = L1_func_80029684;
L1_func_80029868 = func_80029A30;
L1_func_800299CC = func_80029B94;
L1_func_80029A34 = func_80029BFC;
L1_func_8002A3C8 = func_8002A590;
func_8002A7E4 = L1_func_8002A61C;
func_8002A8E8 = L1_func_8002A720;
func_8002AA1C = L1_func_8002A854;
func_8002AC5C = L1_func_8002AA94;
L1_func_8002AAC4 = func_8002AC8C;
func_8002ACC4 = L1_func_8002AAFC;
func_8002AE58 = L1_func_8002AC90;
L1_func_8002ADF0 = func_8002AFB8;
func_8002AFFC = L1_func_8002AE34;
L1_func_8002AF08 = func_8002B0D0;
func_8002B1C0 = L1_func_8002AFF8;
L1_func_8002B064 = func_8002B22C;
func_8002B268 = L1_func_8002B0A0;
func_8002B344 = L1_func_8002B17C;
L1_func_8002B29C = func_8002B464;
func_8002B864 = L1_func_8002B69C;
L1_func_8002BB34 = func_8002BCFC;
func_8002BD30 = L1_func_8002BB68;
func_8002BDE0 = L1_func_8002BC18;
func_8002BFEC = L1_func_8002BE24;
func_8002C0FC = L1_func_8002BF34;
func_8002C330 = L1_func_8002C168;
L1_func_8002C2D8 = func_8002C4A0;
func_8002C658 = L1_func_8002C490;
L1_func_8002C664 = func_8002C82C;
func_8002C884 = L1_func_8002C6BC;
L1_func_8002C83C = func_8002CA04;
L1_func_8002C844 = func_8002CA0C;
func_8002D2B8 = L1_func_8002D0F0;
func_8002D39C = L1_func_8002D1D4;
func_8002D6AC = L1_func_8002D4E4;
func_8002D7CC = L1_func_8002D604;
func_8002D8D0 = L1_func_8002D708;
func_8002DECC = L1_func_8002DD6C;
L1_func_8002E0E8 = func_8002E24C;
L1_func_8002E190 = func_8002E2F4;
func_8002E314 = L1_func_8002E1B0;
func_8002E480 = L1_func_8002E318;
L1_func_8002E3A0 = func_8002E508;
L1_func_8002E410 = func_8002E578;
L1_func_8002E430 = func_8002E598;
L1_func_8002E48C = func_8002E5F4;
L1_func_8002E4B4 = func_8002E61C;
L1_func_8002E4D4 = func_8002E63C;
func_8002E644 = L1_func_8002E4DC;
L1_func_8002E534 = func_8002E69C;
L1_func_8002E5C4 = func_8002E72C;
L1_func_8002E798 = func_8002E908;
L1_func_8002F0A4 = func_8002F214;
L1_func_8002F114 = func_8002F284;
L1_func_8002F53C = func_8002F6AC;
func_8002F6D4 = L1_func_8002F564;
func_8002F794 = L1_func_8002F624;
L1_func_8002F7CC = func_8002F93C;
L1_func_8002FFD8 = func_80030134;
func_80030274 = L1_func_80030118;
L1_func_80030304 = func_80030454;
L1_func_80030324 = func_80030474;
func_80030484 = L1_func_80030334;
func_80030504 = L1_func_800303B4;
L1_func_8003052C = func_8003067C;
L1_func_800305B4 = func_80030704;
L1_func_80030610 = func_80030760;
func_800307C0 = L1_func_80030670;
L1_func_800306A8 = func_800307F8;
L1_func_800306F0 = func_80030840;
func_800308E8 = L1_func_80030798;
L1_func_80030868 = func_800309B8;
L1_func_80030994 = func_80030AE4;
func_80030C54 = L1_func_80030B04;
func_80030E58 = L1_func_80030D08;
func_80030EF0 = L1_func_80030DA0;
L1_func_80030EB0 = func_80031000;
func_80031070 = L1_func_80030F20;
func_800310F8 = L1_func_80030FA8;
L1_func_800310B4 = func_80031204;
func_80031640 = L1_func_800314A0;
func_80031818 = L1_func_80031678;
L1_func_80031F18 = func_800320B8;
func_80032214 = L1_func_80032074;
func_80032390 = L1_func_800321F0;
func_80032630 = L1_func_8003246C;
L1_func_800324C0 = func_80032684;
func_80032694 = L1_func_800324D0;
L1_func_80032648 = func_8003280C;
func_800328E8 = L1_func_80032724;
func_8003292C = L1_func_80032768;
L1_func_80032880 = func_80032A44;
func_80033010 = L1_func_80032E4C;
L1_func_80032EFC = func_800330C0;
func_80033254 = L1_func_80033090;
func_80033468 = L1_func_800332A4;
func_800335A8 = L1_func_80033348;
func_80033634 = L1_func_800333D4;
func_80033680 = L1_func_80033420;
func_80033754 = L1_func_800334F4;
L1_func_80033F38 = func_800348FC;
func_8003535C = L1_func_80034998;
func_800353BC = L1_func_800349F8;
func_800359F4 = L1_func_80035030;
L1_func_800350F0 = func_80035AB4;
L1_func_800352B8 = func_80035C7C;
func_80036328 = L1_func_80035964;
func_800363B0 = L1_func_800359EC;
func_80036580 = L1_func_80035BBC;
func_800367AC = L1_func_80035DE8;
func_800368C8 = L1_func_80035F04;
func_80036B80 = L1_func_800361BC;
func_80036CEC = L1_func_80036328;
func_80036F78 = L1_func_800365B4;
func_80037034 = L1_func_80036670;
L1_func_800368A8 = func_8003726C;
L1_func_80036938 = func_800372FC;
func_800377BC = L1_func_80036E10;
L1_func_800373FC = func_80037DA8;
func_800380D0 = L1_func_80037768;
func_8003815C = L1_func_800377F4;
func_80038264 = L1_func_800378FC;
func_8003838C = L1_func_80037A24;
func_80038434 = L1_func_80037ACC;
L1_func_80037B6C = func_800384D4;
func_800389F0 = L1_func_800380DC;
L1_func_800381CC = func_80038AE0;
func_80038D18 = L1_func_80038404;
func_80039018 = L1_func_8003872C;
func_80039920 = L1_func_80038984;
func_80039C1C = L1_func_80038C04;
func_80039CA4 = L1_func_80038C8C;
L1_func_800390F8 = func_8003A110;
L1_func_800391B0 = func_8003A1C8;
L1_func_800393AC = func_8003A3C4;
func_8003A3FC = L1_func_800393E4;
L1_func_80039520 = func_8003A538;
L1_func_800395E8 = func_8003A600;
func_8003A798 = L1_func_800397A8;
L1_func_8003982C = func_8003A81C;
func_8003AA24 = L1_func_80039A34;
L1_func_80039A9C = func_8003AA8C;
L1_func_8003A51C = func_8003B50C;
L1_func_8003A68C = func_8003B67C;
L1_func_8003A71C = func_8003B70C;
func_8003B888 = L1_func_8003A898;
func_8003BA04 = L1_func_8003AA14;
L1_func_8003AC1C = func_8003BC0C;
func_8003C4E4 = L1_func_8003B4F4;
L1_func_8003B53C = func_8003C52C;
L1_func_8003B750 = func_8003C740;
L1_func_8003B808 = func_8003C7F8;
func_8003C930 = L1_func_8003B940;
func_8003CC88 = L1_func_8003BC98;
func_8003CE58 = L1_func_8003BE68;
func_8003CFA8 = L1_func_8003BFB8;
L1_func_8003C1BC = func_8003D1AC;
func_8003D5F0 = L1_func_8003C6B0;
func_8003D624 = L1_func_8003C6E4;
func_8003D7CC = L1_func_8003C88C;
func_8003D7E4 = L1_func_8003C8A4;
func_8003D904 = L1_func_8003C9C4;
L1_func_8003CA4C = func_8003D98C;
func_8003D9FC = L1_func_8003CABC;
L1_func_8003CC8C = func_8003DBCC;
L1_func_8003D76C = func_8003E63C;
func_8003ED28 = L1_func_8003DE58;
func_8003F028 = L1_func_8003E158;
func_8003F364 = L1_func_8003E494;
L1_func_8003E5A0 = func_8003F470;
func_8003F8F4 = L1_func_8003EA24;
func_8003F9D0 = L1_func_8003EB00;
L1_func_8003EC44 = func_8003FB14;
func_80040638 = L1_func_8003F768;
func_80040B9C = L1_func_8003FCE4;
func_80040E54 = L1_func_8003FF9C;
L1_func_8004009C = func_80040F54;
L1_func_80040778 = func_80041494;
func_80041694 = L1_func_80040978;
func_800417C4 = L1_func_80040AA8;
func_80041D78 = L1_func_8004105C;
func_80041ED8 = L1_func_800411BC;
L1_func_8004133C = func_80042058;
func_80042110 = L1_func_800413F4;
L1_func_800414AC = func_800421C8;
L1_func_80041578 = func_80042294;
func_800424E0 = L1_func_800417C4;
L1_func_800419CC = func_800427AC;
func_80042818 = L1_func_80041A38;
func_80042980 = L1_func_80041BA0;
func_80042A08 = L1_func_80041C28;
func_80042AD0 = L1_func_80041CF0;
func_80042B9C = L1_func_80041DBC;
func_80042C58 = L1_func_80041E78;
func_80042E00 = L1_func_80042020;
func_80042F6C = L1_func_8004218C;
L1_func_800425E4 = func_800433C4;
L1_func_80042A94 = func_80043874;
L1_func_80042B28 = func_80043908;
func_80043AFC = L1_func_80042D1C;
L1_func_80042E34 = func_80043C14;
L1_func_80042E6C = func_80043C4C;
func_80043E58 = L1_func_80043078;
func_80043FE0 = L1_func_80043200;
L1_func_800433A8 = func_80044188;
L1_func_800433F4 = func_800441D4;
L1_func_80043610 = func_800443F0;
PROVIDE(L1_func_80043B14 = func_800448F4);
PROVIDE(func_800448F4 = L1_func_80043B14);
L1_func_80043EE0 = func_80044CC0;
func_80045660 = L1_func_800448F4;
L1_func_80044B3C = func_80045890;
L1_func_80044BAC = func_80045900;
L1_func_80044BBC = func_80045910;
L1_func_80044BCC = func_80045920;
func_80045DD8 = L1_func_80045084;
func_80045EA0 = L1_func_8004514C;
func_80046098 = L1_func_80045344;
func_80046420 = L1_func_800456D0;
L1_func_80045A28 = func_80046778;
func_80046FBC = L1_func_8004626C;
L1_func_800463C8 = func_80047118;
func_80048068 = L1_func_80047318;
L1_func_800474AC = func_800481FC;
func_8004830C = L1_func_800475BC;
L1_func_800477C0 = func_80048510;
L1_func_8004782C = func_8004857C;
L1_func_8004783C = func_8004858C;
func_80048754 = L1_func_80047A04;
func_800488A0 = L1_func_80047B50;
func_80048B64 = L1_func_80047DBC;
L1_func_80047ECC = func_80048C74;
func_80049070 = L1_func_800483D8;
func_800490B4 = L1_func_8004841C;
L1_func_80048794 = func_8004942C;
func_800497E4 = L1_func_80048B4C;
func_80049A7C = L1_func_80048DE4;
func_80049AF8 = L1_func_80048E60;
L1_func_80048FE8 = func_80049C80;
L1_func_8004900C = func_80049CA4;
func_8004A058 = L1_func_800493C0;
func_8004A108 = L1_func_80049470;
func_8004A3D4 = L1_func_8004973C;
func_8004A57C = L1_func_800498E4;
func_8004A720 = L1_func_80049A88;
L1_func_80049B7C = func_8004A814;
func_8004A81C = L1_func_80049B84;
L1_func_80049D60 = func_8004A9F8;
L1_func_8004A294 = func_8004AF2C;
L1_func_8004A29C = func_8004AF34;
L1_func_8004A304 = func_8004AF9C;
L1_func_8004A338 = func_8004AFD0;
L1_func_8004A370 = func_8004B008;
L1_func_8004A380 = func_8004B018;
L1_func_8004A398 = func_8004B030;
L1_func_8004A81C = func_8004B46C;
L1_func_8004A85C = func_8004B4AC;
L1_func_8004A8A8 = func_8004B4F8;
func_8004B534 = L1_func_8004A8E4;
L1_func_8004A9E4 = func_8004B634;
func_8004BB5C = L1_func_8004AF0C;
L1_func_8004B028 = func_8004BC78;
L1_func_8004B04C = func_8004BC9C;
L1_func_8004B06C = func_8004BCBC;
L1_func_8004B084 = func_8004BCD4;
func_8004BD00 = L1_func_8004B0B0;
func_8004BDE4 = L1_func_8004B194;
L1_func_8004B270 = func_8004BEC0;
L1_func_8004B334 = func_8004D48C;
func_8004D514 = L1_func_8004B3BC;
func_8004D6E4 = L1_func_8004B58C;
func_8004DB54 = L1_func_8004B9FC;
func_8004DC58 = L1_func_8004BB00;
func_8004DDC8 = L1_func_8004BC70;
func_8004DF00 = L1_func_8004BDA8;
L1_func_8004BE84 = func_8004E0C4;
L1_func_8004BF70 = func_8004E1B0;
func_8004E440 = L1_func_8004C0C0;
L1_func_8004C368 = func_8004E6E8;
func_8004E818 = L1_func_8004C498;
L1_func_8004C50C = func_8004E88C;
func_8004E8D8 = L1_func_8004C558;
L1_func_8004C5C8 = func_8004E948;
L1_func_8004C698 = func_8004EA18;
L1_func_8004C768 = func_8004EAE8;
L1_func_8004C824 = func_8004EBA4;
func_8004EBAC = L1_func_8004C82C;
func_8004ECC4 = L1_func_8004C944;
func_8004EDDC = L1_func_8004CA5C;
func_8004EEAC = L1_func_8004CB2C;
func_8004F008 = L1_func_8004CBF4;
func_8004F0EC = L1_func_8004CCD8;
func_8004F128 = L1_func_8004CD14;
func_8004F1B4 = L1_func_8004CDA0;
L1_func_8004CE38 = func_8004F24C;
func_8004F288 = L1_func_8004CE74;
func_8004F314 = L1_func_8004CF00;
func_8004F6E4 = L1_func_8004D2D0;
L1_func_8004D5A8 = func_8004F9BC;
func_8004FB40 = L1_func_8004D72C;
func_8004FB84 = L1_func_8004D770;
func_8004FC58 = L1_func_8004D844;
func_8004FCA0 = L1_func_8004D88C;
func_8004FD8C = L1_func_8004D978;
func_8004FE74 = L1_func_8004DA60;
func_8004FFE0 = L1_func_8004DBCC;
func_800501B0 = L1_func_8004DD9C;
func_8005040C = L1_func_8004DFF8;
func_80050490 = L1_func_8004E07C;
func_80050718 = L1_func_8004E304;
func_8005073C = L1_func_8004E328;
L1_func_8004E37C = func_80050790;
L1_func_8004E5D8 = func_800508E8;
L1_func_8004E78C = func_80050A9C;
func_80050AA4 = L1_func_8004E794;
func_80050BAC = L1_func_8004E89C;
func_80050C7C = L1_func_8004E96C;
func_80050CBC = L1_func_8004E9AC;
L1_func_8004EA68 = func_80050D78;
func_80050DC8 = L1_func_8004EAB8;
func_80050E30 = L1_func_8004EB20;
func_80050F80 = L1_func_8004EC70;
func_80051254 = L1_func_8004EF44;
L1_func_8004F134 = func_80051444;
func_80051458 = L1_func_8004F148;
func_80051658 = L1_func_8004F348;
L1_func_8004F3D8 = func_800516E8;
L1_func_8004F3E8 = func_800516F8;
L1_func_8004F880 = func_80051B90;
L1_func_8004FD3C = func_8005204C;
func_80052490 = L1_func_80050180;
func_8005269C = L1_func_8005038C;
L1_func_800503D8 = func_800526E8;
func_80052C70 = L1_func_80050960;
func_80052CAC = L1_func_8005099C;
func_80052CF4 = L1_func_800509E4;
func_80052D20 = L1_func_80050A10;
L1_func_80050A70 = func_80052D80;
func_80053A38 = L1_func_80051728;
func_8005462C = L1_func_800523E4;
func_80054878 = L1_func_80052630;
func_80054A50 = L1_func_80052808;
func_80054D74 = L1_func_80052B2C;
L1_func_80052BEC = func_80054E34;
func_80055098 = L1_func_80053004;
func_80055114 = L1_func_80053080;
func_800556CC = L1_func_80053684;
L1_func_80053790 = func_800557D8;
func_8005585C = L1_func_8005397C;
func_8005590C = L1_func_80053A2C;
func_8005595C = L1_func_80053A7C;
func_80055A44 = L1_func_80053B64;
L1_func_80053BD0 = func_80055AB0;
func_80055AC0 = L1_func_80053BE0;
func_80055CC4 = L1_func_80053DE4;
func_80055DB8 = L1_func_80053ED8;
func_80056038 = L1_func_80054098;
func_8005606C = L1_func_800540CC;
func_800560B8 = L1_func_80054118;
func_8005610C = L1_func_8005416C;
func_80056208 = L1_func_80054268;
func_800562AC = L1_func_8005430C;
func_8005635C = L1_func_800543BC;
L1_func_80054414 = func_800563B4;
func_80056674 = L1_func_80054604;
func_8005670C = L1_func_8005469C;
func_80056834 = L1_func_800547C4;
func_800568AC = L1_func_8005483C;
func_800569D4 = L1_func_80054964;
func_80056B38 = L1_func_80054AC8;
func_80056C68 = L1_func_80054BF8;
func_80056E14 = L1_func_80054DA4;
func_80056EA8 = L1_func_80054E38;
func_80056FA4 = L1_func_80054F34;
func_8005704C = L1_func_80054FDC;
func_800570D0 = L1_func_80055060;
func_800571DC = L1_func_8005516C;
func_80057274 = L1_func_80055204;
func_8005730C = L1_func_8005529C;
func_8005736C = L1_func_800552FC;
func_800573CC = L1_func_8005535C;
func_80057430 = L1_func_800553C0;
func_80057580 = L1_func_80055510;
func_80057608 = L1_func_80055598;
func_800576E0 = L1_func_80055670;
func_80057838 = L1_func_800557C8;
L1_func_800557F4 = func_80057864;
func_80057884 = L1_func_80055814;
L1_func_80055878 = func_800578E8;
L1_func_80055BA8 = func_80057C18;
func_80057E94 = L1_func_80055E24;
func_80057FC8 = L1_func_80055F58;
func_800580C4 = L1_func_80056054;
func_80058180 = L1_func_80056110;
L1_func_80056154 = func_800581C4;
func_800583C8 = L1_func_80056358;
func_8005842C = L1_func_800563BC;
func_800584B4 = L1_func_80056444;
func_8005851C = L1_func_800564AC;
func_800585A8 = L1_func_80056538;
func_800585E0 = L1_func_80056570;
func_8005864C = L1_func_800565DC;
func_80058684 = L1_func_80056614;
func_80058768 = L1_func_800566F8;
func_800588AC = L1_func_8005683C;
func_80058904 = L1_func_80056894;
func_80058D8C = L1_func_80056D1C;
func_80059000 = L1_func_80056F90;
func_800590E4 = L1_func_80057074;
func_80059168 = L1_func_800570F8;
func_80059204 = L1_func_80057194;
func_80059228 = L1_func_800571B8;
L1_func_800572F4 = func_80059364;
func_80059414 = L1_func_800573A4;
func_80059480 = L1_func_80057410;
func_800594AC = L1_func_8005743C;
func_800594EC = L1_func_8005747C;
func_8005966C = L1_func_800575FC;
L1_func_80057648 = func_800596B8;
L1_func_80057750 = func_800597C0;
func_80059B20 = L1_func_80057AB0;
L1_func_80057AD8 = func_80059B48;
func_80059B9C = L1_func_80057B2C;
L1_func_80057B94 = func_80059C04;
L1_func_80057BFC = func_80059C6C;
func_80059CB0 = L1_func_80057C40;
L1_func_80057E80 = func_80059EF0;
L1_func_80058694 = func_8005A704;
func_8005A8CC = L1_func_8005885C;
func_8005AAC8 = L1_func_80058A58;
func_8005AB80 = L1_func_80058B10;
func_8005ABDC = L1_func_80058B6C;
func_8005AD70 = L1_func_80058D00;
func_8005ADCC = L1_func_80058D5C;
func_8005AE6C = L1_func_8005AD6C;
L1_func_8005ADB0 = func_8005AEB0;
L1_func_8005ADD4 = func_8005AED4;
L1_func_8005AEF8 = func_8005AFF8;
func_8005B608 = L1_func_8005B508;
func_8005B684 = L1_func_8005B584;
func_8005B6AC = L1_func_8005B5AC;
func_8005B7CC = L1_func_8005B6CC;
func_8005B86C = L1_func_8005B76C;
func_8005B8BC = L1_func_8005B7BC;
func_8005B96C = L1_func_8005B86C;
func_8005BA6C = L1_func_8005B96C;
func_8005BB30 = L1_func_8005BA30;
func_8005BBE8 = L1_func_8005BAE8;
func_8005BD80 = L1_func_8005BC80;
func_8005BFF0 = L1_func_8005BEF0;
func_8005C20C = L1_func_8005C10C;
L1_func_8005C214 = func_8005C314;
func_8005C43C = L1_func_8005C33C;
L1_func_8005C864 = func_8005C964;
L1_func_8005C894 = func_8005C994;
func_8005C9C4 = L1_func_8005C8C4;
func_8005CB20 = L1_func_8005CA20;
L1_func_8005CB38 = func_8005CC38;
func_8005CF10 = L1_func_8005CED0;
L1_func_8005CFC8 = func_8005D008;
func_8005D2F0 = L1_func_8005D2B0;
L1_func_8005D58C = func_8005D5CC;
func_8005D604 = L1_func_8005D5C4;
func_8005D670 = L1_func_8005D630;
L1_func_8005D654 = func_8005D694;
func_8005D6D4 = L1_func_8005D694;
func_8005D7A0 = L1_func_8005D760;
L1_func_8005DA90 = func_8005DAD0;
L1_func_8005DB7C = func_8005DBBC;
func_8005DC80 = L1_func_8005DC40;
L1_func_8005DF40 = func_8005DF80;
func_8005DFBC = L1_func_8005DF7C;
func_8005E060 = L1_func_8005E020;
func_8005E268 = L1_func_8005E228;
L1_func_8005E424 = func_8005E464;
func_8005EB1C = L1_func_8005EADC;
func_8005EBAC = L1_func_8005EB6C;
func_8005ECC4 = L1_func_8005EC84;
func_8005EE38 = L1_func_8005EE6C;
L1_func_8005F3B0 = func_8005F374;
func_8005F8AC = L1_func_8005F93C;
func_8005FA18 = L1_func_8005FAA8;
L1_func_80060094 = func_8005FFF4;
func_8006039C = L1_func_8006043C;
func_80060594 = L1_func_800604B0;
L1_func_8006060C = func_800606F0;
func_800606F8 = L1_func_80060614;
func_8006087C = L1_func_80060798;
func_800609C8 = L1_func_800608E4;
func_80060BA4 = L1_func_80060AC0;
L1_func_80060E28 = func_80060EE0;
L1_func_80061018 = func_80061084;
L1_func_80061068 = func_8006114C;
func_800616AC = L1_func_800615C8;
L1_func_80061700 = func_800617E4;
func_800617EC = L1_func_80061708;
L1_func_80061DC0 = func_80061E1C;
func_80061EF0 = L1_func_80061EC4;
L1_func_80061F38 = func_80061F64;
L1_func_80061FB4 = func_80061FE0;
func_800622F4 = L1_func_80062300;
func_80062388 = L1_func_80062394;
func_80062778 = L1_func_80062784;
func_80062B5C = L1_func_80062B68;
func_80062F2C = L1_func_80062F38;
L1_func_80062FAC = func_80062FA0;
func_80063224 = L1_func_800632AC;
func_80063328 = L1_func_800633B0;
func_80063438 = L1_func_800634C0;
func_80063630 = L1_func_800636B8;
func_80063728 = L1_func_800637B0;
L1_func_80063858 = func_800637D0;
L1_func_80063ADC = func_80063A54;
func_80063A98 = L1_func_80063B20;
func_80063C24 = L1_func_80063CAC;
func_80063CB8 = L1_func_80063D40;
L1_func_80063ED4 = func_80063E4C;
L1_func_80063EF8 = func_80063E70;
func_80063EAC = L1_func_80063F34;
func_80063EFC = L1_func_80063F84;
func_800640A4 = L1_func_8006412C;
func_800640F4 = L1_func_8006417C;
func_80064194 = L1_func_8006439C;
func_800642D4 = L1_func_800644DC;
func_80064414 = L1_func_8006461C;
func_80064458 = L1_func_80064660;
func_80064644 = L1_func_8006484C;
func_80064808 = L1_func_80064A10;
func_80064A20 = L1_func_80064C28;
L1_func_80064E40 = func_80064C38;
func_80064EAC = L1_func_80065510;
L1_func_80065588 = func_80064F24;
func_80064F54 = L1_func_800655B8;
func_80064FB0 = L1_func_80065614;
L1_func_800658B4 = func_80065250;
func_800652C4 = L1_func_80065928;
L1_func_80065A20 = func_800653BC;
func_80065A34 = L1_func_80066098;
func_80065C44 = L1_func_800662A8;
func_80065E54 = L1_func_800664B8;
func_800660A0 = L1_func_80066704;
L1_func_8006692C = func_800662C8;
L1_func_80066968 = func_80066304;
func_80066340 = L1_func_800669A4;
L1_func_80066A60 = func_800663FC;
L1_func_80066B14 = func_800664B0;
L1_func_80067F18 = func_800687BC;
L1_func_80069318 = func_80069DD8;
L1_func_80069328 = func_80069DE8;
L1_func_800693DC = func_80069EBC;
L1_func_8006981C = func_8006BDB4;
L1_func_80069850 = func_8006BE78;
L1_func_800698B8 = func_8006BF24;
L1_func_8006B1DC = func_8006E97C;
L1_func_8006B230 = func_8006E9D0;
func_8006EA14 = L1_func_8006B274;
L1_func_8006B2C4 = func_8006EA64;
func_8006FC34 = L1_func_8006C494;
func_80070094 = L1_func_8006C8F4;
L1_func_8006CB88 = func_80070328;
L1_func_8006CEA4 = func_80070644;
func_80070B60 = L1_func_8006D3C0;
L1_func_8006D470 = func_80070C10;
func_800714C0 = L1_func_8006DD20;
L1_func_8006E054 = func_800717F4;
func_80071DC0 = L1_func_8006E620;
func_80072180 = L1_func_8006E9E0;
func_8007245C = L1_func_8006ECBC;
func_80072648 = L1_func_8006EEA8;
func_800727D4 = L1_func_8006F034;
L1_func_8006F168 = func_80072908;
func_80072E4C = L1_func_8006F6AC;
L1_func_8006F784 = func_80072F24;
func_80073144 = L1_func_8006F9A4;
func_800731F4 = L1_func_8006FA54;
func_800732A4 = L1_func_8006FB04;
func_80073674 = L1_func_8006FED4;
func_80073810 = L1_func_80070070;
func_80073A6C = L1_func_800702CC;
func_80073D48 = L1_func_800705A8;
func_80073E90 = L1_func_800706F0;
func_80074DD8 = L1_func_80071638;
L1_func_80072190 = func_80075930;
func_80075BAC = L1_func_8007240C;
L1_func_800726D0 = func_80075E70;
func_800764E8 = L1_func_80072D48;
func_800765C8 = L1_func_80072E28;
L1_func_8007369C = func_80076E3C;
func_80077B88 = L1_func_800743E8;
L1_func_800746D0 = func_80077E70;
func_80078788 = L1_func_80074FE8;
func_80078A60 = L1_func_800752C0;
L1_func_800752E8 = func_80078A88;
L1_func_800753A4 = func_80078B44;
L1_func_800753F0 = func_80078B90;
func_80078BFC = L1_func_8007545C;
func_80078D5C = L1_func_800755BC;
func_80078E1C = L1_func_8007567C;
func_80078F60 = L1_func_800757C0;
L1_func_800758C0 = func_80079060;
func_80079090 = L1_func_800758F0;
func_800790C0 = L1_func_80075920;
func_800794E8 = L1_func_80075D48;
func_8007963C = L1_func_80075E9C;
func_800796C0 = L1_func_80075F20;
L1_func_80075FA0 = func_80079740;
L1_func_80075FE4 = func_80079784;
func_800797B4 = L1_func_80076014;
L1_func_800760B4 = func_80079854;
func_800798A4 = L1_func_80076104;
func_80079924 = L1_func_80076184;
L1_func_80076A8C = func_8007A190;
L1_func_80077764 = func_8007AF00;
L1_func_800779FC = func_8007B198;
L1_func_80077CCC = func_8007B468;
L1_func_80077D50 = func_8007B4EC;
L1_func_80077FC4 = func_8007B760;
L1_func_800781B4 = func_8007B950;
L1_func_80078534 = func_8007BCD0;
L1_func_800785A8 = func_8007BD44;
L1_func_800787FC = func_8007BF98;
L1_func_80078840 = func_8007BFDC;
L1_func_800788E0 = func_8007C07C;
L1_func_800792B8 = func_8007D2EC;
L1_func_80079390 = func_8007D3C4;
L1_func_800793EC = func_8007D544;
L1_func_800794A0 = func_8007D5F8;
L1_func_800794D4 = func_8007D62C;
L1_func_80079588 = func_8007D6E0;
L1_func_800797A8 = func_8007D900;
L1_func_8007980C = func_8007D950;
L1_func_800798A8 = func_8007DA18;
L1_func_800798D4 = func_8007DA44;
L1_func_80079B94 = func_8007DD04;
L1_func_80079C04 = func_8007DD74;
L1_func_80079C54 = func_8007DDC4;
L1_func_80079D84 = func_8007DEF4;
L1_func_80079DB8 = func_8007DF40;
L1_func_80079E10 = func_8007DF98;
L1_func_80079F84 = func_8007E10C;
L1_func_8007A040 = func_8007E200;
L1_func_8007A17C = func_8007E33C;
L1_func_8007A1B0 = func_8007E370;
L1_func_8007A4E4 = func_8007E68C;
L1_func_8007A554 = func_8007E6FC;
L1_func_8007A580 = func_8007E728;
L1_func_8007A614 = func_8007E7BC;
L1_func_8007A694 = func_8007E83C;
L1_func_8007AA94 = func_8007EC3C;
L1_func_8007AC7C = func_8007EE24;
L1_func_8007CE30 = func_80080FD8;
L1_func_8007D184 = func_8008132C;
L1_func_8007D1E8 = func_80081390;
L1_func_8007D260 = func_80081408;
L1_func_8007D2B4 = func_8008145C;
L1_func_8007D914 = func_80081ABC;
L1_func_8007DA88 = func_80081C30;
L1_func_8007DE50 = func_80081FF8;
L1_func_8007E610 = func_800827B8;
L1_func_8007E6A4 = func_8008284C;
L1_func_8007EB7C = func_80082D24;
L1_func_8007EC78 = func_80082E20;
L1_func_8007ED98 = func_80082F40;
L1_func_8007EE34 = func_80082FDC;
L1_func_8007EE64 = func_8008300C;
L1_func_8007EEBC = func_80083064;
L1_func_8007EECC = func_80083074;
L1_func_8007F040 = func_800831E8;
L1_func_8007F0D8 = func_80083280;
L1_func_8007F140 = func_800832E8;
L1_func_8007F25C = func_80083404;
L1_func_8007F2EC = func_80083494;
L1_func_8007F34C = func_800834F4;
L1_func_8007F414 = func_800835BC;
L1_func_8007F4C0 = func_80083668;
L1_func_8007F530 = func_800836D8;
L1_func_8007F5F0 = func_80083798;
L1_func_8007FAE8 = func_80083C90;
L1_func_8007FCE0 = func_80083E88;
L1_func_8007FF50 = func_800840F8;
L1_func_8007FF70 = func_80084118;
L1_func_80080008 = func_800841B0;
L1_func_800800A0 = func_80084248;
L1_func_800800BC = func_80084264;
L1_func_8008013C = func_800842E4;
L1_func_80080154 = func_800842FC;
L1_func_80080234 = func_800843DC;
L1_func_80080464 = func_8008460C;
L1_func_800806A0 = func_80084848;
L1_func_80080920 = func_80084AC8;
L1_func_80080944 = func_80084AEC;
L1_func_80080958 = func_80084B00;
L1_func_80080998 = func_80084B40;
L1_func_800809E0 = func_80084B88;
L1_func_80080A10 = func_80084BB8;
L1_func_80080A34 = func_80084BDC;
L1_func_80080CE4 = func_80084E8C;
L1_func_80080F44 = func_800850EC;
L1_func_80081094 = func_8008523C;
L1_func_800811D0 = func_80085378;
L1_func_80081204 = func_800853AC;
L1_func_80081348 = func_800854F0;
L1_func_800813E8 = func_80085590;
L1_func_80081410 = func_800855B8;
L1_func_80081448 = func_800855F0;
L1_func_80081458 = func_80085600;
L1_func_800814CC = func_80085674;
L1_func_800815A0 = func_80085748;
L1_func_80081A08 = func_80085BB0;
L1_func_80081B74 = func_80085D1C;
L1_func_80081C54 = func_80085DFC;
L1_func_80081C84 = func_80085E2C;
L1_func_80081CE4 = func_80085E8C;
L1_func_80081D14 = func_80085EBC;
L1_func_80082638 = func_800867E0;
L1_func_800828AC = func_80086A54;
L1_func_8008297C = func_80086B24;
L1_func_80082B64 = func_80086D0C;
L1_func_80082D00 = func_80086EA8;
L1_func_80082E04 = func_80086FAC;
L1_func_80082ED8 = func_80087080;
L1_func_80082EE8 = func_80087090;
L1_func_80082EF8 = func_800870A0;
L1_func_80082F04 = func_800870AC;
L1_func_80082F24 = func_800870CC;
L1_func_80082F44 = func_800870EC;
L1_func_80082F64 = func_8008710C;
L1_func_80082F78 = func_80087120;
L1_func_80082F8C = func_80087134;
L1_func_800830C8 = func_80087270;
L1_func_800831FC = func_800873A4;
L1_func_80083348 = func_800874F0;
L1_func_80083368 = func_80087510;
L1_func_80083388 = func_80087530;
L1_func_800833AC = func_80087554;
L1_func_800833CC = func_80087574;
L1_func_800834D0 = func_80087678;
L1_func_80083F14 = func_800880BC;
L1_func_80084134 = func_800882DC;
L1_func_80084164 = func_8008830C;
L1_func_80084194 = func_8008833C;
L1_func_800841C4 = func_8008836C;
L1_func_800841F8 = func_800883A0;
L1_func_80084228 = func_800883D0;
L1_func_80084238 = func_800883E0;
L1_func_80084250 = func_800883F8;
L1_func_80084328 = func_800884D0;
L1_func_800844F8 = func_800886A0;
L1_func_80084640 = func_800887E8;
L1_func_800846E0 = func_80088888;
L1_func_80084758 = func_80088900;
L1_func_80084E0C = func_80088FB4;
L1_func_800855BC = func_80089764;
L1_func_8008571C = func_800898C4;
L1_func_8008596C = func_80089B14;
L1_func_800859B8 = func_80089B60;
L1_func_80085B5C = func_80089D04;
L1_func_80085BD0 = func_80089D78;
L1_func_800865BC = func_8008A764;
L1_func_80086688 = func_8008A830;
L1_func_80086780 = func_8008A928;
L1_func_80086854 = func_8008A9FC;
L1_func_8008688C = func_8008AA34;
L1_func_800868D4 = func_8008AA7C;
L1_func_80086928 = func_8008AAD0;
L1_func_80086A40 = func_8008ABE8;
L1_func_80086A6C = func_8008AC14;
L1_func_80086AD4 = func_8008AC7C;
L1_func_80086C64 = func_8008AE0C;
L1_func_80086D30 = func_8008AED8;
L1_func_80086D74 = func_8008AF1C;
L1_func_800870A8 = func_8008B250;
L1_func_80087198 = func_8008B340;
L1_func_800873A8 = func_8008B550;
L1_func_80087620 = func_8008B7C8;
L1_func_800876B0 = func_8008B858;
L1_func_800876E4 = func_8008B88C;
L1_func_80088C44 = func_8008CDEC;
L1_func_8008A404 = func_8008E5AC;
L1_func_8008A904 = func_8008EAAC;
L1_func_8008C5A4 = func_8009075C;
L1_func_8008C5C4 = func_8009077C;
L1_func_8008C5D8 = func_80090790;
L1_func_8008C638 = func_800907F0;
L1_func_8008CCB8 = func_80090C70;
L1_func_8008D2EC = func_800912A4;
L1_func_8008DAAC = func_80091A64;
L1_func_8008DB68 = func_80091B20;
L1_func_8008DBDC = func_80091B94;
L1_func_8008E03C = func_80092284;
L1_func_8008E378 = func_800925C0;
L1_func_8008FAE8 = func_80093D20;
L1_func_80090004 = func_8009423C;
L1_func_80090164 = func_8009439C;
L1_func_80090880 = func_80094AB8;
L1_func_80090B00 = func_80094D38;
L1_func_80090CC0 = func_80094EF8;
L1_func_80090D7C = func_80094FB4;
L1_func_80090FFC = func_80095234;
L1_func_80091080 = func_800952B8;
L1_func_800910C4 = func_800952FC;
L1_func_80091168 = func_800953A0;
L1_func_800911C0 = func_800953F8;
L1_func_800911E8 = func_80095420;
L1_func_80091210 = func_80095448;
L1_func_80091450 = func_80095688;
L1_func_80091480 = func_800956B8;
L1_func_800919DC = func_80095C14;
L1_func_80091C5C = func_80095E94;
L1_func_80091F24 = func_8009615C;
L1_func_80092330 = func_80096568;
L1_func_80092404 = func_8009663C;
L1_func_800924F4 = func_8009672C;
L1_func_800926D4 = func_8009690C;
L1_func_8009283C = func_80096A74;
L1_func_8009293C = func_80096B74;
L1_func_80092A34 = func_80096C6C;
L1_func_80092F24 = func_8009715C;
L1_func_80092F5C = func_80097194;
L1_func_8009302C = func_80097264;
L1_func_80093C64 = func_80097E9C;
L1_func_80093E24 = func_8009805C;
L1_func_80093F24 = func_8009815C;
L1_func_80093F4C = func_80098184;
L1_func_80094434 = func_8009866C;
L1_func_80094440 = func_80098678;
L1_func_800944C4 = func_800986FC;
L1_func_80094734 = func_8009896C;
L1_func_8009476C = func_800989A4;
L1_func_80094840 = func_80098A78;
L1_func_800948E8 = func_80098B20;
L1_func_80094CE0 = func_80098F18;
L1_func_80094D48 = func_80098F80;
L1_func_80094D64 = func_80098F9C;
L1_func_80094E2C = func_80099064;
L1_func_80094EC4 = func_800990FC;
L1_func_80094F18 = func_80099150;
L1_func_80094F78 = func_800991B0;
L1_func_80094F98 = func_800991D0;
L1_func_80094FAC = func_800991E4;
L1_func_80094FCC = func_80099204;
L1_func_80094FEC = func_80099224;
L1_func_8009500C = func_80099244;
L1_func_80095104 = func_8009933C;
L1_func_800957F0 = func_80099A28;
L1_func_80095914 = func_80099B4C;
L1_func_80095934 = func_80099B6C;
L1_func_80095954 = func_80099B8C;
L1_func_80095A44 = func_80099C7C;
L1_func_80095A64 = func_80099C9C;
L1_func_80095D7C = func_80099FB4;
L1_func_80095ECC = func_8009A104;
L1_func_80096270 = func_8009A4A8;
L1_func_800963C4 = func_8009A5FC;
L1_func_80096738 = func_8009A970;
L1_func_800967BC = func_8009A9F4;
L1_func_80096BC0 = func_8009ADF8;
L1_func_80096C54 = func_8009AE8C;
L1_func_80096C9C = func_8009AED4;
L1_func_80096F50 = func_8009B188;
L1_func_80099EB0 = func_8009E0E8;
L1_func_8009A0A0 = func_8009E2D8;
L1_func_8009A1F0 = func_8009E428;
L1_func_8009A3B0 = func_8009E5E8;
L1_func_8009A9E0 = func_8009EC18;
L1_func_8009AB60 = func_8009ED98;
L1_func_8009B940 = func_8009FB78;
L1_func_8009BEAC = func_800A00E4;
L1_func_8009BF10 = func_800A0148;
L1_func_8009BFC0 = func_800A01F8;
L1_func_800AACFC = func_800B0714;
L1_func_800AAEF8 = func_800B0910;
L1_gPsi = D_800B6030;
L1_g_Args = D_800B6010;
L1_g_CamPosX = D_800B60C0;
L1_g_CamPosY = D_800B60C4;
L1_g_CamRotX = D_800B6088;
L1_g_CamTargetX = D_800B607C;
L1_g_Camera = D_800B6078;
L1_g_CheatCodeProgress = D_800B6FFC;
L1_g_CheatCodes = D_800A0EF4;
L1_g_CutScene = D_800A0F34;
L1_g_DebugPageNames = D_800A1088;
L1_g_DebugTextX = D_800A125C;
L1_g_DebugTextY = D_800A125E;
L1_g_DevMenu = D_800D5750;
L1_g_FrameCap = D_800B6F80;
L1_g_FrameRate = D_800A0FE4;
L1_g_GodMode = D_800A0F72;
L1_g_Invincible = D_800A0CC0;
L1_g_MenuUpdateFunc = D_800D6B48;
L1_g_PadAxes = D_800B7340;
L1_g_PadAxesPrev = D_800B7344;
L1_g_PadHeld = D_800B7328;
L1_g_PadPressed = D_800B7330;
L1_g_PadPrev = D_800B7334;
L1_g_Player = D_800B6FE4;
L1_g_Projection = D_800B6124;
L1_g_Weapons = D_800B6138;
L1_gteMIMefunc = func_8009063C;
L1_gte_rotate_z_matrix = func_8009729C;
L1_jtbl_800A6F68 = jtbl_800AC544;
L1_jtbl_800A7168 = jtbl_800AC744;
L1_jtbl_800A74B0 = jtbl_800ACA8C;
L1_jtbl_800A7764 = jtbl_800ACD40;
L1_jtbl_800A7ED8 = jtbl_800AD518;
L1_jtbl_800A8028 = jtbl_800AD668;
L1_jtbl_800A8088 = jtbl_800AD6C8;
L1_jtbl_800A859C = jtbl_800ADBDC;
L1_jtbl_800A8AC0 = jtbl_800AE150;
L1_jtbl_800A8B20 = jtbl_800AE1B0;
L1_jtbl_800A8BE8 = jtbl_800AE278;
L1_jtbl_800A98E4 = jtbl_800AF2C0;
L1_jtbl_800A9AEC = jtbl_800AF500;
L1_jtbl_800A9DF8 = jtbl_800AF80C;
L1_jtbl_800AA190 = jtbl_800AFBA4;
L1_jtbl_800AA1F0 = jtbl_800AFC04;
L1_jtbl_800AA270 = jtbl_800AFC84;
L1_jtbl_800AA2A8 = jtbl_800AFCBC;
L1_jtbl_800AA330 = jtbl_800AFD44;
L1_jtbl_800AA540 = jtbl_800AFF54;
L1_jtbl_800AA560 = jtbl_800AFF74;
L1_jtbl_800AA780 = jtbl_800B0194;
L1_jtbl_800AA860 = jtbl_800B0274;
L1_jtbl_800AA880 = jtbl_800B0294;
L1_malloc3 = func_8008FADC;
L1_memchr = func_8008FD9C;
L1_memcpy = func_8009062C;
L1_memmove = func_80095610;
L1_memset = func_8009061C;
L1_note2pitch = func_800935B0;
L1_note2pitch2 = func_800935FC;
L1_printf = func_80083044;
L1_rand = func_80085C3C;
L1_ratan2 = func_8009019C;
L1_rcos = func_8009E478;
L1_rsin = func_8009E518;
L1_setRC2wait = func_8009927C;
L1_setjmp = func_80096E94;
L1_sin_1 = func_8009E554;
L1_sprintf = func_80085F1C;
L1_start = func_8002C9D0;
L1_startIntrDMA = func_80096EB4;
L1_startIntrVSync = func_80096D54;
L1_strcat = func_80088088;
L1_strcmp = func_8008FDDC;
L1_strcpy = func_80085E4C;
L1_strlen = func_80085E1C;
L1_strncmp = func_80096D44;
L1_strncpy = func_80092830;
L1_strstr = func_8008FF1C;
L1_strtok = func_8008FDEC;
L1_strtol = func_8008FF0C;
L1_toupper = func_80085D0C;
L1_vmNoiseOff = func_800946F8;
L1_vmNoiseOn = func_80093040;
D_1F8003D4 = 0x1F8003D4;
D_1F8003D8 = 0x1F8003D8;
D_1F8003DC = 0x1F8003DC;
L1_D_800AB540_b = L1_D_800AB540;
L1_D_800AB540_c = L1_D_800AB540;
L1_D_8009CE24 = L1_D_8009CE20 + 4;
