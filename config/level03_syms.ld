/* Generated by tools/port_level.py: LEVEL01 names (L1_ prefix) bound to level03's symbols. */
L1_AddPrim = func_8008B318;
L1_ApplyBonusCheats = func_8002DFC0;
L1_ApplyMatrix = func_8008DFF8;
L1_ApplyMatrixLV = func_8007C2E8;
L1_ApplyMatrixSV = func_800900EC;
L1_Args_GetFlag115 = func_8002E168;
L1_CALLOC3_OBJ_54 = func_8008D4DC;
func_8004FEA8 = L1_Camera_ResetZoom;
func_8002C26C = L1_CdBin_Disable;
func_8002C2B0 = L1_CdBin_Enable;
func_8002C3CC = L1_CdBin_SetLevel;
L1_CdInit = func_800875E0;
L1_CdSearchFile = func_80085144;
L1_ChangeClearPAD = func_80094810;
L1_ChangeClearRCnt = func_80094820;
func_8002DC38 = L1_Cheat_CheckCodes;
L1_Cheat_DoAction = func_8002D9AC;
L1_Cheat_ResetCodes = func_8002E110;
L1_CloseEvent = func_8008300C;
L1_D_80082604 = func_800841D8;
L1_D_80095808 = D_800973DC;
L1_D_8009C180 = D_8009DD54;
L1_D_8009C184 = D_8009DD58;
L1_D_8009C1EC = D_8009DDC0;
L1_D_8009C1ED = D_8009DDC1;
L1_D_8009C1EE = D_8009DDC2;
L1_D_8009C1F0 = D_8009DDC4;
L1_D_8009C1F4 = D_8009DDC8;
L1_D_8009C1F8 = D_8009DDCC;
L1_D_8009C200 = D_8009DDD4;
L1_D_8009C204 = D_8009DDD8;
L1_D_8009C208 = D_8009DDDC;
L1_D_8009C20A = D_8009DDDE;
L1_D_8009C20C = D_8009DDE0;
L1_D_8009CA56 = D_8009E62A;
L1_D_8009CA58 = D_8009E62C;
L1_D_8009CA59 = D_8009E62D;
L1_D_8009CA5A = D_8009E62E;
L1_D_8009CA5C = D_8009E630;
L1_D_8009CA5E = D_8009E632;
L1_D_8009CA60 = D_8009E634;
L1_D_8009CA64 = D_8009E638;
L1_D_8009CA68 = D_8009E63C;
L1_D_8009CA70 = D_8009E644;
L1_D_8009CA74 = D_8009E648;
L1_D_8009CA78 = D_8009E64C;
L1_D_8009CA7C = D_8009E650;
L1_D_8009CA80 = D_8009E654;
L1_D_8009CA84 = D_8009E658;
L1_D_8009CA8C = D_8009E660;
L1_D_8009CA90 = D_8009E664;
L1_D_8009CA94 = D_8009E668;
L1_D_8009CA98 = D_8009E66C;
L1_D_8009CA9C = D_8009E670;
L1_D_8009CAA0 = D_8009E674;
L1_D_8009CAA4 = D_8009E678;
L1_D_8009CAA8 = D_8009E67C;
L1_D_8009CAAC = D_8009E680;
L1_D_8009CABD = D_8009E691;
L1_D_8009CABE = D_8009E692;
L1_D_8009CABF = D_8009E693;
L1_D_8009CAC0 = D_8009E694;
L1_D_8009CAC4 = D_8009E698;
L1_D_8009CACC = D_8009E6A0;
L1_D_8009CAD0 = D_8009E6A4;
L1_D_8009CD00 = D_8009E8D4;
L1_D_8009CD30 = D_8009E908;
L1_D_8009CD3C = D_8009E914;
L1_D_8009CD4C = D_8009E924;
L1_D_8009CD50 = D_8009E928;
L1_D_8009CD54 = D_8009E92C;
L1_D_8009CD58 = D_8009E930;
L1_D_8009CD5C = D_8009E934;
L1_D_8009CD5E = D_8009E936;
L1_D_8009CD60 = D_8009E938;
L1_D_8009CD62 = D_8009E93A;
L1_D_8009CD6C = D_8009E944;
L1_D_8009CD6E = D_8009E946;
L1_D_8009CD78 = D_8009E950;
L1_D_8009CD80 = D_8009E958;
L1_D_8009CD88 = D_8009E960;
L1_D_8009CD8C = D_8009E964;
L1_D_8009CD98 = D_8009E970;
L1_D_8009CDA0 = D_8009E978;
L1_D_8009CDA2 = D_8009E97A;
L1_D_8009CDA8 = D_8009E980;
L1_D_8009CDD0 = D_8009E9A8;
L1_D_8009CDDC = D_8009E9B4;
L1_D_8009CDE4 = D_8009E9BC;
L1_D_8009CDE5 = D_8009E9BD;
L1_D_8009CDE6 = D_8009E9BE;
L1_D_8009CDE7 = D_8009E9BF;
L1_D_8009CDE8 = D_8009E9C0;
L1_D_8009CDEC = D_8009E9C4;
L1_D_8009CDF0 = D_8009E9C8;
L1_D_8009CE20 = D_8009E9F8;
L1_D_8009CE28 = D_8009EA00;
L1_D_8009CE38 = D_8009EA10;
L1_D_8009CE3C = D_8009EA14;
L1_D_8009CE48 = D_8009EA20;
L1_D_8009CEB0 = D_8009EA88;
L1_D_8009CEE0 = D_8009EAB8;
L1_D_8009CF10 = D_8009EAE8;
L1_D_8009CF14 = D_8009EAEC;
L1_D_8009CF2C = D_8009EB04;
L1_D_8009CF30 = D_8009EB08;
L1_D_8009CF34 = D_8009EB0C;
L1_D_8009CF48 = D_8009EB20;
L1_D_8009CF4C = D_8009EB24;
L1_D_8009CF50 = D_8009EB28;
L1_D_8009CF54 = D_8009EB2C;
L1_D_8009CF68 = D_8009EB3C;
L1_D_8009CF6C = D_8009EB40;
L1_D_8009CF70 = D_8009EB44;
L1_D_8009CF74 = D_8009EB48;
L1_D_8009CF7C = D_8009EB50;
L1_D_8009CF80 = D_8009EB54;
L1_D_8009CF8C = D_8009EB60;
L1_D_8009CF90 = D_8009EB64;
L1_D_8009CF94 = D_8009EB68;
L1_D_8009CF98 = D_8009EB6C;
L1_D_8009CF9C = D_8009EB70;
L1_D_8009CFA8 = D_8009EB7C;
L1_D_8009CFB0 = D_8009EB84;
L1_D_8009CFB4 = D_8009EB88;
L1_D_8009CFBB = D_8009EB8F;
L1_D_8009CFBE = D_8009EB92;
L1_D_8009CFC0 = D_8009EB94;
L1_D_8009CFC4 = D_8009EB98;
L1_D_8009CFC8 = D_8009EB9C;
L1_D_8009CFCC = D_8009EBA0;
L1_D_8009CFE4 = D_8009EBB8;
L1_D_8009CFE8 = D_8009EBBC;
L1_D_8009CFEC = D_8009EBC0;
L1_D_8009CFF0 = D_8009EBC4;
L1_D_8009CFF6 = D_8009EBCA;
L1_D_8009CFF8 = D_8009EBCC;
L1_D_8009CFFC = D_8009EBD0;
L1_D_8009D000 = D_8009EBD4;
L1_D_8009D002 = D_8009EBD6;
L1_D_8009D004 = D_8009EBD8;
L1_D_8009D008 = D_8009EBDC;
L1_D_8009D00C = D_8009EBE0;
L1_D_8009D00E = D_8009EBE2;
L1_D_8009D010 = D_8009EBE4;
L1_D_8009D014 = D_8009EBE8;
L1_D_8009D018 = D_8009EBEC;
L1_D_8009D01A = D_8009EBEE;
L1_D_8009D020 = D_8009EBF4;
L1_D_8009D038 = D_8009EC0C;
L1_D_8009D03C = D_8009EC10;
L1_D_8009D040 = D_8009EC14;
L1_D_8009D084 = D_8009EC58;
L1_D_8009D088 = D_8009EC5C;
L1_D_8009D09C = D_8009EC70;
L1_D_8009D0FC = D_8009ECD0;
L1_D_8009D104 = D_8009ECD8;
L1_D_8009D106 = D_8009ECDA;
L1_D_8009D108 = D_8009ECDC;
L1_D_8009D10A = D_8009ECDE;
L1_D_8009D10C = D_8009ECE0;
L1_D_8009D124 = D_8009ECF8;
L1_D_8009D130 = D_8009ED04;
L1_D_8009D26C = D_8009EE44;
L1_D_8009D270 = D_8009EE50;
L1_D_8009D274 = D_8009EE58;
L1_D_8009D280 = D_8009EF18;
L1_D_8009D2A8 = D_8009EE48;
L1_D_8009D2AC = D_8009EE54;
L1_D_8009D2B0 = D_8009EE5C;
L1_D_8009D35C = D_8009F068;
L1_D_8009D368 = D_8009F074;
L1_D_8009D36C = D_8009F078;
L1_D_8009D374 = D_8009F080;
L1_D_8009D384 = D_8009F090;
L1_D_8009D394 = D_8009F0A0;
L1_D_8009D3A4 = D_8009F0B0;
L1_D_8009D3A8 = D_8009F0B4;
L1_D_8009D3AC = D_8009F0B8;
L1_D_8009D3B0 = D_8009F0BC;
L1_D_8009D3BC = D_8009F0C8;
L1_D_8009D3F0 = D_8009F0FC;
L1_D_8009D3F4 = D_8009F100;
L1_D_8009D3F8 = D_8009F104;
L1_D_8009D3FC = D_8009F108;
L1_D_8009D444 = D_8009F150;
L1_D_8009D5A8 = D_8009F2F4;
L1_D_8009D5AC = D_8009F2F8;
L1_D_8009D5F8 = D_8009F35C;
L1_D_8009D5FC = D_8009F360;
L1_D_8009D600 = D_8009F364;
L1_D_8009D610 = D_8009F374;
L1_D_8009D620 = D_8009F384;
L1_D_8009D660 = D_8009F3C4;
L1_D_8009D7A4 = D_8009F508;
L1_D_8009D7A8 = D_8009F50C;
L1_D_8009D8B8 = D_8009F61C;
L1_D_8009D8BE = D_8009F622;
L1_D_8009D8C4 = D_8009F628;
L1_D_8009D8C8 = D_8009F62C;
L1_D_8009D8CC = D_8009F630;
L1_D_8009D8D4 = D_8009F638;
L1_D_8009D8E4 = D_8009F640;
L1_D_8009D8E8 = D_8009F644;
L1_D_8009D8F0 = D_8009F64C;
L1_D_8009D8F4 = D_8009F650;
L1_D_8009D8F8 = D_8009F654;
L1_D_8009D8FC = D_8009F658;
L1_D_8009D900 = D_8009F65C;
L1_D_8009D904 = D_8009F660;
L1_D_8009D90C = D_8009F668;
L1_D_8009D910 = D_8009F66C;
L1_D_8009D914 = D_8009F670;
L1_D_8009D918 = D_8009F674;
L1_D_8009D91C = D_8009F678;
L1_D_8009D920 = D_8009F67C;
L1_D_8009D924 = D_8009F680;
L1_D_8009D928 = D_8009F684;
L1_D_8009DB50 = D_8009F898;
L1_D_8009E410 = D_800A0908;
L1_D_8009E480 = D_800A09AC;
L1_D_8009E490 = D_800A09C0;
L1_D_8009E908 = D_800A0DD8;
L1_D_8009E9A8 = D_800A0EB8;
L1_D_8009E9B4 = D_800A0EC4;
L1_D_8009E9B8 = D_800A0EC8;
L1_D_8009E9BC = D_800A0ECC;
L1_D_8009E9C0 = D_800A0ED0;
L1_D_8009E9C4 = D_800A0ED4;
L1_D_8009E9D8 = D_800A0EE8;
L1_D_8009EADC = D_800A1118;
L1_D_8009EB5C = D_800A1198;
L1_D_8009EB7C = D_800A11B8;
L1_D_8009EB88 = D_800A11C4;
L1_D_8009EB8C = D_800A11C8;
L1_D_8009EE0C = D_800A1448;
L1_D_8009EE3D = D_800A1479;
L1_D_8009EE8C = D_800A14C8;
L1_D_8009EEC4 = D_800A1500;
L1_D_8009EEC8 = D_800A1504;
L1_D_8009EED0 = D_800A150C;
L1_D_8009EED4 = D_800A1510;
L1_D_8009EED8 = D_800A1514;
L1_D_8009EEDC = D_800A1518;
L1_D_8009EEF0 = D_800A1530;
L1_D_8009EEF4 = D_800A1534;
L1_D_8009EEF8 = D_800A1538;
L1_D_8009EF1C = D_800A155C;
L1_D_8009EF94 = D_800A15D4;
L1_D_8009EF98 = D_800A15D8;
L1_D_8009EF9C = D_800A15DC;
L1_D_8009EFA0 = D_800A15E0;
L1_D_8009EFA4 = D_800A15E4;
L1_D_8009EFA8 = D_800A15E8;
L1_D_8009EFC8 = D_800A1608;
L1_D_8009F008 = D_800A1648;
L1_D_8009F00C = D_800A164C;
L1_D_8009F010 = D_800A1650;
L1_D_8009F012 = D_800A1652;
L1_D_8009F013 = D_800A1653;
L1_D_8009F014 = D_800A1654;
L1_D_8009F016 = D_800A1656;
L1_D_8009F018 = D_800A1658;
L1_D_8009F01C = D_800A165C;
L1_D_8009F07C = D_800A16BC;
L1_D_8009F084 = D_800A16C4;
L1_D_8009F090 = D_800A16D0;
L1_D_8009F09C = D_800A16DC;
L1_D_8009F0BC = D_800A16FC;
L1_D_8009F0D0 = D_800A1710;
L1_D_8009F0E4 = D_800A1724;
L1_D_8009F0E6 = D_800A1726;
L1_D_8009F10C = D_800A174C;
L1_D_8009F114 = D_800A1754;
L1_D_8009F118 = D_800A1758;
L1_D_8009F11C = D_800A175C;
L1_D_8009F120 = D_800A1760;
L1_D_8009F124 = D_800A1764;
L1_D_8009F128 = D_800A1768;
L1_D_8009F12C = D_800A176C;
L1_D_8009F130 = D_800A1770;
L1_D_8009F134 = D_800A1774;
L1_D_8009F138 = D_800A1778;
L1_D_8009F13C = D_800A177C;
L1_D_8009F140 = D_800A1780;
L1_D_8009F144 = D_800A1784;
L1_D_8009F148 = D_800A1788;
L1_D_8009F14C = D_800A178C;
L1_D_8009F150 = D_800A1790;
L1_D_8009F160 = D_800A17A0;
L1_D_8009F170 = D_800A17B0;
L1_D_8009F178 = D_800A17B8;
L1_D_8009F17C = D_800A17BC;
L1_D_8009F18C = D_800A17CC;
L1_D_8009F190 = D_800A17D0;
L1_D_8009F194 = D_800A17D4;
L1_D_8009F198 = D_800A17D8;
L1_D_8009F1B0 = D_800A17F0;
L1_D_8009F230 = D_800A1870;
L1_D_8009F234 = D_800A1874;
L1_D_8009F248 = D_800A1888;
L1_D_8009F24C = D_800A188C;
L1_D_8009F250 = D_800A1890;
L1_D_8009F254 = D_800A1894;
L1_D_8009F2B8 = D_800A18F8;
L1_D_8009F2BA = D_800A18FA;
L1_D_8009F2BC = D_800A18FC;
L1_D_8009F2E8 = D_800A1928;
L1_D_8009F2F4 = D_800A1934;
L1_D_800A0340 = D_800A2980;
L1_D_800A0344 = D_800A2984;
L1_D_800A0348 = D_800A2988;
L1_D_800A034C = D_800A298C;
L1_D_800A0350 = D_800A2990;
L1_D_800A0370 = D_800A29B0;
L1_D_800A4370 = D_800A69B0;
L1_D_800A4374 = D_800A69B4;
L1_D_800A4378 = D_800A69B8;
L1_D_800A437C = D_800A69BC;
L1_D_800A4380 = D_800A69C0;
L1_D_800A4382 = D_800A69C2;
L1_D_800A4384 = D_800A69C4;
L1_D_800A4390 = D_800A69D0;
L1_D_800A4394 = D_800A69D4;
L1_D_800A43B0 = D_800A69F0;
L1_D_800A43C8 = D_800A6A08;
L1_D_800A43CC = D_800A6A0C;
L1_D_800A43D0 = D_800A6A10;
L1_D_800A43D4 = D_800A6A14;
L1_D_800A43D8 = D_800A6A18;
L1_D_800A43DC = D_800A6A1C;
L1_D_800A43E0 = D_800A6A20;
L1_D_800A43E4 = D_800A6A24;
L1_D_800A43E8 = D_800A6A28;
L1_D_800A43EC = D_800A6A2C;
L1_D_800A43F0 = D_800A6A30;
L1_D_800A43F4 = D_800A6A34;
L1_D_800A43F8 = D_800A6A38;
L1_D_800A43FC = D_800A6A3C;
L1_D_800A4400 = D_800A6A40;
L1_D_800A4404 = D_800A6A44;
L1_D_800A4408 = D_800A6A48;
L1_D_800A440C = D_800A6A4C;
L1_D_800A4410 = D_800A6A50;
L1_D_800A4414 = D_800A6A54;
L1_D_800A4418 = D_800A6A58;
L1_D_800A441C = D_800A6A5C;
L1_D_800A4420 = D_800A6A60;
L1_D_800A4428 = D_800A6A68;
L1_D_800A442C = D_800A6A6C;
L1_D_800A4430 = D_800A6A70;
L1_D_800A4440 = D_800A6A80;
L1_D_800A4450 = D_800A6A90;
L1_D_800A4460 = D_800A6AA0;
L1_D_800A446C = D_800A6AAC;
L1_D_800A4470 = D_800A6AB0;
L1_D_800A4474 = D_800A6AB4;
L1_D_800A4478 = D_800A6AB8;
L1_D_800A447C = D_800A6ABC;
L1_D_800A45D0 = D_800A6C10;
L1_D_800A45D4 = D_800A6C14;
L1_D_800A45D8 = D_800A6C18;
L1_D_800A4EA0 = D_800A74E0;
L1_D_800A4FD8 = D_800A7618;
L1_D_800A4FDC = D_800A761C;
L1_D_800A4FF0 = D_800A7630;
L1_D_800A5000 = D_800A7640;
L1_D_800A5010 = D_800A7650;
L1_D_800A56A0 = D_800A7CE0;
L1_D_800A5834 = D_800A7E74;
L1_D_800A59D0 = D_800A8010;
L1_D_800A59D4 = D_800A8014;
L1_D_800A59D8 = D_800A8018;
L1_D_800A59DC = D_800A801C;
L1_D_800A59E0 = D_800A8020;
L1_D_800A5B60 = D_800A81A0;
L1_D_800A5B6C = D_800A81AC;
L1_D_800A5B90 = D_800A81D0;
L1_D_800A5BA8 = D_800A81E8;
L1_D_800A5CB0 = D_800A82F0;
L1_D_800A5CB4 = D_800A82F4;
L1_D_800A5CB8 = D_800A82F8;
L1_D_800A5CBC = D_800A82FC;
L1_D_800A5CC0 = D_800A8300;
L1_D_800A5CC8 = D_800A8308;
L1_D_800A5CCC = D_800A830C;
L1_D_800A5CD0 = D_800A8310;
L1_D_800A5CD4 = D_800A8314;
L1_D_800A5CD8 = D_800A8318;
L1_D_800A5CDC = D_800A831C;
L1_D_800A5CE0 = D_800A8320;
L1_D_800A5CE4 = D_800A8324;
L1_D_800A5CE8 = D_800A8328;
L1_D_800A5CEC = D_800A832C;
L1_D_800A5CF0 = D_800A8330;
L1_D_800A5D00 = D_800A8340;
L1_D_800A5D04 = D_800A8344;
L1_D_800A5D08 = D_800A8348;
L1_D_800A5D18 = D_800A8358;
L1_D_800A5D1C = D_800A835C;
L1_D_800A5D20 = D_800A8360;
L1_D_800A5D24 = D_800A8364;
L1_D_800A5D28 = D_800A8368;
L1_D_800A5D2C = D_800A836C;
L1_D_800A5D34 = D_800A8374;
L1_D_800A5D44 = D_800A8384;
L1_D_800A5D48 = D_800A8388;
L1_D_800A5D4C = D_800A838C;
L1_D_800A5D7A = D_800A83BA;
L1_D_800A5D7C = D_800A83BC;
L1_D_800A5D80 = D_800A83C0;
L1_D_800A5D98 = D_800A83D8;
L1_D_800A5D9C = D_800A83DC;
L1_D_800A5DA0 = D_800A83E0;
L1_D_800A5DA4 = D_800A83E4;
L1_D_800A5DA8 = D_800A83E8;
L1_D_800A5DAC = D_800A83EC;
L1_D_800A5DB0 = D_800A83F0;
L1_D_800A5DB4 = D_800A83F4;
L1_D_800A5DB5 = D_800A83F5;
L1_D_800A5DBC = D_800A83FC;
L1_D_800A5E3C = D_800A847C;
L1_D_800A5E5C = D_800A849C;
L1_D_800A5EA0 = D_800A84E0;
L1_D_800A5EDC = D_800A851C;
L1_D_800A5F5C = D_800A859C;
L1_D_800A5FDC = D_800A861C;
L1_D_800A605C = D_800A869C;
L1_D_800A6060 = D_800A86A0;
L1_D_800A6064 = D_800A86A4;
L1_D_800A6068 = D_800A86A8;
L1_D_800A606C = D_800A86AC;
L1_D_800A6070 = D_800A86B0;
L1_D_800A6074 = D_800A86B4;
L1_D_800A6075 = D_800A86B5;
L1_D_800A6078 = D_800A86B8;
L1_D_800A6090 = D_800A86D0;
L1_D_800A6094 = D_800A86D4;
L1_D_800A6098 = D_800A86D8;
L1_D_800A609C = D_800A86DC;
L1_D_800A60A0 = D_800A86E0;
L1_D_800A60B0 = D_800A86F0;
L1_D_800A60D0 = D_800A8710;
L1_D_800A60D4 = D_800A8714;
L1_D_800A60E0 = D_800A8720;
L1_D_800A60E4 = D_800A8724;
L1_D_800A6104 = D_800A8744;
L1_D_800A6110 = D_800A8750;
L1_D_800A6114 = D_800A8754;
L1_D_800A6118 = D_800A8758;
L1_D_800A611C = D_800A875C;
L1_D_800A6120 = D_800A8760;
L1_D_800A6140 = D_800A8780;
L1_D_800A6170 = D_800A87B0;
L1_D_800A6174 = D_800A87B4;
L1_D_800A6178 = D_800A87B8;
L1_D_800A6180 = D_800A87C0;
L1_D_800A6198 = D_800A87D8;
L1_D_800A62A0 = D_800A88E0;
L1_D_800A66A0 = D_800A8CE0;
L1_D_800A6EB0 = D_800A94F0;
L1_D_800A6ED0 = D_800A9510;
L1_D_800A6EF8 = D_800A9538;
L1_D_800A6F00 = D_800A9540;
L1_D_800A6F1C = D_800A955C;
L1_D_800A6F34 = D_800A9574;
L1_D_800A6F4C = D_800A958C;
L1_D_800A7048 = D_800A9688;
L1_D_800A7060 = D_800A96A0;
L1_D_800A70A0 = D_800A96E0;
L1_D_800A70C8 = D_800A9708;
L1_D_800A70D4 = D_800A9714;
L1_D_800A70F8 = D_800A9738;
L1_D_800A7190 = D_800A97D0;
L1_D_800A71EC = D_800A982C;
L1_D_800A71F0 = D_800A9830;
L1_D_800A71F4 = D_800A9834;
L1_D_800A71F8 = D_800A9838;
L1_D_800A7214 = D_800A9854;
L1_D_800A7260 = D_800A98A0;
L1_D_800A7290 = D_800A98D0;
L1_D_800A72E8 = D_800A9928;
L1_D_800A7300 = D_800A9940;
L1_D_800A7310 = D_800A9950;
L1_D_800A7320 = D_800A9960;
L1_D_800A7324 = D_800A9964;
L1_D_800A7330 = D_800A9970;
L1_D_800A7344 = D_800A9984;
L1_D_800A735C = D_800A999C;
L1_D_800A73BC = D_800A99FC;
L1_D_800A73D8 = D_800A9A18;
L1_D_800A7418 = D_800A9A58;
L1_D_800A7424 = D_800A9A64;
L1_D_800A7474 = D_800A9AB4;
L1_D_800A747C = D_800A9ABC;
L1_D_800A7498 = D_800A9AD8;
L1_D_800A74D4 = D_800A9B14;
L1_D_800A74E0 = D_800A9B20;
L1_D_800A7510 = D_800A9B50;
L1_D_800A75D0 = D_800A9C10;
L1_D_800A7678 = D_800A9CB8;
L1_D_800A76A0 = D_800A9CE0;
L1_D_800A76E4 = D_800A9D24;
L1_D_800A76F8 = D_800A9D38;
L1_D_800A770C = D_800A9D4C;
L1_D_800A7714 = D_800A9D54;
L1_D_800A7728 = D_800A9D68;
L1_D_800A773C = D_800A9D7C;
L1_D_800A7750 = D_800A9D90;
L1_D_800A775C = D_800A9D9C;
L1_D_800A7778 = D_800A9DB8;
L1_D_800A7784 = D_800A9DC4;
L1_D_800A7788 = D_800A9DC8;
L1_D_800A77A0 = D_800A9DE0;
L1_D_800A77B4 = D_800A9DF4;
L1_D_800A77CC = D_800A9E0C;
L1_D_800A79F0 = D_800AA030;
L1_D_800A7A0C = D_800AA04C;
L1_D_800A7A24 = D_800AA064;
L1_D_800A7A30 = D_800AA070;
L1_D_800A7CF0 = D_800AA350;
L1_D_800A7D08 = D_800AA368;
L1_D_800A7D20 = D_800AA380;
L1_D_800A7D44 = D_800AA3A4;
L1_D_800A7D64 = D_800AA3C4;
L1_D_800A7D74 = D_800AA3E8;
L1_D_800A7D90 = D_800AA404;
L1_D_800A7DC0 = D_800AA434;
L1_D_800A7DE8 = D_800AA45C;
L1_D_800A7DF4 = D_800AA468;
L1_D_800A7E14 = D_800AA488;
L1_D_800A7E34 = D_800AA4A8;
L1_D_800A7E50 = D_800AA4C4;
L1_D_800A7E74 = D_800AA4E8;
L1_D_800A7E90 = D_800AA504;
L1_D_800A7EC4 = D_800AA538;
L1_D_800A7EFC = D_800AA570;
L1_D_800A7F1C = D_800AA590;
L1_D_800A7F2C = D_800AA5A0;
L1_D_800A7FF8 = D_800AA66C;
L1_D_800A8000 = D_800AA674;
L1_D_800A80A4 = D_800AA718;
L1_D_800A80B0 = D_800AA724;
L1_D_800A80BC = D_800AA730;
L1_D_800A80C8 = D_800AA73C;
L1_D_800A81F8 = D_800AA86C;
L1_D_800A8210 = D_800AA884;
L1_D_800A8224 = D_800AA898;
L1_D_800A8238 = D_800AA8AC;
L1_D_800A824C = D_800AA8C0;
L1_D_800A8260 = D_800AA8D4;
L1_D_800A8274 = D_800AA8E8;
L1_D_800A8280 = D_800AA8F4;
L1_D_800A828C = D_800AA900;
L1_D_800A82B4 = D_800AA928;
L1_D_800A82DC = D_800AA950;
L1_D_800A8304 = D_800AA978;
L1_D_800A8308 = D_800AA97C;
L1_D_800A8310 = D_800AA984;
L1_D_800A8318 = D_800AA98C;
L1_D_800A8320 = D_800AA994;
L1_D_800A832C = D_800AA9A0;
L1_D_800A8340 = D_800AA9B4;
L1_D_800A8370 = D_800AA9E4;
L1_D_800A8390 = D_800AAA04;
L1_D_800A83B0 = D_800AAA24;
L1_D_800A83BC = D_800AAA30;
L1_D_800A83C8 = D_800AAA3C;
L1_D_800A83D4 = D_800AAA48;
L1_D_800A83E0 = D_800AAA54;
L1_D_800A83E8 = D_800AAA5C;
L1_D_800A83F0 = D_800AAA64;
L1_D_800A8400 = D_800AAA74;
L1_D_800A8410 = D_800AAA84;
L1_D_800A8418 = D_800AAA8C;
L1_D_800A8420 = D_800AAA94;
L1_D_800A842C = D_800AAAA0;
L1_D_800A8444 = D_800AAAB8;
L1_D_800A844C = D_800AAAC0;
L1_D_800A8458 = D_800AAACC;
L1_D_800A8460 = D_800AAAD4;
L1_D_800A8464 = D_800AAAD8;
L1_D_800A8468 = D_800AAADC;
L1_D_800A8478 = D_800AAAEC;
L1_D_800A8484 = D_800AAAF8;
L1_D_800A8490 = D_800AAB04;
L1_D_800A849C = D_800AAB10;
L1_D_800A84A8 = D_800AAB1C;
L1_D_800A84B4 = D_800AAB28;
L1_D_800A84B8 = D_800AAB2C;
L1_D_800A84D0 = D_800AAB44;
L1_D_800A84D8 = D_800AAB4C;
L1_D_800A84E4 = D_800AAB58;
L1_D_800A84F0 = D_800AAB64;
L1_D_800A84FC = D_800AAB70;
L1_D_800A850C = D_800AAB80;
L1_D_800A851C = D_800AAB90;
L1_D_800A8528 = D_800AAB9C;
L1_D_800A8534 = D_800AABA8;
L1_D_800A8544 = D_800AABB8;
L1_D_800A857C = D_800AABF0;
L1_D_800A85C4 = D_800AAC38;
L1_D_800A85D4 = D_800AAC48;
L1_D_800A85F8 = D_800AAC6C;
L1_D_800A86C0 = D_800AAD64;
L1_D_800A86CC = D_800AAD70;
L1_D_800A8764 = D_800AADF0;
L1_D_800A87EC = D_800AAE78;
L1_D_800A87F8 = D_800AAE84;
L1_D_800A8808 = D_800AAE94;
L1_D_800A880C = D_800AAE98;
L1_D_800A8820 = D_800AAEAC;
L1_D_800A8858 = D_800AAEE4;
L1_D_800A887C = D_800AAF08;
L1_D_800A8884 = D_800AAF10;
L1_D_800A8894 = D_800AAF20;
L1_D_800A88A4 = D_800AAF30;
L1_D_800A88D0 = D_800AAF5C;
L1_D_800A89A4 = D_800AB058;
L1_D_800A89F0 = D_800AB0A4;
L1_D_800A8A2C = D_800AB0E0;
L1_D_800A8AA8 = D_800AB15C;
L1_D_800A8C08 = D_800AB2BC;
L1_D_800A8C28 = D_800AB2DC;
L1_D_800A8C48 = D_800AB2FC;
L1_D_800A8CB0 = D_800AB364;
L1_D_800A8CC4 = D_800AB378;
L1_D_800A8CEC = D_800AB3A0;
L1_D_800A8CF8 = D_800AB3AC;
L1_D_800A8D14 = D_800AB3C8;
L1_D_800A8D44 = D_800AB3E8;
L1_D_800A8D58 = D_800AB3FC;
L1_D_800A8F94 = D_800AB4B8;
L1_D_800A8FAC = D_800AB4D0;
L1_D_800A9390 = D_800AB8B4;
L1_D_800A9488 = D_800AB970;
L1_D_800A9498 = D_800AB980;
L1_D_800A9794 = D_800AC008;
L1_D_800A97BC = D_800AC030;
L1_D_800A98C8 = D_800AC1B8;
L1_D_800A99D0 = D_800AC2E4;
L1_D_800A99EC = D_800AC300;
L1_D_800A9A08 = D_800AC31C;
L1_D_800A9A60 = D_800AC374;
L1_D_800A9A84 = D_800AC398;
L1_D_800A9AA8 = D_800AC3BC;
L1_D_800A9B6C = D_800AC480;
L1_D_800A9B78 = D_800AC48C;
L1_D_800A9BE8 = D_800AC4FC;
L1_D_800A9C08 = D_800AC51C;
L1_D_800A9C78 = D_800AC58C;
L1_D_800A9C8C = D_800AC5A0;
L1_D_800A9CA0 = D_800AC5B4;
L1_D_800A9CAC = D_800AC5C0;
L1_D_800A9CC0 = D_800AC5D4;
L1_D_800A9CC4 = D_800AC5D8;
L1_D_800A9CDC = D_800AC5F0;
L1_D_800A9D00 = D_800AC614;
L1_D_800A9D18 = D_800AC62C;
L1_D_800A9D30 = D_800AC644;
L1_D_800A9D44 = D_800AC658;
L1_D_800A9D78 = D_800AC68C;
L1_D_800A9D90 = D_800AC6A4;
L1_D_800A9EB0 = D_800AC7C4;
L1_D_800A9EC8 = D_800AC7DC;
L1_D_800A9EE0 = D_800AC7F4;
L1_D_800A9F10 = D_800AC824;
L1_D_800A9F2C = D_800AC840;
L1_D_800A9F44 = D_800AC858;
L1_D_800A9F60 = D_800AC874;
L1_D_800A9F80 = D_800AC894;
L1_D_800A9F8C = D_800AC8A0;
L1_D_800A9F9C = D_800AC8B0;
L1_D_800A9FC8 = D_800AC8DC;
L1_D_800A9FD0 = D_800AC8E4;
L1_D_800AA000 = D_800AC914;
L1_D_800AA024 = D_800AC938;
L1_D_800AA044 = D_800AC958;
L1_D_800AA058 = D_800AC96C;
L1_D_800AA07C = D_800AC990;
L1_D_800AA09C = D_800AC9B0;
L1_D_800AA0B8 = D_800AC9CC;
L1_D_800AA0BC = D_800AC9D0;
L1_D_800AA0BE = D_800AC9D2;
L1_D_800AA0C0 = D_800AC9D4;
L1_D_800AA0DC = D_800AC9F0;
L1_D_800AA110 = D_800ACA24;
L1_D_800AA154 = D_800ACA68;
L1_D_800AA170 = D_800ACA84;
L1_D_800AA1B0 = D_800ACAC4;
L1_D_800AA1D0 = D_800ACAE4;
L1_D_800AA3C0 = D_800ACCD4;
L1_D_800AA3E8 = D_800ACCFC;
L1_D_800AA410 = D_800ACD24;
L1_D_800AA438 = D_800ACD4C;
L1_D_800AA444 = D_800ACD58;
L1_D_800AA46C = D_800ACD80;
L1_D_800AA494 = D_800ACDA8;
L1_D_800AA4C0 = D_800ACDD4;
L1_D_800AA4F0 = D_800ACE04;
L1_D_800AA518 = D_800ACE2C;
L1_D_800AA580 = D_800ACE94;
L1_D_800AA590 = D_800ACEA4;
L1_D_800AA5A0 = D_800ACEB4;
L1_D_800AA5B4 = D_800ACEC8;
L1_D_800AA70C = D_800AD020;
L1_D_800AA71C = D_800AD030;
L1_D_800AA738 = D_800AD04C;
L1_D_800AA744 = D_800AD058;
L1_D_800AA760 = D_800AD074;
L1_D_800AA774 = D_800AD088;
L1_D_800AA794 = D_800AD0A8;
L1_D_800AA79C = D_800AD0B0;
L1_D_800AA7A8 = D_800AD0BC;
L1_D_800AA7B0 = D_800AD0C4;
L1_D_800AA7C0 = D_800AD0D4;
L1_D_800AA800 = D_800AD114;
L1_D_800AA80C = D_800AD120;
L1_D_800AA818 = D_800AD12C;
L1_D_800AA830 = D_800AD144;
L1_D_800AA84C = D_800AD160;
L1_D_800AA8A0 = D_800AD1B4;
L1_D_800AA8C8 = D_800AD1DC;
L1_D_800AA8E0 = D_800AD1F4;
L1_D_800AA8E8 = D_800AD1FC;
L1_D_800AA8F0 = D_800AD204;
L1_D_800AB4A0 = D_800ADDB8;
L1_D_800AB540 = D_800ADE58;
L1_D_800AB5E0 = D_800ADEF8;
L1_D_800AB5E4 = D_800ADEFC;
L1_D_800AB5E8 = D_800ADF00;
L1_D_800AB5EC = D_800ADF04;
L1_D_800AB5F0 = D_800ADF08;
L1_D_800AB5F4 = D_800ADF0C;
L1_D_800AB5F8 = D_800ADF10;
L1_D_800AB5FC = D_800ADF14;
L1_D_800AB600 = D_800ADF18;
L1_D_800AB604 = D_800ADF1C;
L1_D_800AB608 = D_800ADF20;
L1_D_800AB60C = D_800ADF24;
L1_D_800AB610 = D_800ADF28;
L1_D_800AB614 = D_800ADF2C;
L1_D_800AB618 = D_800ADF30;
L1_D_800AB744 = D_800AE05C;
L1_D_800AB754 = D_800AE06C;
L1_D_800AC284 = D_800AEB9C;
L1_D_800AC384 = D_800AEC9C;
L1_D_800AC38C = D_800AECA4;
L1_D_800AC4C8 = D_800AEDE0;
L1_D_800AC4D0 = D_800AEDE8;
L1_D_800AC4D8 = D_800AEDF0;
L1_D_800AC4DC = D_800AEDF4;
L1_D_800AC4E0 = D_800AEDF8;
L1_D_800AC4E4 = D_800AEDFC;
L1_D_800AC4E8 = D_800AEE00;
L1_D_800AC4EC = D_800AEE04;
L1_D_800AC54C = D_800AEE64;
L1_D_800AC550 = D_800AEE68;
L1_D_800AE940 = D_800B1258;
L1_D_800AE9B8 = D_800B12D0;
L1_D_800AE9C0 = D_800B12D8;
L1_D_800AEB1A = D_800B1432;
L1_D_800AEC38 = D_800B1550;
L1_D_800AEDA0 = D_800B16B8;
L1_D_800AEDA4 = D_800B16BC;
L1_D_800AEDA8 = D_800B16C0;
L1_D_800AEDAC = D_800B16C4;
L1_D_800AEDB0 = D_800B16C8;
L1_D_800AEDB4 = D_800B16CC;
L1_D_800AEDB8 = D_800B16D0;
L1_D_800AEDBC = D_800B16D4;
L1_D_800AEDD4 = D_800B16EC;
L1_D_800AEDD8 = D_800B16F0;
L1_D_800AEDDC = D_800B16F4;
L1_D_800AEDE0 = D_800B16F8;
L1_D_800AEDE4 = D_800B16FC;
L1_D_800AEDE8 = D_800B1700;
L1_D_800AEDEC = D_800B1704;
L1_D_800AEDF0 = D_800B1708;
L1_D_800AEE10 = D_800B1728;
L1_D_800AEE14 = D_800B172C;
L1_D_800AF620 = D_800B1F38;
L1_D_800AF624 = D_800B1F3C;
L1_D_800AF6A4 = D_800B1FBC;
L1_D_800AF6A5 = D_800B1FBD;
L1_D_800AF6A8 = D_800B1FC0;
L1_D_800AFEA8 = D_800B27C0;
L1_D_800AFEAC = D_800B27C4;
L1_D_800AFEB0 = D_800B27C8;
L1_D_800AFEB5 = D_800B27CD;
L1_D_800AFEB6 = D_800B27CE;
L1_D_800AFEB7 = D_800B27CF;
L1_D_800AFEB8 = D_800B27D0;
L1_D_800AFEB9 = D_800B27D1;
L1_D_800AFEBC = D_800B27D4;
L1_D_800AFEC0 = D_800B27D8;
L1_D_800AFEC8 = D_800B27E0;
L1_D_800AFF2C = D_800B2844;
L1_D_800AFF48 = D_800B2860;
L1_D_800AFF4C = D_800B2864;
L1_D_800AFF58 = D_800B2870;
L1_D_800AFF5C = D_800B2874;
L1_D_800AFF60 = D_800B2878;
L1_D_800AFF64 = D_800B287C;
L1_D_800AFF68 = D_800B2880;
L1_D_800AFF70 = D_800B2888;
L1_D_800AFF78 = D_800B2890;
L1_D_800AFF80 = D_800B2898;
L1_D_800AFF84 = D_800B289C;
L1_D_800AFF88 = D_800B28A0;
L1_D_800AFF8C = D_800B28A4;
L1_D_800AFF94 = D_800B28AC;
L1_D_800AFF98 = D_800B28B0;
L1_D_800AFFA4 = D_800B28BC;
L1_D_800AFFA8 = D_800B28C0;
L1_D_800AFFAC = D_800B28C4;
L1_D_800AFFB0 = D_800B28C8;
L1_D_800AFFB4 = D_800B28CC;
L1_D_800AFFC0 = D_800B28D8;
L1_D_800AFFC4 = D_800B28DC;
L1_D_800AFFC8 = D_800B28E0;
L1_D_800AFFCC = D_800B28E4;
L1_D_800B0014 = D_800B292C;
L1_D_800B0018 = D_800B2930;
L1_D_800B0064 = D_800B297C;
L1_D_800B0066 = D_800B297E;
L1_D_800B0068 = D_800B2980;
L1_D_800B0070 = D_800B2988;
L1_D_800B0084 = D_800B299C;
L1_D_800B008C = D_800B29A4;
L1_D_800B0094 = D_800B29AC;
L1_D_800B00A0 = D_800B29B8;
L1_D_800B0108 = D_800B2A20;
L1_D_800B05AC = D_800B30EC;
L1_D_800B05B0 = D_800B30F0;
L1_D_800B077C = D_800B32BC;
L1_D_800B0794 = D_800B32D4;
L1_D_800B0798 = D_800B32D8;
L1_D_800B07A4 = D_800B32E4;
L1_D_800B07A8 = D_800B32E8;
L1_D_800B07AC = D_800B32EC;
L1_D_800B07B0 = D_800B32F0;
L1_D_800B07B4 = D_800B32F4;
L1_D_800B07B8 = D_800B32F8;
L1_D_800B07BC = D_800B32FC;
L1_D_800B07C0 = D_800B3300;
L1_D_800B07C4 = D_800B3304;
L1_D_800B0804 = D_800B3344;
L1_D_800B0808 = D_800B3348;
L1_D_800B0848 = D_800B3388;
L1_D_800B0868 = D_800B33A8;
L1_D_800B086C = D_800B33AC;
L1_D_800B087C = D_800B33BC;
L1_D_800B0A94 = D_800B35D4;
L1_D_800B0A98 = D_800B35D8;
L1_D_800B0AA0 = D_800B35E0;
L1_D_800B0AA4 = D_800B35E4;
L1_D_800B0AA8 = D_800B35E8;
L1_D_800B0AB4 = D_800B35F4;
L1_D_800B0AB8 = D_800B35F8;
L1_D_800B0AC0 = D_800B3600;
L1_D_800B0AC8 = D_800B3608;
L1_D_800B0ACC = D_800B360C;
L1_D_800B0AD0 = D_800B3610;
L1_D_800B0AD4 = D_800B3614;
L1_D_800B0ADC = D_800B361C;
L1_D_800B0AE0 = D_800B3620;
L1_D_800B0AE4 = D_800B3624;
L1_D_800B0AE8 = D_800B3628;
L1_D_800B0AEC = D_800B362C;
L1_D_800B0AFC = D_800B363C;
L1_D_800B0B10 = D_800B3650;
L1_D_800B0B14 = D_800B3654;
L1_D_800B0B54 = D_800B3694;
L1_D_800B0B58 = D_800B3698;
L1_D_800B0B64 = D_800B36A4;
L1_D_800B0B68 = D_800B36A8;
L1_D_800B0B6A = D_800B36AA;
L1_D_800B0B6C = D_800B36AC;
L1_D_800B0B70 = D_800B36B0;
L1_D_800B0B72 = D_800B36B2;
L1_D_800B0B78 = D_800B36B8;
L1_D_800B0B80 = D_800B36C0;
L1_D_800B0B84 = D_800B36C4;
L1_D_800B0B88 = D_800B36C8;
L1_D_800B0B8C = D_800B36CC;
L1_D_800B0B9C = D_800B36DC;
L1_D_800B0BA0 = D_800B36E0;
L1_D_800B0BB4 = D_800B36F4;
L1_D_800B0BB8 = D_800B36F8;
L1_D_800B0BBC = D_800B36FC;
L1_D_800B0BC0 = D_800B3700;
L1_D_800B0C10 = D_800B3750;
L1_D_800B0C30 = D_800B3770;
L1_D_800B0C38 = D_800B3778;
L1_D_800B0C58 = D_800B3798;
L1_D_800B0C5C = D_800B379C;
L1_D_800B0C60 = D_800B37A0;
L1_D_800B0C64 = D_800B37A4;
L1_D_800B0C68 = D_800B37A8;
L1_D_800B0C74 = D_800B37B4;
L1_D_800B0C84 = D_800B37C4;
L1_D_800B0C8C = D_800B37CC;
L1_D_800B0C94 = D_800B37D4;
L1_D_800B0C98 = D_800B37D8;
L1_D_800B0C9C = D_800B37DC;
L1_D_800B0CA0 = D_800B37E0;
L1_D_800B0CA4 = D_800B37E4;
L1_D_800B0CA8 = D_800B37E8;
L1_D_800B0CAC = D_800B37EC;
L1_D_800B0CB0 = D_800B37F0;
L1_D_800B0CC4 = D_800B3804;
L1_D_800B0D50 = D_800B3890;
L1_D_800B0D94 = D_800B38D4;
L1_D_800B0D9C = D_800B38DC;
L1_D_800B0DA0 = D_800B38E0;
L1_D_800B0DA4 = D_800B38E4;
L1_D_800B0DA8 = D_800B38E8;
L1_D_800B0DAC = D_800B38EC;
L1_D_800B0DB0 = D_800B38F0;
L1_D_800B0DB4 = D_800B38F4;
L1_D_800B0DB8 = D_800B38F8;
L1_D_800B0DBC = D_800B38FC;
L1_D_800B0DC0 = D_800B3900;
L1_D_800B0DC4 = D_800B3904;
L1_D_800B0DC8 = D_800B3908;
L1_D_800B0DCC = D_800B390C;
L1_D_800B0DD4 = D_800B3914;
L1_D_800B0DD8 = D_800B3918;
L1_D_800B0DDC = D_800B391C;
L1_D_800B0DE4 = D_800B3924;
L1_D_800B0E34 = D_800B3974;
L1_D_800B0E36 = D_800B3976;
L1_D_800B0E40 = D_800B3980;
L1_D_800B0E48 = D_800B3988;
L1_D_800B0E54 = D_800B3994;
L1_D_800B0E58 = D_800B3998;
L1_D_800B0E5E = D_800B399E;
L1_D_800B0E5F = D_800B399F;
L1_D_800B0E62 = D_800B39A2;
L1_D_800B0E63 = D_800B39A3;
L1_D_800B0E8C = D_800B39CC;
L1_D_800B0EA0 = D_800B39E0;
L1_D_800B0EFC = D_800B3A3C;
L1_D_800B8EFC = D_800BBA3C;
L1_D_800B8F24 = D_800BBA64;
L1_D_800B8F28 = D_800BBA68;
L1_D_800B8F68 = D_800BBAA8;
L1_D_800B8F88 = D_800BBAC8;
L1_D_800B8FB0 = D_800BBAF0;
L1_D_800B8FB4 = D_800BBAF4;
L1_D_800C1C54 = D_800C4794;
L1_D_800CA8F4 = D_800CD434;
L1_D_800D28F4 = D_800D5434;
L1_D_800D2AF4 = D_800D5634;
L1_D_800D2AF8 = D_800D5638;
L1_D_800D2AFC = D_800D563C;
L1_D_800D2BC4 = D_800D5704;
L1_D_800D2BE8 = D_800D5728;
L1_D_800D2BEC = D_800D572C;
L1_D_800D2BF0 = D_800D5730;
L1_D_800D2D30 = D_800D5870;
L1_D_800D2E70 = D_800D59B0;
L1_D_800D2E74 = D_800D59B4;
L1_D_800D2E84 = D_800D59C4;
L1_D_800D2E90 = D_800D59D0;
L1_D_800D2F48 = D_800D5A88;
L1_D_800D2F68 = D_800D5AA8;
L1_D_800D2F8C = D_800D5ACC;
L1_D_800D2F90 = D_800D5AD0;
L1_D_800D2F94 = D_800D5AD4;
L1_D_800D2FA4 = D_800D5AE4;
L1_D_800D2FA8 = D_800D5AE8;
L1_D_800D2FAC = D_800D5AEC;
L1_D_800D2FB0 = D_800D5AF0;
L1_D_800D2FC0 = D_800D5B00;
L1_D_800D2FC4 = D_800D5B04;
L1_D_800D2FF4 = D_800D5B34;
L1_D_800D305C = D_800D5B9C;
L1_D_800D3068 = D_800D5BA8;
L1_D_800D308C = D_800D5BCC;
L1_D_800D30C0 = D_800D5C00;
L1_D_800D30D4 = D_800D5C14;
L1_D_800D30D8 = D_800D5C18;
L1_D_800D31B8 = D_800D5CF8;
L1_D_800D31C0 = D_800D5D00;
L1_D_800D31D0 = D_800D5D10;
L1_D_800D3238 = D_800D5D78;
L1_D_800D3288 = D_800D5DC8;
L1_D_800D3FA8 = D_800D6AE8;
L1_D_800D3FAC = D_800D6AEC;
L1_D_800D3FB0 = D_800D6AF0;
L1_D_800D3FD4 = D_800D6B14;
L1_D_800D3FD8 = D_800D6B18;
L1_D_800D3FE0 = D_800D6B20;
L1_D_800D3FE4 = D_800D6B24;
L1_D_800D3FEC = D_800D6B2C;
L1_D_800D3FF0 = D_800D6B30;
L1_D_800D4050 = D_800D6B90;
L1_D_800D4058 = D_800D6B98;
L1_D_800D4068 = D_800D6BA8;
L1_D_800D406C = D_800D6BAC;
L1_D_800D4070 = D_800D6BB0;
L1_D_800D4074 = D_800D6BB4;
L1_D_800D4080 = D_800D6BC0;
L1_D_800D40D8 = D_800D6C18;
L1_D_800D40F8 = D_800D6C38;
L1_D_800D40FC = D_800D6C3C;
L1_D_800D4100 = D_800D6C40;
L1_D_800D4104 = D_800D6C44;
L1_D_800D4108 = D_800D6C48;
L1_D_800D410C = D_800D6C4C;
L1_D_800D4110 = D_800D6C50;
L1_D_800D4114 = D_800D6C54;
L1_D_800D424C = D_800D6D8C;
L1_D_800D4250 = D_800D6D90;
L1_D_800D4384 = D_800D6EC4;
L1_D_800D4385 = D_800D6EC5;
L1_D_800D4386 = D_800D6EC6;
L1_D_800D4387 = D_800D6EC7;
L1_D_800D4388 = D_800D6EC8;
L1_D_800D4389 = D_800D6EC9;
L1_D_800D438A = D_800D6ECA;
L1_D_800D438B = D_800D6ECB;
L1_D_800D438C = D_800D6ECC;
L1_D_800D438D = D_800D6ECD;
L1_D_800D438E = D_800D6ECE;
L1_D_800D438F = D_800D6ECF;
L1_D_800D4390 = D_800D6ED0;
L1_D_800D43A8 = D_800D6EE8;
L1_D_800D43AC = D_800D6EEC;
L1_D_800D43C0 = D_800D6F00;
L1_D_800D43C4 = D_800D6F04;
L1_D_800D43CC = D_800D6F0C;
L1_D_800D43D0 = D_800D6F10;
L1_D_800D43E4 = D_800D6F24;
L1_D_800D43F0 = D_800D6F30;
L1_D_800D43F4 = D_800D6F34;
L1_D_800D43F8 = D_800D6F38;
L1_D_800D4400 = D_800D6F40;
L1_D_800D4404 = D_800D6F44;
L1_D_800D440C = D_800D6F4C;
L1_D_800D4410 = D_800D6F50;
L1_D_800D4414 = D_800D6F54;
L1_D_800D4424 = D_800D6F64;
L1_D_800D4440 = D_800D6F80;
L1_D_800D4444 = D_800D6F84;
L1_D_800D4450 = D_800D6FCC;
L1_D_800D4454 = D_800D6FD0;
L1_D_800D4458 = D_800D6FD4;
L1_D_800D445C = D_800D6FD8;
L1_D_800D4464 = D_800D6FE0;
L1_D_800D4468 = D_800D6FE4;
L1_D_800D446C = D_800D6FE8;
L1_D_800D4474 = D_800D6FF4;
L1_D_800D4484 = D_800D7008;
L1_D_800D4564 = D_800D70E8;
L1_D_800D45C4 = D_800D7148;
L1_D_800D45F4 = D_800D7178;
L1_D_800D4688 = D_800D720C;
L1_D_800D46D8 = D_800D725C;
L1_D_800D4958 = D_800D74DC;
L1_D_800D4984 = D_800D7508;
L1_D_800D5DA4 = D_800D8928;
L1_D_800D5E80 = D_800D8A04;
L1_D_800D5ED0 = D_800D8A54;
L1_D_800D5ED8 = D_800D8A5C;
L1_D_800D5EF0 = D_800D8A74;
L1_D_800D5F40 = D_800D8AC4;
L1_D_800D5F48 = D_800D8ACC;
L1_D_800D74F8 = D_800DA07C;
L1_D_800D74FC = D_800DA080;
L1_D_800D7500 = D_800DA084;
L1_D_800D7550 = D_800DA0D4;
L1_D_800D7554 = D_800DA0D8;
L1_D_800D7588 = D_800DA10C;
L1_D_800D77B8 = D_800DA33C;
L1_D_800D77E8 = D_800DA36C;
L1_D_800D7838 = D_800DA3BC;
L1_D_800D7888 = D_800DA40C;
L1_D_800D78D8 = D_800DA45C;
L1_D_800D7930 = D_800DA4B4;
L1_D_800D7980 = D_800DA504;
L1_D_800D79D0 = D_800DA554;
L1_D_800D79D4 = D_800DA558;
L1_D_800D7A1C = D_800DA5A0;
L1_D_800D7A20 = D_800DA5A4;
L1_D_800D7AB8 = D_800DA63C;
L1_D_800D7B08 = D_800DA68C;
L1_D_800D7BE8 = D_800DA76C;
L1_D_800D7BF0 = D_800DA774;
L1_D_800D7C24 = D_800DA7A8;
L1_D_800D7C64 = D_800DA7E8;
L1_D_800D7CB4 = D_800DA838;
L1_D_800D7CB8 = D_800DA83C;
L1_D_800D7D08 = D_800DA88C;
L1_D_800D7DF8 = D_800DA97C;
L1_D_800D7DFC = D_800DA980;
L1_D_800D7E9C = D_800DAA20;
L1_D_800D7EEC = D_800DAA70;
L1_D_800D7FDC = D_800DAB60;
L1_D_800D811C = D_800DACA0;
L1_D_800D8138 = D_800DACBC;
L1_D_800D8150 = D_800DACD4;
L1_D_800D8154 = D_800DACD8;
L1_D_800D861C = D_800DB1A0;
L1_D_800D8620 = D_800DB1A4;
L1_D_800D8624 = D_800DB1A8;
L1_D_800D8674 = D_800DB1F8;
L1_D_800D86C4 = D_800DB248;
L1_D_800D86C8 = D_800DB24C;
L1_D_800D86DC = D_800DB260;
L1_D_800D86E0 = D_800DB264;
L1_D_800D86E4 = D_800DB268;
L1_D_800D86E8 = D_800DB26C;
L1_D_800D8BE8 = D_800DB76C;
L1_D_800D8C7C = D_800DB800;
L1_D_800D8C90 = D_800DB814;
L1_D_800D8C94 = D_800DB818;
L1_D_800D8E74 = D_800DB9F8;
L1_D_800D8E8C = D_800DBA10;
L1_D_800D8EA4 = D_800DBA28;
L1_D_800D8EA8 = D_800DBA2C;
L1_D_800D8EE8 = D_800DBA6C;
L1_D_800D8FE8 = D_800DBB6C;
L1_D_800D8FF8 = D_800DBB7C;
L1_D_800D90C0 = D_800DBC44;
L1_D_800D911C = D_800DBCA0;
L1_D_800D91E4 = D_800DBD68;
L1_D_800D91E7 = D_800DBD6B;
L1_D_800D91E8 = D_800DBD6C;
L1_D_800D91F0 = D_800DBD74;
L1_D_800D91F8 = D_800DBD7C;
L1_D_800D91FC = D_800DBD80;
L1_D_800D9200 = D_800DBD84;
L1_D_800D9208 = D_800DBD8C;
L1_D_800D920C = D_800DBD90;
L1_D_800D9210 = D_800DBD94;
L1_D_800D9214 = D_800DBD98;
L1_D_800D9218 = D_800DBD9C;
L1_D_800D9232 = D_800DBDB6;
L1_D_800D9268 = D_800DBDF8;
L1_D_800D9278 = D_800DBE08;
L1_D_800DA270 = D_800DCE00;
L1_D_800DA5C0 = D_800DD150;
L1_D_800DA5C4 = D_800DD154;
L1_D_800DB7E4 = D_800DE374;
L1_D_800DB884 = D_800DE414;
L1_D_800DCAA4 = D_800DF634;
L1_D_800DCB44 = D_800DF6D4;
L1_D_800DCB4C = D_800DF6DC;
L1_D_800DD7F4 = D_800E0384;
L1_D_800DDC44 = D_800E0388;
L1_D_800DDC48 = D_800E038C;
L1_D_800DDC4C = D_800E0390;
L1_D_800DDC50 = D_800E0394;
L1_D_800DDC54 = D_800E0398;
L1_D_800DDC58 = D_800E039C;
L1_D_800DDC5C = D_800E03A0;
L1_D_800DDC60 = D_800E03A4;
L1_D_800DDC64 = D_800E03A8;
L1_D_800DDC68 = D_800E03AC;
L1_D_800DDC6C = D_800E03B0;
L1_D_800DDCC0 = D_800E0404;
L1_D_800DDCC4 = D_800E0408;
L1_D_800DDCC8 = D_800E040C;
L1_D_800DDCCC = D_800E0410;
L1_D_800DDD8C = D_800E04D0;
L1_D_800DDD90 = D_800E04D4;
L1_D_800DDD94 = D_800E04D8;
L1_D_800DDD98 = D_800E04DC;
L1_D_800DDDA0 = D_800E04E4;
L1_D_800DDDA4 = D_800E04E8;
L1_D_800DDDA8 = D_800E04EC;
L1_D_800DDDAC = D_800E04F0;
L1_D_800DDDB0 = D_800E04F4;
L1_D_800DDDB4 = D_800E04F8;
L1_D_800DDDB8 = D_800E04FC;
L1_D_800DDDBC = D_800E0500;
L1_D_800DDDCC = D_800E0510;
L1_D_800DDDDC = D_800E0520;
L1_D_800DDDEC = D_800E0530;
L1_D_800DDE04 = D_800E0548;
L1_D_800DDE08 = D_800E054C;
L1_D_800DDE10 = D_800E0554;
L1_D_800DDE30 = D_800E0574;
L1_D_800DDE34 = D_800E0578;
L1_D_800DDEE0 = D_800E0624;
L1_D_800DDEE4 = D_800E0628;
L1_D_800DDEE8 = D_800E062C;
L1_D_800DDEEC = D_800E0630;
L1_D_800DDEF0 = D_800E0634;
L1_D_800DDF08 = D_800E064C;
L1_D_800DDF24 = D_800E0668;
L1_D_800DDFEC = D_800E0730;
L1_D_800DE000 = D_800E0744;
L1_D_800DE004 = D_800E0748;
L1_D_800DE018 = D_800E075C;
L1_D_800DE0C4 = D_800E0808;
L1_D_800DE0C8 = D_800E080C;
L1_D_800DE0D4 = D_800E0818;
L1_D_800DE0D8 = D_800E081C;
L1_D_800DE0DC = D_800E0820;
L1_D_800DE0E0 = D_800E0824;
L1_D_800DE0E4 = D_800E0828;
L1_D_800DE0E8 = D_800E0834;
L1_D_800DE8E8 = D_800E1034;
L1_D_800DF0E8 = D_800E1834;
L1_D_800DF0EC = D_800E1838;
L1_D_800DF0F0 = D_800E183C;
L1_D_800DF0F8 = D_800E1844;
L1_D_800DF10C = D_800E1858;
L1_D_800DF12C = D_800E1878;
L1_D_800DF1F4 = D_800E1940;
L1_D_800DF200 = D_800E194C;
L1_D_800DF540 = D_800E1C8C;
L1_D_800DF5B8 = D_800E1D04;
L1_D_800DF684 = D_800E1DD0;
L1_D_800E02B4 = D_800E2A04;
L1_D_800E23D4 = D_800E56B0;
L1_D_800E23E8 = D_800E56C4;
L1_D_800E2438 = D_800E5820;
L1_D_800E2448 = D_800E5830;
L1_D_800E2DA8 = D_800E6190;
L1_D_800E2DBC = D_800E61A4;
L1_D_800E2DE0 = D_800E61C8;
L1_D_800E2DE4 = D_800E61CC;
L1_D_800E2DF4 = D_800E61DC;
L1_D_800E2E44 = D_800E622C;
L1_D_800E2E48 = D_800E6230;
L1_D_800E2E4C = D_800E6234;
L1_D_800E2F2C = D_800E6314;
L1_D_800E2F38 = D_800E6320;
L1_D_800E2F3C = D_800E6324;
L1_D_800E2F54 = D_800E633C;
L1_D_800E2F58 = D_800E6340;
L1_D_800E2F5C = D_800E6344;
L1_D_800F0F5C = D_800F4344;
L1_D_800F0F80 = D_800F4368;
L1_D_800F1180 = D_800F46B0;
L1_D_800F11A0 = D_800F46D0;
L1_D_800F11D0 = D_800F4700;
L1_D_800F11F0 = D_800F4720;
L1_D_800F128C = D_800F47BC;
L1_D_800F1294 = D_800F47C4;
L1_D_800F12D4 = D_800F4804;
L1_D_800F12EC = D_800F481C;
L1_D_800F12F4 = D_800F4824;
L1_D_800F1314 = D_800F4844;
L1_D_800F1354 = D_800F4884;
L1_D_800F136C = D_800F489C;
L1_D_800F1374 = D_800F48A4;
L1_D_800F138C = D_800F48BC;
L1_D_800F1398 = D_800F48C8;
L1_D_800F13A8 = D_800F48D8;
L1_D_800F1DCC = D_800F52FC;
L1_D_800F25D8 = D_800F5B08;
L1_D_800F2FBC = D_800F64EC;
L1_D_800F3848 = D_800F6D78;
L1_D_800F3B48 = D_800F7078;
L1_D_800F3E98 = D_800F73C8;
L1_D_800F40DC = D_800F760C;
L1_D_800F40E0 = D_800F7610;
L1_D_800F40F8 = D_800F7628;
L1_D_800F40FC = D_800F762C;
L1_D_800F4114 = D_800F7644;
L1_D_800F413C = D_800F766C;
L1_D_800F415C = D_800F768C;
L1_D_800F4264 = D_800F7794;
L1_D_800F4268 = D_800F7798;
L1_D_800F426C = D_800F779C;
L1_D_800F4270 = D_800F77A0;
L1_D_800F5A64 = D_800F8F94;
L1_D_800F5A65 = D_800F8F95;
L1_D_800F5A66 = D_800F8F96;
L1_D_800F5A68 = D_800F8F98;
L1_D_800F5A6C = D_800F8F9C;
L1_D_800F6040 = D_800F9570;
L1_D_800F6064 = D_800F9594;
L1_D_800F6068 = D_800F9598;
L1_D_800F606C = D_800F959C;
L1_D_800F6070 = D_800F95A0;
L1_D_800F7664 = D_800FAB94;
L1_D_800F7E64 = D_800FB394;
L1_D_800F7EC4 = D_800FB3F4;
L1_D_800F7EC8 = D_800FB3F8;
L1_D_800F7EC9 = D_800FB3F9;
L1_D_800F7ECA = D_800FB3FA;
L1_D_800F7ECC = D_800FB3FC;
L1_D_800F7ECE = D_800FB3FE;
L1_D_800F7ED0 = D_800FB400;
L1_D_800F7ED2 = D_800FB402;
L1_D_800F7EE4 = D_800FB414;
L1_D_800F7EE8 = D_800FB418;
L1_D_800F7EEC = D_800FB41C;
L1_D_800F7EF4 = D_800FB424;
L1_D_800F7EF8 = D_800FB428;
L1_D_800F7EFC = D_800FB42C;
L1_D_800F7F00 = D_800FB430;
L1_D_800F7F04 = D_800FB434;
L1_D_800F7F08 = D_800FB438;
L1_D_800F7F10 = D_800FB440;
L1_D_800F7F1C = D_800FB44C;
L1_D_800F7F64 = D_800FB494;
L1_D_800F7F68 = D_800FB498;
L1_D_800F7F6C = D_800FB49C;
L1_D_800F7F70 = D_800FB4A0;
L1_D_800F7F74 = D_800FB4A4;
L1_D_800F7F81 = D_800FB4B1;
L1_D_800F7F84 = D_800FB4B4;
L1_D_800F7FCC = D_800FB4FC;
L1_D_800F8014 = D_800FB544;
L1_D_800F81F4 = D_800FB724;
L1_D_800F81F8 = D_800FB728;
L1_D_800F8204 = D_800FB734;
L1_D_800F8208 = D_800FB738;
L1_D_800F8214 = D_800FB744;
L1_D_800F8614 = D_800FBB44;
L1_D_800FC614 = D_800FFB44;
L1_D_800FC616 = D_800FFB46;
L1_D_800FC624 = D_800FFB54;
L1_D_800FC628 = D_800FFB58;
L1_D_800FC62C = D_800FFB5C;
L1_D_800FC630 = D_800FFB60;
L1_D_800FC640 = D_800FFB70;
L1_D_800FC644 = D_800FFB74;
L1_D_800FC648 = D_800FFB78;
L1_D_800FC650 = D_800FFB80;
L1_D_800FC654 = D_800FFB84;
L1_D_800FC658 = D_800FFB88;
L1_D_800FC65C = D_800FFB8C;
L1_D_800FC660 = D_800FFB90;
L1_D_800FC664 = D_800FFB94;
L1_D_800FC670 = D_800FFBA0;
L1_D_800FC67C = D_800FFBAC;
L1_D_800FC6A0 = D_800FFBD0;
L1_D_800FC6B0 = D_800FFBE0;
L1_D_800FC6C0 = D_800FFBF0;
L1_D_800FC780 = D_800FFCB0;
L1_D_800FC784 = D_800FFCB4;
L1_D_800FC788 = D_800FFCB8;
L1_D_800FC790 = D_800FFCC0;
L1_D_800FC794 = D_800FFCC4;
L1_D_800FCF94 = D_801004C4;
L1_D_800FCF98 = D_801004C8;
L1_D_800FCF9C = D_801004CC;
L1_D_800FCFA0 = D_801004D0;
L1_D_800FCFA4 = D_801004D4;
L1_D_800FCFA8 = D_801004D8;
L1_D_800FCFAC = D_801004DC;
L1_D_800FCFB0 = D_801004E0;
L1_D_800FCFB4 = D_801004E4;
L1_D_800FD038 = D_80100568;
L1_D_800FD0B8 = D_801005E8;
L1_D_800FD0F8 = D_80100628;
L1_D_800FD138 = D_80100668;
L1_D_800FD178 = D_801006A8;
L1_D_800FD17C = D_801006AC;
L1_D_800FD190 = D_801006C0;
L1_D_800FD191 = D_801006C1;
L1_D_800FD195 = D_801006C5;
L1_D_800FD197 = D_801006C7;
L1_D_800FD19A = D_801006CA;
L1_D_800FD19B = D_801006CB;
L1_D_800FD19F = D_801006CF;
L1_D_800FD1A1 = D_801006D1;
L1_D_800FD1A2 = D_801006D2;
L1_D_800FD1A4 = D_801006D4;
L1_D_800FD1A6 = D_801006D4 + 0x2;
L1_D_800FD1A8 = D_801006D8;
L1_D_800FD1AC = D_801006DC;
L1_D_800FD1BC = D_801006EC;
L1_D_800FD1C0 = D_801006F0;
L1_D_800FD1C4 = D_801006F4;
L1_D_800FD1C8 = D_801006F8;
L1_D_800FD208 = D_80100738;
L1_D_800FD248 = D_80100778;
L1_D_800FD24C = D_8010077C;
L1_D_800FD254 = D_80100784;
L1_D_800FD258 = D_80100788;
L1_D_800FD25C = D_8010078C;
L1_D_800FD260 = D_80100790;
L1_D_800FD264 = D_80100794;
L1_D_800FD266 = D_80100796;
L1_D_800FD268 = D_80100798;
L1_D_800FD26A = D_8010079A;
L1_D_800FD26C = D_8010079C;
L1_D_800FD3E4 = D_80100914;
L1_D_800FD3E8 = D_80100918;
L1_D_800FD400 = D_80100930;
L1_D_800FD440 = D_80100970;
L1_D_800FD442 = D_80100972;
L1_D_800FD444 = D_80100974;
L1_D_800FD446 = D_80100976;
L1_D_800FD448 = D_80100978;
L1_D_800FD44A = D_8010097A;
L1_D_800FD44C = D_8010097C;
L1_D_800FD44E = D_8010097E;
L1_D_800FD450 = D_80100980;
L1_D_800FD452 = D_80100982;
L1_D_800FD454 = D_80100984;
L1_D_800FD456 = D_80100986;
L1_D_800FD458 = D_80100988;
L1_D_800FD45A = D_8010098A;
L1_D_800FD45D = D_8010098D;
L1_D_800FD45E = D_8010098E;
L1_D_800FD460 = D_80100990;
L1_D_800FD462 = D_80100992;
L1_D_800FD464 = D_80100994;
L1_D_800FD466 = D_80100996;
L1_D_800FD46A = D_8010099A;
L1_D_800FD46C = D_8010099C;
L1_D_800FD46E = D_8010099E;
L1_D_800FD470 = D_801009A0;
L1_D_800FD472 = D_801009A2;
L1_D_800FD476 = D_801009A6;
L1_D_800FD824 = D_80100D54;
L1_D_800FD980 = D_80100EB0;
L1_D_800FD984 = D_80100EB4;
L1_D_800FD988 = D_80100EB8;
L1_D_800FD98C = D_80100EBC;
L1_D_800FD990 = D_80100EC0;
L1_D_800FD994 = D_80100EC4;
L1_D_800FD998 = D_80100EC8;
L1_D_800FD99C = D_80100ECC;
L1_D_800FD9A0 = D_80100ED0;
L1_D_800FD9A4 = D_80100ED4;
L1_D_800FD9AC = D_80100EDC;
L1_D_800FD9C0 = D_80100EF0;
L1_D_800FD9C8 = D_80100EF8;
L1_D_800FD9D0 = D_80100F00;
L1_D_800FD9D8 = D_80100F08;
L1_D_800FD9DC = D_80100F0C;
L1_D_800FD9E0 = D_80100F10;
L1_D_800FD9F4 = D_80100F24;
L1_D_800FDA04 = D_80100F34;
L1_D_800FDA08 = D_80100F38;
L1_D_800FDA0C = D_80100F3C;
L1_D_800FDA24 = D_80100F54;
L1_D_800FDB2C = D_8010105C;
L1_DebugPage_ArtProfile = func_800412C8;
func_800415C0 = L1_DebugPage_Camera;
L1_DebugPage_ContourMask = func_80075F88;
L1_DebugPage_FPWeapon = func_8007B000;
L1_DebugPage_Framerate = func_80041304;
L1_DebugPage_Loadpoint = func_80031CD8;
func_80041350 = L1_DebugPage_ObjectCount;
L1_DebugPage_Profile = func_8004128C;
func_8002FC6C = L1_DebugScreen_DrawPage;
L1_DeliverEvent = func_80095828;
func_80032CE4 = L1_DevMenu_Draw;
func_80032A8C = L1_DevMenu_HandleInput;
func_80032EAC = L1_DevMenu_Init;
L1_DisableEvent = func_8009C7D4;
L1_EVENT_OBJ_11C = func_800876FC;
L1_EVENT_OBJ_90 = func_80087670;
L1_EVENT_OBJ_CC = func_800876AC;
L1_EVENT_OBJ_F4 = func_800876D4;
L1_EnableEvent = func_8008095C;
L1_FlushCache = func_8009CAE4;
L1_FntFlush = func_800897D0;
L1_FntLoad = func_80089478;
L1_FntOpen = func_80089518;
L1_FntPrint = func_80089AEC;
L1_GPU_cw = func_8009020C;
L1_GS_001_OBJ_1F8 = func_80086548;
L1_GS_001_OBJ_74 = func_800863C4;
L1_GS_107_OBJ_4B8 = func_80078A44;
L1_GS_107_OBJ_51C = func_80078AA8;
L1_GetClut = func_80083888;
L1_GetTPage = func_80083908;
func_8002F688 = L1_Gfx_Init;
L1_GsClearOt = func_8008AC58;
L1_GsDefDispBuff = func_8008BF38;
L1_GsGetActiveBuff = func_800868C0;
L1_GsGetHeadpUnit = func_8008FF44;
L1_GsGetLs = func_8007BDE8;
L1_GsGetLsUnit = func_8008E6B0;
L1_GsGetLwUnit = func_8008E980;
L1_GsGetTimInfo = func_8008DAD8;
L1_GsInit3D = func_8008BEB8;
L1_GsInitGraph = func_80086350;
L1_GsInitGraph2 = func_800864E0;
L1_GsInitVcount = func_800877C0;
L1_GsLinkAnim = func_8008FBD8;
L1_GsLinkObject4 = func_80087800;
L1_GsMapCoordUnit = func_8008F1E0;
L1_GsMapModelingData = func_8008D418;
L1_GsMapUnit = func_8008F260;
L1_GsScanAnim = func_8008FB30;
L1_GsScanUnit = func_8008FD8C;
L1_GsSetAmbient = func_800900BC;
L1_GsSetDrawBuffClip = func_80094B80;
L1_GsSetDrawBuffOffset = func_800868D0;
L1_GsSetFlatLight = func_8007858C;
L1_GsSetRefView2 = func_80086AA0;
L1_GsSortClear = func_80086768;
L1_GsSortObject4 = func_8007D104;
L1_GsSortOt = func_80089378;
L1_GsSortUnit = func_8008E4DC;
L1_GsSwapDispBuff = func_8008ACB8;
L1_GsTMDdivF3NL = func_8008C528;
L1_GsTMDdivG3NL = func_8008C718;
L1_GsTMDdivNF3 = func_8008BAC8;
L1_GsTMDdivNG3 = func_8008BCB8;
L1_GsTMDdivTF3L = func_8008C918;
L1_GsTMDdivTF3LFG = func_8008AD68;
L1_GsTMDdivTF3NL = func_8008A338;
L1_GsTMDdivTG3NL = func_8008A5E8;
L1_GsTMDdivTNF3 = func_8008CEC8;
L1_GsTMDdivTNG3 = func_8008D178;
L1_GsTMDfastF3GL = func_8008A838;
L1_GsTMDfastF3GLFG = func_8008BFF8;
L1_GsTMDfastF3GNL = func_8008B598;
L1_GsTMDfastF3L = func_8007E770;
L1_GsTMDfastF3LFG = func_8007E8B8;
L1_GsTMDfastF3NL = func_8007E630;
L1_GsTMDfastG3GL = func_8008AA58;
L1_GsTMDfastG3GLFG = func_8008C218;
L1_GsTMDfastG3GNL = func_8008B958;
L1_GsTMDfastG3L = func_8007E1CC;
L1_GsTMDfastG3LFG = func_8007E35C;
L1_GsTMDfastG3NL = func_8007E08C;
L1_GsTMDfastNF3 = func_8007E4F4;
L1_GsTMDfastNG3 = func_8007DF44;
L1_GsTMDfastTF3L = func_8007DC64;
L1_GsTMDfastTF3LFG = func_8007DDD4;
L1_GsTMDfastTF3NL = func_8007DB00;
L1_GsTMDfastTG3L = func_8007CD98;
L1_GsTMDfastTG3LFG = func_8007CF4C;
L1_GsTMDfastTG3NL = func_8007CC3C;
L1_GsTMDfastTNF3 = func_8007D994;
L1_GsTMDfastTNG3 = func_8007CAC4;
L1_GsU_00000008 = func_8009B0A4;
L1_GsU_00000009 = func_8009B224;
L1_GsU_0000000c = func_8009A764;
L1_GsU_0000000d = func_8009A924;
L1_GsU_0000000f = func_8009AAF4;
L1_GsU_00000209 = func_8009B3B4;
L1_GsU_0000020d = func_8009ACD4;
L1_GsU_00200009 = func_8009B554;
L1_GsU_0020000d = func_8009AEC4;
L1_GsU_01000000 = func_800997C4;
L1_GsU_0100000c = func_80099324;
L1_GsU_0100000d = func_80099594;
L1_GsU_02000000 = func_800991E4;
L1_GsU_02000001 = func_80099274;
L1_GsU_03000000 = D_800998F4;
L1_GsU_03000001 = func_8009A034;
L1_GsU_03000010 = func_8009A214;
L1_GsU_03000011 = func_8009A404;
L1_Gssub_make_matrix = func_8008DEE8;
L1_HookEntryInt = func_80094840;
L1_INTR_DMA_OBJ_1CC = func_80094A1C;
L1_INTR_DMA_OBJ_278 = func_80094AC8;
L1_INTR_DMA_OBJ_4C = func_8009489C;
L1_INTR_VB_OBJ_58 = func_80094748;
L1_INTR_VB_OBJ_C4 = func_800947B4;
L1_INTR_VB_OBJ_F0 = func_800947E0;
L1_ISO9660_OBJ_2D8 = func_8008541C;
L1_ISO9660_OBJ_2F8 = func_8008543C;
L1_ISO9660_OBJ_5BC = func_80085700;
L1_ISO9660_OBJ_660 = func_800857A4;
L1_ISO9660_OBJ_8FC = func_80085A40;
L1_InitGeom = func_800892F0;
L1_InitHeap3 = func_8008D3B8;
L1_LoadClut = func_8008D9F8;
L1_LoadClut2 = func_8008DA68;
L1_LoadTPage = func_800973F8;
func_800762CC = L1_Math_Abs;
func_80076308 = L1_Math_Max;
func_800763BC = L1_Math_Max3;
func_80076354 = L1_Math_Min3;
L1_Menu_ResetState = func_80029064;
L1_MulMatrix = func_8007C448;
L1_MulMatrix2 = func_8007C558;
L1_OpenEvent = func_80080A80;
L1_PADIF_OBJ_120 = func_80096DF8;
L1_PADIF_OBJ_1CC = func_80096EA4;
L1_PADIF_OBJ_290 = func_80096F68;
L1_PADIF_OBJ_48 = func_80096D20;
L1_PADPORTD_OBJ_160 = func_80087C50;
L1_PADPORTD_OBJ_1C8 = func_80087CB8;
L1_PADPORTD_OBJ_2BC = func_80087DAC;
L1_PADPORTD_OBJ_2CC = func_80087DBC;
L1_PADPORTD_OBJ_388 = func_80087E78;
L1_PADPORTD_OBJ_604 = func_800880F4;
L1_PADPORTD_OBJ_63C = func_8008812C;
L1_PADSEQD_OBJ_144 = func_80095C7C;
L1_PADSEQD_OBJ_34 = func_80095B6C;
L1_PADSEQD_OBJ_488 = func_80095FC0;
L1_PATCHGTE_OBJ_DC = D_800973F4;
L1_PCcreat = func_800868A0;
L1_PClseek = func_80085AC4;
L1_PCopen = func_80085124;
L1_PCread = func_800849EC;
L1_PadInitDirect = func_80087AF0;
func_80044E2C = L1_Pad_StickToSpeed;
func_8002F21C = L1_Pad_Update;
func_80041C4C = L1_PauseMenu_Open;
L1_PopMatrix = func_80078C60;
L1_PushMatrix = func_80078BBC;
L1_ResetEntryInt = func_80094B20;
func_8004262C = L1_RestartPrompt_Open;
L1_ReturnFromException = func_80094B10;
L1_RotAverage3 = func_80097F38;
L1_RotAverageNclip3 = func_80097EA8;
L1_RotAverageNclipColorCol3 = func_800988B4;
L1_RotAverageNclipColorDpq3 = func_80097548;
L1_RotAverageNclipColorDpq3_1 = func_800979A0;
L1_RotMatrix = func_8008F610;
L1_RotMatrixY = func_8008DD48;
L1_RotMatrixYXZ = func_8008F8A0;
L1_RotMatrixYXZ_gte = func_8008E2DC;
L1_RotTrans = func_800901DC;
L1_ScaleMatrix = func_8008FF7C;
L1_SetBackColor = func_8009B6F4;
L1_SetColorMatrix = func_80078B8C;
L1_SetDefDispEnv = func_8008C4E8;
L1_SetDefDrawEnv = func_8008C418;
L1_SetDrawMode = func_80083788;
L1_SetDumpFnt = func_80089438;
L1_SetFarColor = func_8009BDF4;
L1_SetLightMatrix = func_8009019C;
L1_SetLineF4 = func_80083768;
L1_SetRotMatrix = func_8009014C;
L1_SetTransMatrix = func_8009017C;
L1_SpuClearReverbWorkArea = func_80095858;
L1_SpuFree = func_80095A78;
L1_SpuGetVoiceEnvelope = func_8009BA64;
L1_SpuInitMalloc = func_8009CB04;
L1_SpuIsTransferCompleted = func_80098A74;
L1_SpuMalloc = func_80098F14;
L1_SpuRead = func_80098A14;
L1_SpuSetCommonAttr = func_800920D4;
L1_SpuSetKey = func_8009BAB4;
L1_SpuSetNoiseClock = func_8009BCA4;
L1_SpuSetTransferMode = func_80098984;
L1_SpuSetTransferStartAddr = func_800989B4;
L1_SpuSetVoiceAttr = func_80094FB8;
L1_SpuStart = func_80092F34;
L1_SquareRoot0 = func_80078AFC;
L1_SquareRoot12 = func_8008E0E8;
L1_SsEnd = func_80087A40;
L1_SsPitchFromNote = func_80091000;
L1_SsSeqCalledTbyT = func_800955B8;
L1_SsSetSerialAttr = func_80083678;
L1_SsSetSerialVol = func_800834CC;
L1_SsSetTickMode = func_800871A0;
L1_SsUtAllKeyOff = func_80087040;
L1_SsVabClose = func_80087990;
L1_SsVabOpenHead = func_8008D958;
L1_SsVabTransBody = func_8008D708;
L1_SsVabTransCompleted = func_8008D7D8;
L1_SsVoKeyOn = func_80083124;
L1_SysDeqIntRP = func_80096BF8;
L1_SysEnqIntRP = func_80096C08;
L1_TestEvent = func_8009CAF4;
L1_TransposeMatrix = func_8008DFB8;
L1_VSYNC_OBJ_178 = func_80085C70;
L1_VS_VH2_OBJ_34 = func_8008D98C;
L1_VSync = func_80085AF8;
func_80075FF8 = L1_Vec_Dot;
func_80076074 = L1_Vec_ProjectXZ;
func_8007611C = L1_Vec_Scale;
L1_WaitEvent = func_8009C7C4;
L1__SN_read = func_8009303C;
L1__SN_write = func_80094C20;
L1__SpuInit = func_80092E4C;
L1__SpuSetAnyVoice = func_8009CB64;
L1__SsGetSeqData = func_8009D164;
L1__SsInit = func_8009021C;
L1__SsReadDeltaValue = func_8009DCA4;
L1__SsSeqGetEof = func_8009CF20;
L1__SsSeqPlay = func_8009CE24;
L1__SsSndCrescendo = func_8009C084;
L1__SsSndNextSep = func_8009DBA4;
L1__SsSndPause = func_8009C4B4;
L1__SsSndPlay = func_8009C054;
L1__SsSndReplay = func_8009C554;
L1__SsSndTempo = func_8009C294;
L1__SsVmAlloc = func_80091E24;
L1__SsVmDoAllocate = func_8009080C;
L1__SsVmFlush = func_8009037C;
L1__SsVmInit = func_8009B714;
L1__SsVmKeyOffNow = func_800915FC;
L1__SsVmKeyOnNow = func_8009112C;
L1__SsVmSelectToneAndVag = func_8009BCF4;
L1__SsVmVSetUp = func_800902BC;
L1__dirFailAuto = func_80095EE0;
L1__gp = D_800AD1F4;
L1__padInitDirSeq = func_80095B38;
L1__patch_gte = func_80097318;
L1__spu_gcSPU = func_8009C7E4;
L1_bzero = func_80095FF8;
L1_calloc3 = func_8008D488;
L1_chkRC2wait = func_80096C38;
L1_exit = func_800838A8;
L1_free3 = func_8008D5B8;
L1_func_80026D08 = func_80026D34;
func_80026EFC = L1_func_80026ED0;
L1_func_80026F30 = func_80026F5C;
func_80027274 = L1_func_80027248;
func_800272D0 = L1_func_800272A4;
func_800273C0 = L1_func_80027394;
PROVIDE(L1_func_800274F4 = func_80027520);
PROVIDE(func_80027520 = L1_func_800274F4);
func_8002839C = L1_func_80028370;
PROVIDE(L1_func_8002847C = func_800284A8);
PROVIDE(func_800284A8 = L1_func_8002847C);
func_800286A4 = L1_func_80028678;
L1_func_800286EC = func_80028718;
func_80028758 = L1_func_8002872C;
func_8002883C = L1_func_80028810;
func_80028884 = L1_func_80028858;
func_80028984 = L1_func_80028958;
L1_func_800289C0 = func_800289EC;
func_80028B84 = L1_func_80028B58;
func_80028C34 = L1_func_80028C08;
func_80028DE8 = L1_func_80028DBC;
func_80029090 = L1_func_80029064;
PROVIDE(L1_func_800291B0 = func_800291DC);
PROVIDE(func_800291DC = L1_func_800291B0);
func_800294E0 = L1_func_800294B4;
func_80029530 = L1_func_80029504;
L1_func_8002967C = func_800296A8;
func_800296B0 = L1_func_80029684;
func_80029894 = L1_func_80029868;
L1_func_800299CC = func_800299F8;
PROVIDE(L1_func_80029A34 = func_80029A60);
PROVIDE(func_80029A60 = L1_func_80029A34);
func_8002A3F4 = L1_func_8002A3C8;
func_8002A648 = L1_func_8002A61C;
func_8002A74C = L1_func_8002A720;
func_8002A880 = L1_func_8002A854;
func_8002AAC0 = L1_func_8002AA94;
L1_func_8002AAC4 = func_8002AAF0;
func_8002AB28 = L1_func_8002AAFC;
func_8002ACBC = L1_func_8002AC90;
L1_func_8002ADF0 = func_8002AE1C;
func_8002AE60 = L1_func_8002AE34;
L1_func_8002AF08 = func_8002AF34;
func_8002B024 = L1_func_8002AFF8;
L1_func_8002B064 = func_8002B090;
func_8002B0CC = L1_func_8002B0A0;
func_8002B1A8 = L1_func_8002B17C;
PROVIDE(L1_func_8002B29C = func_8002B2C8);
PROVIDE(func_8002B2C8 = L1_func_8002B29C);
func_8002B6C8 = L1_func_8002B69C;
L1_func_8002BB34 = func_8002BB60;
func_8002BB94 = L1_func_8002BB68;
func_8002BC44 = L1_func_8002BC18;
func_8002BE50 = L1_func_8002BE24;
func_8002BF60 = L1_func_8002BF34;
func_8002C194 = L1_func_8002C168;
L1_func_8002C2D8 = func_8002C304;
func_8002C4BC = L1_func_8002C490;
L1_func_8002C664 = func_8002C690;
func_8002C6E8 = L1_func_8002C6BC;
L1_func_8002C83C = func_8002C868;
L1_func_8002C844 = func_8002C870;
func_8002D11C = L1_func_8002D0F0;
func_8002D200 = L1_func_8002D1D4;
func_8002D510 = L1_func_8002D4E4;
func_8002D630 = L1_func_8002D604;
func_8002D734 = L1_func_8002D708;
func_8002DD30 = L1_func_8002DD6C;
L1_func_8002E0E8 = func_8002E0B8;
L1_func_8002E190 = func_8002E160;
func_8002E180 = L1_func_8002E1B0;
func_8002E2F4 = L1_func_8002E318;
L1_func_8002E3A0 = func_8002E37C;
L1_func_8002E410 = func_8002E3EC;
L1_func_8002E430 = func_8002E40C;
L1_func_8002E48C = func_8002E468;
L1_func_8002E4B4 = func_8002E490;
L1_func_8002E4D4 = func_8002E4B0;
func_8002E4B8 = L1_func_8002E4DC;
L1_func_8002E534 = func_8002E510;
L1_func_8002E5C4 = func_8002E5A0;
PROVIDE(L1_func_8002E798 = func_8002E77C);
PROVIDE(func_8002E77C = L1_func_8002E798);
L1_func_8002F0A4 = func_8002F088;
L1_func_8002F114 = func_8002F0F8;
L1_func_8002F53C = func_8002F520;
func_8002F548 = L1_func_8002F564;
func_8002F608 = L1_func_8002F624;
L1_func_8002F7CC = func_8002F7B0;
PROVIDE(L1_func_8002FFD8 = func_8002FF9C);
PROVIDE(func_8002FF9C = L1_func_8002FFD8);
func_800300DC = L1_func_80030118;
func_80030270 = L1_func_800302AC;
L1_func_80030304 = func_800302C8;
L1_func_80030324 = func_800302E8;
func_800302F8 = L1_func_80030334;
func_80030378 = L1_func_800303B4;
PROVIDE(L1_func_8003052C = func_800304F0);
PROVIDE(func_800304F0 = L1_func_8003052C);
L1_func_800305B4 = func_80030578;
L1_func_80030610 = func_800305D4;
func_80030634 = L1_func_80030670;
L1_func_800306A8 = func_8003066C;
L1_func_800306F0 = func_800306B4;
func_8003075C = L1_func_80030798;
L1_func_80030868 = func_8003082C;
PROVIDE(L1_func_80030994 = func_80030958);
PROVIDE(func_80030958 = L1_func_80030994);
func_80030AC8 = L1_func_80030B04;
func_80030CCC = L1_func_80030D08;
func_80030D64 = L1_func_80030DA0;
L1_func_80030EB0 = func_80030E74;
func_80030EE4 = L1_func_80030F20;
func_80030F6C = L1_func_80030FA8;
L1_func_800310B4 = func_80031078;
func_800314B0 = L1_func_800314A0;
func_80031688 = L1_func_80031678;
L1_func_80031F18 = func_80031F28;
func_80032084 = L1_func_80032074;
func_80032200 = L1_func_800321F0;
func_8003261C = L1_func_8003246C;
L1_func_800324C0 = func_80032670;
func_80032680 = L1_func_800324D0;
L1_func_80032648 = func_800327F8;
func_800328D4 = L1_func_80032724;
func_80032918 = L1_func_80032768;
L1_func_80032880 = func_80032A30;
func_80032FFC = L1_func_80032E4C;
PROVIDE(L1_func_80032EFC = func_800330AC);
PROVIDE(func_800330AC = L1_func_80032EFC);
func_80033240 = L1_func_80033090;
func_80033454 = L1_func_800332A4;
func_800334F8 = L1_func_80033348;
func_80033584 = L1_func_800333D4;
func_800335D0 = L1_func_800334F4;
L1_func_80033F38 = func_8003440C;
func_80034E6C = L1_func_80034998;
func_80034ECC = L1_func_800349F8;
func_80035504 = L1_func_80035030;
L1_func_800350F0 = func_800355C4;
PROVIDE(L1_func_800352B8 = func_8003578C);
PROVIDE(func_8003578C = L1_func_800352B8);
func_80035E38 = L1_func_80035964;
func_80035EC0 = L1_func_800359EC;
func_80036090 = L1_func_80035BBC;
func_800362BC = L1_func_80035DE8;
func_800363D8 = L1_func_80035F04;
func_80036690 = L1_func_800361BC;
func_800367FC = L1_func_80036328;
func_80036A88 = L1_func_800365B4;
func_80036B44 = L1_func_80036670;
L1_func_800368A8 = func_80036D7C;
L1_func_80036938 = func_80036E0C;
func_800372DC = L1_func_80036E10;
L1_func_800373FC = func_800378C8;
func_80037C20 = L1_func_80037768;
func_80037CAC = L1_func_800377F4;
func_80037DB4 = L1_func_800378FC;
func_80037EDC = L1_func_80037A24;
func_80037F84 = L1_func_80037ACC;
L1_func_80037B6C = func_80038024;
func_80038540 = L1_func_800380DC;
PROVIDE(L1_func_800381CC = func_80038630);
PROVIDE(func_80038630 = L1_func_800381CC);
func_80038868 = L1_func_80038404;
func_80038B90 = L1_func_8003872C;
func_80039188 = L1_func_80038984;
func_80039484 = L1_func_80038C04;
func_8003950C = L1_func_80038C8C;
L1_func_800390F8 = func_80039978;
PROVIDE(L1_func_800391B0 = func_80039A30);
PROVIDE(func_80039A30 = L1_func_800391B0);
L1_func_800393AC = func_80039C2C;
func_80039C64 = L1_func_800393E4;
L1_func_80039520 = func_80039DA0;
L1_func_800395E8 = func_80039E68;
func_8003A000 = L1_func_800397A8;
PROVIDE(L1_func_8003982C = func_8003A084);
PROVIDE(func_8003A084 = L1_func_8003982C);
func_8003A28C = L1_func_80039A34;
PROVIDE(L1_func_80039A9C = func_8003A2F4);
PROVIDE(func_8003A2F4 = L1_func_80039A9C);
PROVIDE(L1_func_8003A51C = func_8003AD74);
PROVIDE(func_8003AD74 = L1_func_8003A51C);
PROVIDE(L1_func_8003A68C = func_8003AEE4);
PROVIDE(func_8003AEE4 = L1_func_8003A68C);
L1_func_8003A71C = func_8003AF74;
func_8003B0F0 = L1_func_8003A898;
func_8003B26C = L1_func_8003AA14;
PROVIDE(L1_func_8003AC1C = func_8003B474);
PROVIDE(func_8003B474 = L1_func_8003AC1C);
func_8003BD4C = L1_func_8003B4F4;
PROVIDE(L1_func_8003B53C = func_8003BD94);
PROVIDE(func_8003BD94 = L1_func_8003B53C);
L1_func_8003B750 = func_8003BFA8;
PROVIDE(L1_func_8003B808 = func_8003C064);
PROVIDE(func_8003C064 = L1_func_8003B808);
func_8003C19C = L1_func_8003B940;
func_8003C4F4 = L1_func_8003BC98;
func_8003C6C4 = L1_func_8003BE68;
func_8003C814 = L1_func_8003BFB8;
L1_func_8003C1BC = func_8003CA18;
func_8003CF74 = L1_func_8003C6B0;
func_8003CFA8 = L1_func_8003C6E4;
func_8003D150 = L1_func_8003C88C;
func_8003D168 = L1_func_8003C8A4;
func_8003D288 = L1_func_8003C9C4;
L1_func_8003CA4C = func_8003D310;
func_8003D380 = L1_func_8003CABC;
L1_func_8003CC8C = func_8003D550;
PROVIDE(L1_func_8003D76C = func_8003DFC0);
PROVIDE(func_8003DFC0 = L1_func_8003D76C);
func_8003E6AC = L1_func_8003DE58;
func_8003E9AC = L1_func_8003E158;
func_8003ECE8 = L1_func_8003E494;
PROVIDE(L1_func_8003E5A0 = func_8003EDF4);
PROVIDE(func_8003EDF4 = L1_func_8003E5A0);
func_8003F278 = L1_func_8003EA24;
func_8003F354 = L1_func_8003EB00;
PROVIDE(L1_func_8003EC44 = func_8003F498);
PROVIDE(func_8003F498 = L1_func_8003EC44);
func_8003FFBC = L1_func_8003F768;
func_800407C8 = L1_func_8003FF9C;
L1_func_8004009C = func_800408C8;
PROVIDE(L1_func_80040778 = func_80040E08);
PROVIDE(func_80040E08 = L1_func_80040778);
func_80041008 = L1_func_80040978;
func_80041138 = L1_func_80040AA8;
func_800416EC = L1_func_8004105C;
func_8004184C = L1_func_800411BC;
L1_func_8004133C = func_800419CC;
func_80041A84 = L1_func_800413F4;
L1_func_800414AC = func_80041B3C;
L1_func_80041578 = func_80041C08;
func_80041E54 = L1_func_800417C4;
L1_func_800419CC = func_80042120;
func_8004218C = L1_func_80041A38;
func_800422F4 = L1_func_80041BA0;
func_8004237C = L1_func_80041C28;
func_80042444 = L1_func_80041CF0;
func_80042510 = L1_func_80041DBC;
func_800425CC = L1_func_80041E78;
func_80042774 = L1_func_80042020;
func_800428E0 = L1_func_8004218C;
PROVIDE(L1_func_800425E4 = func_80042D38);
PROVIDE(func_80042D38 = L1_func_800425E4);
L1_func_80042A94 = func_800431E8;
L1_func_80042B28 = func_8004327C;
func_80043470 = L1_func_80042D1C;
L1_func_80042E34 = func_80043588;
L1_func_80042E6C = func_800435C0;
func_800437CC = L1_func_80043078;
func_80043954 = L1_func_80043200;
L1_func_800433A8 = func_80043AFC;
L1_func_800433F4 = func_80043B48;
PROVIDE(L1_func_80043610 = func_80043D64);
PROVIDE(func_80043D64 = L1_func_80043610);
PROVIDE(L1_func_80043B14 = func_80044268);
PROVIDE(func_80044268 = L1_func_80043B14);
L1_func_80043EE0 = func_80044634;
func_80044FD4 = L1_func_800448F4;
L1_func_80044B3C = func_8004521C;
L1_func_80044BAC = func_8004528C;
L1_func_80044BBC = func_8004529C;
PROVIDE(L1_func_80044BCC = func_80045574);
PROVIDE(func_80045574 = L1_func_80044BCC);
func_80045A2C = L1_func_80045084;
func_80045B94 = L1_func_8004514C;
func_80045D8C = L1_func_80045344;
func_80046114 = L1_func_800456D0;
PROVIDE(L1_func_80045A28 = func_8004646C);
PROVIDE(func_8004646C = L1_func_80045A28);
func_80046CB0 = L1_func_8004626C;
PROVIDE(L1_func_800463C8 = func_80046E0C);
PROVIDE(func_80046E0C = L1_func_800463C8);
func_80047D5C = L1_func_80047318;
PROVIDE(L1_func_800474AC = func_80047EF0);
PROVIDE(func_80047EF0 = L1_func_800474AC);
func_80048000 = L1_func_800475BC;
L1_func_800477C0 = func_80048204;
L1_func_8004782C = func_80048270;
L1_func_8004783C = func_80048280;
func_80048448 = L1_func_80047A04;
func_80048594 = L1_func_80047B50;
func_80048800 = L1_func_80047DBC;
L1_func_80047ECC = func_80048910;
func_80048E20 = L1_func_800483D8;
func_80048E64 = L1_func_8004841C;
PROVIDE(L1_func_80048794 = func_800491DC);
PROVIDE(func_800491DC = L1_func_80048794);
func_80049594 = L1_func_80048B4C;
func_8004982C = L1_func_80048DE4;
func_800498A8 = L1_func_80048E60;
L1_func_80048FE8 = func_80049A30;
L1_func_8004900C = func_80049A54;
func_80049E08 = L1_func_800493C0;
func_80049EB8 = L1_func_80049470;
func_8004A184 = L1_func_8004973C;
func_8004A32C = L1_func_800498E4;
func_8004A4D0 = L1_func_80049A88;
L1_func_80049B7C = func_8004A5C4;
func_8004A5CC = L1_func_80049B84;
PROVIDE(L1_func_80049D60 = func_8004A7A8);
PROVIDE(func_8004A7A8 = L1_func_80049D60);
L1_func_8004A294 = func_8004ACDC;
L1_func_8004A29C = func_8004ACE4;
L1_func_8004A304 = func_8004AD4C;
L1_func_8004A338 = func_8004AD80;
L1_func_8004A370 = func_8004ADB8;
L1_func_8004A380 = func_8004ADC8;
L1_func_8004A398 = func_8004ADE0;
L1_func_8004A81C = func_8004B21C;
L1_func_8004A85C = func_8004B25C;
L1_func_8004A8A8 = func_8004B2A8;
func_8004B2E4 = L1_func_8004A8E4;
PROVIDE(L1_func_8004A9E4 = func_8004B3E4);
PROVIDE(func_8004B3E4 = L1_func_8004A9E4);
func_8004B90C = L1_func_8004AF0C;
L1_func_8004B028 = func_8004BA28;
L1_func_8004B04C = func_8004BA4C;
L1_func_8004B06C = func_8004BA6C;
L1_func_8004B084 = func_8004BA84;
func_8004BAB0 = L1_func_8004B0B0;
func_8004BB94 = L1_func_8004B194;
L1_func_8004B270 = func_8004BC70;
L1_func_8004B334 = func_8004D234;
func_8004D2BC = L1_func_8004B3BC;
func_8004D48C = L1_func_8004B58C;
func_8004D8FC = L1_func_8004B9FC;
func_8004DA00 = L1_func_8004BB00;
func_8004DB70 = L1_func_8004BC70;
func_8004DCA8 = L1_func_8004BDA8;
L1_func_8004BE84 = func_8004DD84;
L1_func_8004BF70 = func_8004DE70;
func_8004DFC0 = L1_func_8004C0C0;
PROVIDE(L1_func_8004C368 = func_8004E268);
PROVIDE(func_8004E268 = L1_func_8004C368);
func_8004E398 = L1_func_8004C498;
L1_func_8004C50C = func_8004E40C;
func_8004E458 = L1_func_8004C558;
L1_func_8004C5C8 = func_8004E4C8;
L1_func_8004C698 = func_8004E598;
L1_func_8004C768 = func_8004E668;
L1_func_8004C824 = func_8004E724;
func_8004E72C = L1_func_8004C82C;
func_8004E844 = L1_func_8004C944;
func_8004E95C = L1_func_8004CA5C;
func_8004EA2C = L1_func_8004CB2C;
func_8004EAF4 = L1_func_8004CBF4;
func_8004EBD8 = L1_func_8004CCD8;
func_8004EC14 = L1_func_8004CD14;
func_8004ECA0 = L1_func_8004CDA0;
L1_func_8004CE38 = func_8004ED38;
func_8004ED74 = L1_func_8004CE74;
func_8004EE00 = L1_func_8004CF00;
PROVIDE(L1_func_8004D048 = func_8004EF48);
PROVIDE(func_8004EF48 = L1_func_8004D048);
func_8004F114 = L1_func_8004D214;
func_8004F1D0 = L1_func_8004D2D0;
L1_func_8004D5A8 = func_8004F4A8;
func_8004F62C = L1_func_8004D72C;
func_8004F670 = L1_func_8004D770;
func_8004F744 = L1_func_8004D844;
func_8004F78C = L1_func_8004D88C;
func_8004F878 = L1_func_8004D978;
func_8004F960 = L1_func_8004DA60;
func_8004FACC = L1_func_8004DBCC;
func_8004FC9C = L1_func_8004DD9C;
func_8004FEF8 = L1_func_8004DFF8;
func_8004FF7C = L1_func_8004E07C;
func_80050204 = L1_func_8004E304;
func_80050228 = L1_func_8004E328;
L1_func_8004E37C = func_8005027C;
PROVIDE(L1_func_8004E5D8 = func_800503D4);
PROVIDE(func_800503D4 = L1_func_8004E5D8);
L1_func_8004E78C = func_80050588;
func_80050590 = L1_func_8004E794;
func_80050698 = L1_func_8004E89C;
func_80050768 = L1_func_8004E96C;
func_800507A8 = L1_func_8004E9AC;
L1_func_8004EA68 = func_80050864;
func_800508B4 = L1_func_8004EAB8;
func_8005091C = L1_func_8004EB20;
func_80050A6C = L1_func_8004EC70;
func_80050D40 = L1_func_8004EF44;
L1_func_8004F134 = func_80050F30;
func_80050F44 = L1_func_8004F148;
func_80051144 = L1_func_8004F348;
L1_func_8004F3D8 = func_800511D4;
PROVIDE(L1_func_8004F3E8 = func_800511E4);
PROVIDE(func_800511E4 = L1_func_8004F3E8);
PROVIDE(L1_func_8004F880 = func_8005167C);
PROVIDE(func_8005167C = L1_func_8004F880);
PROVIDE(L1_func_8004FD3C = func_80051B38);
PROVIDE(func_80051B38 = L1_func_8004FD3C);
func_80051F7C = L1_func_80050180;
func_80052188 = L1_func_8005038C;
PROVIDE(L1_func_800503D8 = func_800521D4);
PROVIDE(func_800521D4 = L1_func_800503D8);
func_8005275C = L1_func_80050960;
func_80052798 = L1_func_8005099C;
func_800527E0 = L1_func_800509E4;
func_8005280C = L1_func_80050A10;
PROVIDE(L1_func_80050A70 = func_8005286C);
PROVIDE(func_8005286C = L1_func_80050A70);
func_80053524 = L1_func_80051728;
func_800540EC = L1_func_800523E4;
func_80054338 = L1_func_80052630;
func_80054510 = L1_func_80052808;
func_80054834 = L1_func_80052B2C;
L1_func_80052BEC = func_800548F4;
func_80054B58 = L1_func_80053004;
func_80054BD4 = L1_func_80053080;
func_8005518C = L1_func_80053684;
L1_func_800536F0 = func_800551F8;
L1_func_80053790 = func_80055298;
func_8005530C = L1_func_80053804;
func_80055484 = L1_func_8005397C;
func_80055534 = L1_func_80053A2C;
func_80055584 = L1_func_80053A7C;
func_8005566C = L1_func_80053B64;
L1_func_80053BD0 = func_800556D8;
func_800556E8 = L1_func_80053BE0;
func_800558EC = L1_func_80053DE4;
func_800559E0 = L1_func_80053ED8;
func_80055C98 = L1_func_80054098;
func_80055CCC = L1_func_800540CC;
func_80055D18 = L1_func_80054118;
func_80055D6C = L1_func_8005416C;
func_80055E68 = L1_func_80054268;
func_80055F0C = L1_func_8005430C;
func_80055FBC = L1_func_800543BC;
L1_func_80054414 = func_80056014;
func_80056290 = L1_func_80054604;
func_80056328 = L1_func_8005469C;
func_80056450 = L1_func_800547C4;
func_800564C8 = L1_func_8005483C;
func_800565F0 = L1_func_80054964;
func_80056754 = L1_func_80054AC8;
func_80056884 = L1_func_80054BF8;
func_80056A30 = L1_func_80054DA4;
func_80056AC4 = L1_func_80054E38;
func_80056BC0 = L1_func_80054F34;
func_80056C68 = L1_func_80054FDC;
func_80056CEC = L1_func_80055060;
func_80056DF8 = L1_func_8005516C;
func_80056E90 = L1_func_80055204;
func_80056F28 = L1_func_8005529C;
func_80056F88 = L1_func_800552FC;
func_80056FE8 = L1_func_8005535C;
func_8005704C = L1_func_800553C0;
func_8005719C = L1_func_80055510;
func_80057224 = L1_func_80055598;
func_800572FC = L1_func_80055670;
func_80057454 = L1_func_800557C8;
PROVIDE(L1_func_800557F4 = func_80057480);
PROVIDE(func_80057480 = L1_func_800557F4);
func_800574A0 = L1_func_80055814;
PROVIDE(L1_func_80055878 = func_80057504);
PROVIDE(func_80057504 = L1_func_80055878);
PROVIDE(L1_func_80055BA8 = func_80057834);
PROVIDE(func_80057834 = L1_func_80055BA8);
func_80057AB0 = L1_func_80055E24;
func_80057BE4 = L1_func_80055F58;
func_80057CE0 = L1_func_80056054;
func_80057D9C = L1_func_80056110;
PROVIDE(L1_func_80056154 = func_80057DE0);
PROVIDE(func_80057DE0 = L1_func_80056154);
func_80057FE4 = L1_func_80056358;
func_80058048 = L1_func_800563BC;
func_800580D0 = L1_func_80056444;
func_80058138 = L1_func_800564AC;
func_800581C4 = L1_func_80056538;
func_800581FC = L1_func_80056570;
func_80058268 = L1_func_800565DC;
func_800582A0 = L1_func_80056614;
func_80058384 = L1_func_800566F8;
func_800584C8 = L1_func_8005683C;
func_80058520 = L1_func_80056894;
func_800589A8 = L1_func_80056D1C;
func_80058C1C = L1_func_80056F90;
func_80058D00 = L1_func_80057074;
func_80058D84 = L1_func_800570F8;
func_80058E20 = L1_func_80057194;
func_80058E44 = L1_func_800571B8;
PROVIDE(L1_func_800572F4 = func_80058F80);
PROVIDE(func_80058F80 = L1_func_800572F4);
func_80059030 = L1_func_800573A4;
func_8005909C = L1_func_80057410;
func_800590C8 = L1_func_8005743C;
func_80059108 = L1_func_8005747C;
func_80059288 = L1_func_800575FC;
L1_func_80057648 = func_800592D4;
PROVIDE(L1_func_80057750 = func_800593DC);
PROVIDE(func_800593DC = L1_func_80057750);
func_8005973C = L1_func_80057AB0;
L1_func_80057AD8 = func_80059764;
func_800597B8 = L1_func_80057B2C;
L1_func_80057B94 = func_80059820;
L1_func_80057BFC = func_80059888;
func_800598CC = L1_func_80057C40;
PROVIDE(L1_func_80057E80 = func_80059B0C);
PROVIDE(func_80059B0C = L1_func_80057E80);
L1_func_80058694 = func_8005A320;
func_8005A4E8 = L1_func_8005885C;
func_8005A6E4 = L1_func_80058A58;
func_8005A79C = L1_func_80058B10;
func_8005A7F8 = L1_func_80058B6C;
func_8005A98C = L1_func_80058D00;
func_8005A9E8 = L1_func_80058D5C;
func_8005AA88 = L1_func_8005AD6C;
L1_func_8005ADB0 = func_8005AACC;
PROVIDE(L1_func_8005ADD4 = func_8005AAF0);
PROVIDE(func_8005AAF0 = L1_func_8005ADD4);
PROVIDE(L1_func_8005AEF8 = func_8005AC14);
PROVIDE(func_8005AC14 = L1_func_8005AEF8);
func_8005B224 = L1_func_8005B508;
func_8005B2A0 = L1_func_8005B584;
func_8005B2C8 = L1_func_8005B5AC;
func_8005B3E8 = L1_func_8005B6CC;
func_8005B488 = L1_func_8005B76C;
func_8005B4D8 = L1_func_8005B7BC;
func_8005B588 = L1_func_8005B86C;
func_8005B688 = L1_func_8005B96C;
func_8005B74C = L1_func_8005BA30;
func_8005B804 = L1_func_8005BAE8;
func_8005B99C = L1_func_8005BC80;
func_8005BC0C = L1_func_8005BEF0;
func_8005BE28 = L1_func_8005C10C;
PROVIDE(L1_func_8005C214 = func_8005BF30);
PROVIDE(func_8005BF30 = L1_func_8005C214);
func_8005C058 = L1_func_8005C33C;
L1_func_8005C864 = func_8005C580;
L1_func_8005C894 = func_8005C5B0;
func_8005C5E0 = L1_func_8005C8C4;
func_8005C73C = L1_func_8005CA20;
L1_func_8005CB38 = func_8005C854;
func_8005CB30 = L1_func_8005CED0;
PROVIDE(L1_func_8005CFC8 = func_8005CC28);
PROVIDE(func_8005CC28 = L1_func_8005CFC8);
func_8005CF10 = L1_func_8005D2B0;
L1_func_8005D58C = func_8005D1EC;
func_8005D224 = L1_func_8005D5C4;
func_8005D290 = L1_func_8005D630;
L1_func_8005D654 = func_8005D2B4;
func_8005D2F4 = L1_func_8005D694;
func_8005D3C0 = L1_func_8005D760;
L1_func_8005DA90 = func_8005D6F0;
PROVIDE(L1_func_8005DB7C = func_8005D7DC);
PROVIDE(func_8005D7DC = L1_func_8005DB7C);
func_8005D8A0 = L1_func_8005DC40;
L1_func_8005DF40 = func_8005DBA0;
func_8005DBDC = L1_func_8005DF7C;
func_8005DC80 = L1_func_8005E020;
func_8005DE88 = L1_func_8005E228;
PROVIDE(L1_func_8005E424 = func_8005E084);
PROVIDE(func_8005E084 = L1_func_8005E424);
func_8005E73C = L1_func_8005EADC;
func_8005E7CC = L1_func_8005EB6C;
func_8005EA2C = L1_func_8005EC84;
func_8005EBA0 = L1_func_8005EE6C;
L1_func_8005F3B0 = func_8005F0DC;
func_8005F614 = L1_func_8005F93C;
func_8005F780 = L1_func_8005FAA8;
L1_func_80060094 = func_8005FD5C;
func_80060104 = L1_func_8006043C;
func_80060178 = L1_func_800604B0;
L1_func_8006060C = func_800602D4;
func_800602DC = L1_func_80060614;
func_80060460 = L1_func_80060798;
func_800605AC = L1_func_800608E4;
func_80060788 = L1_func_80060AC0;
L1_func_80060E28 = func_80060ADC;
L1_func_80061018 = func_80060C80;
PROVIDE(L1_func_80061068 = func_80060D14);
PROVIDE(func_80060D14 = L1_func_80061068);
func_80061274 = L1_func_800615C8;
L1_func_80061700 = func_800613AC;
func_800613B4 = L1_func_80061708;
L1_func_80061DC0 = func_800619E4;
func_80061AE8 = L1_func_80061EC4;
L1_func_80061F38 = func_80061B5C;
L1_func_80061FB4 = func_80061BD8;
func_80061F20 = L1_func_80062300;
func_80061FB4 = L1_func_80062394;
func_800623A4 = L1_func_80062784;
func_80062788 = L1_func_80062B68;
func_80062B58 = L1_func_80062F38;
PROVIDE(L1_func_80062FAC = func_80062BCC);
PROVIDE(func_80062BCC = L1_func_80062FAC);
func_80062E50 = L1_func_800632AC;
func_80062F54 = L1_func_800633B0;
func_80063064 = L1_func_800634C0;
func_8006325C = L1_func_800636B8;
func_80063354 = L1_func_800637B0;
L1_func_80063858 = func_800633FC;
L1_func_80063ADC = func_80063680;
func_800636C4 = L1_func_80063B20;
func_80063850 = L1_func_80063CAC;
func_800638E4 = L1_func_80063D40;
L1_func_80063ED4 = func_80063A78;
L1_func_80063EF8 = func_80063A9C;
func_80063AD8 = L1_func_80063F34;
func_80063B28 = L1_func_80063F84;
func_80063CD0 = L1_func_8006412C;
func_80063E60 = L1_func_8006439C;
func_80063FA0 = L1_func_800644DC;
func_800640E0 = L1_func_8006461C;
func_80064124 = L1_func_80064660;
func_80064310 = L1_func_8006484C;
func_80064690 = L1_func_80064A10;
func_800648A8 = L1_func_80064C28;
L1_func_80064E40 = func_80064AC0;
func_80064D34 = L1_func_80065510;
L1_func_80065588 = func_80064DAC;
func_80064DDC = L1_func_800655B8;
func_80064E38 = L1_func_80065614;
L1_func_800658B4 = func_800650D8;
func_8006514C = L1_func_80065928;
PROVIDE(L1_func_80065A20 = func_80065244);
PROVIDE(func_80065244 = L1_func_80065A20);
L1_func_80066098 = func_800658BC;
func_80065AA0 = L1_func_800662A8;
func_80065CB0 = L1_func_800664B8;
func_80065EFC = L1_func_80066704;
L1_func_8006692C = func_80066124;
L1_func_80066968 = func_80066160;
func_8006619C = L1_func_800669A4;
L1_func_80066A60 = func_80066258;
L1_func_80066B14 = func_80066490;
L1_func_80067F18 = func_800680BC;
func_800691F4 = L1_func_800689F0;
L1_func_80069318 = func_8006977C;
L1_func_80069328 = func_8006978C;
L1_func_800693DC = func_8006984C;
func_8006985C = L1_func_80069478;
L1_func_8006981C = func_80069CFC;
L1_func_80069850 = func_80069E1C;
L1_func_800698B8 = func_80069E84;
L1_func_8006B198 = func_8006C338;
L1_func_8006B1DC = func_8006C37C;
L1_func_8006B230 = func_8006C3D0;
func_8006C414 = L1_func_8006B274;
PROVIDE(L1_func_8006B2C4 = func_8006C464);
PROVIDE(func_8006C464 = L1_func_8006B2C4);
func_8006D634 = L1_func_8006C494;
func_8006DA94 = L1_func_8006C8F4;
PROVIDE(L1_func_8006CB88 = func_8006DD28);
PROVIDE(func_8006DD28 = L1_func_8006CB88);
PROVIDE(L1_func_8006CEA4 = func_8006E044);
PROVIDE(func_8006E044 = L1_func_8006CEA4);
func_8006E560 = L1_func_8006D3C0;
PROVIDE(L1_func_8006D470 = func_8006E610);
PROVIDE(func_8006E610 = L1_func_8006D470);
func_8006EEC0 = L1_func_8006DD20;
PROVIDE(L1_func_8006E054 = func_8006F1F4);
PROVIDE(func_8006F1F4 = L1_func_8006E054);
func_8006F7C0 = L1_func_8006E620;
func_8006FB80 = L1_func_8006E9E0;
func_8006FE5C = L1_func_8006ECBC;
func_80070048 = L1_func_8006EEA8;
func_800701D4 = L1_func_8006F034;
PROVIDE(L1_func_8006F168 = func_80070308);
PROVIDE(func_80070308 = L1_func_8006F168);
func_8007084C = L1_func_8006F6AC;
PROVIDE(L1_func_8006F784 = func_80070924);
PROVIDE(func_80070924 = L1_func_8006F784);
func_80070B44 = L1_func_8006F9A4;
func_80070BF4 = L1_func_8006FA54;
func_80070CA4 = L1_func_8006FB04;
func_80071074 = L1_func_8006FED4;
func_80071210 = L1_func_80070070;
func_8007146C = L1_func_800702CC;
func_80071748 = L1_func_800705A8;
func_80071890 = L1_func_800706F0;
func_800727D8 = L1_func_80071638;
PROVIDE(L1_func_80072190 = func_80073330);
PROVIDE(func_80073330 = L1_func_80072190);
func_800735AC = L1_func_8007240C;
PROVIDE(L1_func_800726D0 = func_80073870);
PROVIDE(func_80073870 = L1_func_800726D0);
func_80073EE8 = L1_func_80072D48;
func_80073FC8 = L1_func_80072E28;
PROVIDE(L1_func_8007369C = func_8007483C);
PROVIDE(func_8007483C = L1_func_8007369C);
func_80075588 = L1_func_800743E8;
PROVIDE(L1_func_800746D0 = func_80075870);
PROVIDE(func_80075870 = L1_func_800746D0);
func_80076188 = L1_func_80074FE8;
func_80076460 = L1_func_800752C0;
PROVIDE(L1_func_800752E8 = func_80076488);
PROVIDE(func_80076488 = L1_func_800752E8);
L1_func_800753A4 = func_80076544;
L1_func_800753F0 = func_80076590;
func_800765FC = L1_func_8007545C;
func_8007675C = L1_func_800755BC;
func_8007681C = L1_func_8007567C;
func_80076960 = L1_func_800757C0;
L1_func_800758C0 = func_80076A60;
func_80076A90 = L1_func_800758F0;
func_80076AC0 = L1_func_80075920;
func_80076EE8 = L1_func_80075D48;
func_8007703C = L1_func_80075E9C;
func_800770C0 = L1_func_80075F20;
L1_func_80075FA0 = func_80077140;
L1_func_80075FE4 = func_80077184;
func_800771B4 = L1_func_80076014;
L1_func_800760B4 = func_80077254;
func_800772A4 = L1_func_80076104;
func_80077324 = L1_func_80076184;
L1_func_80076A8C = func_80077B90;
L1_func_80077764 = func_80078D0C;
L1_func_800779FC = func_80078FA4;
L1_func_80077CCC = func_80079274;
L1_func_80077D50 = func_800792F8;
L1_func_80077FC4 = func_8007956C;
L1_func_800781B4 = func_8007975C;
L1_func_80078534 = func_80079ADC;
L1_func_800785A8 = func_80079B50;
L1_func_800787FC = func_80079DA4;
L1_func_80078840 = func_80079DE8;
L1_func_800788E0 = func_80079E88;
L1_func_800792B8 = func_8007ACE4;
L1_func_80079390 = func_8007ADBC;
L1_func_800793EC = func_8007AF00;
L1_func_800794A0 = func_8007AFB4;
L1_func_800794D4 = func_8007AFE8;
L1_func_80079588 = func_8007B09C;
L1_func_800797A8 = func_8007B2BC;
L1_func_8007980C = func_8007B30C;
L1_func_800798A8 = func_8007B3D4;
L1_func_800798D4 = func_8007B42C;
L1_func_80079B94 = func_8007B6EC;
L1_func_80079C04 = func_8007B75C;
L1_func_80079C54 = func_8007B7AC;
L1_func_80079D84 = func_8007B8DC;
L1_func_80079DB8 = func_8007B928;
L1_func_80079E10 = func_8007B980;
L1_func_80079F84 = func_8007BAF4;
L1_func_8007A040 = func_8007BBE8;
L1_func_8007A17C = func_8007BD24;
L1_func_8007A1B0 = func_8007BD58;
L1_func_8007A1FC = func_8007BDA4;
L1_func_8007A4E4 = func_8007C0B8;
L1_func_8007A554 = func_8007C128;
L1_func_8007A580 = func_8007C154;
L1_func_8007A614 = func_8007C1E8;
L1_func_8007A694 = func_8007C268;
L1_func_8007AA94 = func_8007C668;
L1_func_8007AC7C = func_8007C850;
L1_func_8007CE30 = func_8007EA04;
L1_func_8007D184 = func_8007ED58;
L1_func_8007D1E8 = func_8007EDBC;
L1_func_8007D260 = func_8007EE34;
L1_func_8007D2B4 = func_8007EE88;
L1_func_8007D914 = func_8007F4E8;
L1_func_8007DA88 = func_8007F65C;
L1_func_8007DE50 = func_8007FA24;
L1_func_8007E610 = func_800801E4;
L1_func_8007E6A4 = func_80080278;
L1_func_8007EB7C = func_80080750;
L1_func_8007EC78 = func_8008084C;
L1_func_8007ED98 = func_8008096C;
L1_func_8007EE34 = func_80080A08;
L1_func_8007EE64 = func_80080A38;
L1_func_8007EEBC = func_80080A90;
L1_func_8007EECC = func_80080AA0;
L1_func_8007F040 = func_80080C14;
L1_func_8007F0D8 = func_80080CAC;
L1_func_8007F140 = func_80080D14;
L1_func_8007F25C = func_80080E30;
L1_func_8007F2EC = func_80080EC0;
L1_func_8007F34C = func_80080F20;
L1_func_8007F414 = func_80080FE8;
L1_func_8007F4C0 = func_80081094;
L1_func_8007F530 = func_80081104;
L1_func_8007F5F0 = func_800811C4;
L1_func_8007FAE8 = func_800816BC;
L1_func_8007FCE0 = func_800818B4;
L1_func_8007FF50 = func_80081B24;
L1_func_8007FF70 = func_80081B44;
L1_func_80080008 = func_80081BDC;
L1_func_800800A0 = func_80081C74;
L1_func_800800BC = func_80081C90;
L1_func_8008013C = func_80081D10;
L1_func_80080154 = func_80081D28;
L1_func_80080234 = func_80081E08;
L1_func_80080464 = func_80082038;
L1_func_800806A0 = func_80082274;
L1_func_80080920 = func_800824F4;
L1_func_80080944 = func_80082518;
L1_func_80080958 = func_8008252C;
L1_func_80080998 = func_8008256C;
L1_func_800809E0 = func_800825B4;
L1_func_80080A10 = func_800825E4;
L1_func_80080A34 = func_80082608;
L1_func_80080CE4 = func_800828B8;
L1_func_80080F44 = func_80082B18;
L1_func_80081094 = func_80082C68;
L1_func_800811D0 = func_80082DA4;
L1_func_80081204 = func_80082DD8;
L1_func_80081348 = func_80082F1C;
L1_func_800813E8 = func_80082FBC;
L1_func_80081410 = func_80082FE4;
L1_func_80081448 = func_8008301C;
L1_func_80081458 = func_8008302C;
L1_func_800814CC = func_800830A0;
L1_func_800815A0 = func_80083174;
L1_func_80081A08 = func_800835DC;
L1_func_80081B74 = func_80083748;
L1_func_80081C54 = func_80083828;
L1_func_80081C84 = func_80083858;
L1_func_80081CE4 = func_800838B8;
L1_func_80081D14 = func_800838E8;
L1_func_80082638 = func_8008420C;
L1_func_800828AC = func_80084480;
L1_func_8008297C = func_80084550;
L1_func_80082B64 = func_80084738;
L1_func_80082D00 = func_800848D4;
L1_func_80082E04 = func_800849D8;
L1_func_80082ED8 = func_80084AAC;
L1_func_80082EE8 = func_80084ABC;
L1_func_80082EF8 = func_80084ACC;
L1_func_80082F04 = func_80084AD8;
L1_func_80082F24 = func_80084AF8;
L1_func_80082F44 = func_80084B18;
L1_func_80082F64 = func_80084B38;
L1_func_80082F78 = func_80084B4C;
L1_func_80082F8C = func_80084B60;
L1_func_800830C8 = func_80084C9C;
L1_func_800831FC = func_80084DD0;
L1_func_80083348 = func_80084F1C;
L1_func_80083368 = func_80084F3C;
L1_func_80083388 = func_80084F5C;
L1_func_800833AC = func_80084F80;
L1_func_800833CC = func_80084FA0;
L1_func_800834D0 = func_800850A4;
L1_func_80083F14 = func_80085AE8;
L1_func_80084134 = func_80085D08;
L1_func_80084164 = func_80085D38;
L1_func_80084194 = func_80085D68;
L1_func_800841C4 = func_80085D98;
L1_func_800841F8 = func_80085DCC;
L1_func_80084228 = func_80085DFC;
L1_func_80084238 = func_80085E0C;
L1_func_80084250 = func_80085E24;
L1_func_80084328 = func_80085EFC;
L1_func_800844F8 = func_800860CC;
L1_func_80084640 = func_80086214;
L1_func_800846E0 = func_800862B4;
L1_func_80084758 = func_8008632C;
L1_func_80084E0C = func_800869E0;
L1_func_800855BC = func_80087190;
L1_func_8008571C = func_800872F0;
L1_func_8008596C = func_80087540;
L1_func_800859B8 = func_8008758C;
L1_func_80085B5C = func_80087730;
L1_func_80085BD0 = func_800877A4;
L1_func_800865BC = func_80088190;
L1_func_80086688 = func_8008825C;
L1_func_80086780 = func_80088354;
L1_func_80086854 = func_80088428;
L1_func_8008688C = func_80088460;
L1_func_800868D4 = func_800884A8;
L1_func_80086928 = func_800884FC;
L1_func_80086A40 = func_80088614;
L1_func_80086A6C = func_80088640;
L1_func_80086AD4 = func_800886A8;
L1_func_80086C64 = func_80088838;
L1_func_80086D30 = func_80088904;
L1_func_80086D74 = func_80088948;
L1_func_800870A8 = func_80088C7C;
L1_func_80087198 = func_80088D6C;
L1_func_800873A8 = func_80088F7C;
L1_func_80087620 = func_800891F4;
L1_func_800876B0 = func_80089284;
L1_func_800876E4 = func_800892B8;
L1_func_80088C44 = func_8008A818;
L1_func_8008A404 = func_8008BFD8;
L1_func_8008A904 = func_8008C4D8;
L1_func_8008C5A4 = func_8008E188;
L1_func_8008C5C4 = func_8008E1A8;
L1_func_8008C5D8 = func_8008E1BC;
L1_func_8008C638 = func_8008E21C;
L1_func_8008CCB8 = func_8008E60C;
L1_func_8008D2EC = func_8008EC40;
L1_func_8008DAAC = func_8008F400;
L1_func_8008DB68 = func_8008F4BC;
L1_func_8008DBDC = func_8008F530;
L1_func_8008E03C = func_8008FC20;
L1_func_8008E378 = func_8008FF5C;
L1_func_8008FAE8 = func_800916BC;
L1_func_80090004 = func_80091BD8;
L1_func_80090164 = func_80091D38;
L1_func_80090880 = func_80092454;
L1_func_80090B00 = func_800926D4;
L1_func_80090CC0 = func_80092894;
L1_func_80090D7C = func_80092950;
L1_func_80090FFC = func_80092BD0;
L1_func_80091080 = func_80092C54;
L1_func_800910C4 = func_80092C98;
L1_func_80091168 = func_80092D3C;
L1_func_800911C0 = func_80092D94;
L1_func_800911E8 = func_80092DBC;
L1_func_80091210 = func_80092DE4;
L1_func_80091450 = func_80093024;
L1_func_80091480 = func_80093054;
L1_func_800919DC = func_800935B0;
L1_func_80091C5C = func_80093830;
L1_func_80091F24 = func_80093AF8;
L1_func_80092330 = func_80093F04;
L1_func_80092404 = func_80093FD8;
L1_func_800924F4 = func_800940C8;
L1_func_800926D4 = func_800942A8;
L1_func_8009283C = func_80094410;
L1_func_8009293C = func_80094510;
L1_func_80092A34 = func_80094608;
L1_func_80092F24 = func_80094AF8;
L1_func_80092F5C = func_80094B30;
L1_func_8009302C = func_80094C00;
L1_func_80093C64 = func_80095838;
L1_func_80093E24 = func_800959F8;
L1_func_80093F24 = func_80095AF8;
L1_func_80093F4C = func_80095B20;
L1_func_80094434 = func_80096008;
L1_func_80094440 = func_80096014;
L1_func_800944C4 = func_80096098;
L1_func_80094734 = func_80096308;
L1_func_8009476C = func_80096340;
L1_func_80094840 = func_80096414;
L1_func_800948E8 = func_800964BC;
L1_func_80094CE0 = func_800968B4;
L1_func_80094D48 = func_8009691C;
L1_func_80094D64 = func_80096938;
L1_func_80094E2C = func_80096A00;
L1_func_80094EC4 = func_80096A98;
L1_func_80094F18 = func_80096AEC;
L1_func_80094F78 = func_80096B4C;
L1_func_80094F98 = func_80096B6C;
L1_func_80094FAC = func_80096B80;
L1_func_80094FCC = func_80096BA0;
L1_func_80094FEC = func_80096BC0;
L1_func_8009500C = func_80096BE0;
L1_func_80095104 = func_80096CD8;
L1_func_800957F0 = func_800973C4;
L1_func_80095914 = func_800974E8;
L1_func_80095934 = func_80097508;
L1_func_80095954 = func_80097528;
L1_func_80095A44 = func_80097618;
L1_func_80095A64 = func_80097638;
L1_func_80095D7C = func_80097950;
L1_func_80095ECC = func_80097AA0;
L1_func_80096270 = func_80097E44;
L1_func_800963C4 = func_80097F98;
L1_func_80096738 = func_8009830C;
L1_func_800967BC = func_80098390;
L1_func_80096BC0 = func_80098794;
L1_func_80096C54 = func_80098828;
L1_func_80096C9C = func_80098870;
L1_func_80096F50 = func_80098B24;
L1_func_80099EB0 = func_8009BA84;
L1_func_8009A0A0 = func_8009BC74;
L1_func_8009A1F0 = func_8009BDC4;
L1_func_8009A3B0 = func_8009BF84;
L1_func_8009A9E0 = func_8009C5B4;
L1_func_8009AB60 = func_8009C734;
L1_func_8009B940 = func_8009D514;
L1_func_8009BEAC = func_8009DA80;
L1_func_8009BF10 = func_8009DAE4;
L1_func_8009BFC0 = func_8009DB94;
L1_func_800AACFC = func_800AD614;
L1_func_800AAEF8 = func_800AD810;
L1_gPsi = D_800B28B4;
L1_g_Args = D_800B2894;
L1_g_CamPosX = D_800B2944;
L1_g_CamPosY = D_800B2948;
L1_g_CamRotX = D_800B290C;
L1_g_CamTargetX = D_800B2900;
L1_g_Camera = D_800B28FC;
L1_g_CheatCodeProgress = D_800B3658;
L1_g_CheatCodes = D_8009E890;
L1_g_CutScene = D_8009E8D0;
L1_g_DebugPageNames = D_8009EA28;
L1_g_DebugTextX = D_8009EBF0;
L1_g_DebugTextY = D_8009EBF2;
L1_g_DevMenu = D_800D5B64;
L1_g_FrameCap = D_800B35DC;
L1_g_FrameRate = D_8009E984;
L1_g_GodMode = D_8009E912;
L1_g_Invincible = D_8009E65C;
L1_g_MenuUpdateFunc = D_800D6F5C;
L1_g_PadAxes = D_800B399C;
L1_g_PadAxesPrev = D_800B39A0;
L1_g_PadHeld = D_800B3984;
L1_g_PadPressed = D_800B398C;
L1_g_PadPrev = D_800B3990;
L1_g_Player = D_800B3640;
L1_g_Projection = D_800B29A8;
L1_g_Weapons = D_800B29BC;
L1_gteMIMefunc = func_8008E068;
L1_gte_rotate_z_matrix = func_80094C38;
L1_jtbl_800A6F68 = jtbl_800A95A8;
L1_jtbl_800A7168 = jtbl_800A97A8;
L1_jtbl_800A74B0 = jtbl_800A9AF0;
L1_jtbl_800A7764 = jtbl_800A9DA4;
L1_jtbl_800A7ED8 = jtbl_800AA54C;
L1_jtbl_800A8028 = jtbl_800AA69C;
L1_jtbl_800A8088 = jtbl_800AA6FC;
L1_jtbl_800A859C = jtbl_800AAC10;
L1_jtbl_800A8AC0 = jtbl_800AB174;
L1_jtbl_800A8B20 = jtbl_800AB1D4;
L1_jtbl_800A8BE8 = jtbl_800AB29C;
L1_jtbl_800A98E4 = jtbl_800AC1D4;
L1_jtbl_800A9AEC = jtbl_800AC400;
L1_jtbl_800A9DF8 = jtbl_800AC70C;
L1_jtbl_800AA190 = jtbl_800ACAA4;
L1_jtbl_800AA1F0 = jtbl_800ACB04;
L1_jtbl_800AA270 = jtbl_800ACB84;
L1_jtbl_800AA2A8 = jtbl_800ACBBC;
L1_jtbl_800AA330 = jtbl_800ACC44;
L1_jtbl_800AA540 = jtbl_800ACE54;
L1_jtbl_800AA560 = jtbl_800ACE74;
L1_jtbl_800AA780 = jtbl_800AD094;
L1_jtbl_800AA860 = jtbl_800AD174;
L1_jtbl_800AA880 = jtbl_800AD194;
L1_malloc3 = func_8008D508;
L1_memchr = func_8008D7C8;
L1_memcpy = func_8008E058;
L1_memmove = func_80092FAC;
L1_memset = func_8008E048;
L1_note2pitch = func_80090F4C;
L1_note2pitch2 = func_80090F98;
L1_printf = func_80080A70;
L1_rand = func_80083668;
L1_ratan2 = func_8008DBC8;
L1_rcos = func_8009BE14;
L1_rsin = func_8009BEB4;
L1_setRC2wait = func_80096C18;
L1_setjmp = func_80094830;
L1_sin_1 = func_8009BEF0;
L1_sprintf = func_80083948;
L1_start = func_8002C834;
L1_startIntrDMA = func_80094850;
L1_startIntrVSync = func_800946F0;
L1_strcat = func_80085AB4;
L1_strcmp = func_8008D808;
L1_strcpy = func_80083878;
L1_strlen = func_80083848;
L1_strncmp = func_800946E0;
L1_strncpy = func_800901CC;
L1_strstr = func_8008D948;
L1_strtok = func_8008D818;
L1_strtol = func_8008D938;
L1_toupper = func_80083738;
L1_vmNoiseOff = func_80092094;
L1_vmNoiseOn = func_800909DC;
D_1F8003D4 = 0x1F8003D4;
D_1F8003D8 = 0x1F8003D8;
D_1F8003DC = 0x1F8003DC;
L1_D_800AB540_b = L1_D_800AB540;
L1_D_800AB540_c = L1_D_800AB540;
L1_D_8009CE24 = L1_D_8009CE20 + 4;
