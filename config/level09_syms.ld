/* Generated by tools/port_level.py: LEVEL01 names (L1_ prefix) bound to level09's symbols. */
L1_AddPrim = func_8008E3E0;
L1_ApplyBonusCheats = func_8002E130;
L1_ApplyMatrix = func_800910C0;
L1_ApplyMatrixLV = func_8007F3B0;
L1_ApplyMatrixSV = func_800931B4;
L1_Args_GetFlag115 = func_8002E2D0;
L1_CALLOC3_OBJ_54 = func_800905A4;
func_800503D8 = L1_Camera_ResetZoom;
func_8002C3DC = L1_CdBin_Disable;
func_8002C420 = L1_CdBin_Enable;
func_8002C53C = L1_CdBin_SetLevel;
L1_CdInit = func_8008A6A8;
L1_CdSearchFile = func_8008820C;
L1_ChangeClearPAD = func_800978D8;
L1_ChangeClearRCnt = func_800978E8;
func_8002DDA8 = L1_Cheat_CheckCodes;
L1_Cheat_DoAction = func_8002DB1C;
L1_Cheat_ResetCodes = func_8002E278;
L1_CloseEvent = func_800860D4;
L1_D_80082604 = func_800872A0;
L1_D_80095808 = D_8009A4A4;
L1_D_8009C180 = D_800A0E1C;
L1_D_8009C184 = D_800A0E20;
L1_D_8009C1EC = D_800A0E88;
L1_D_8009C1ED = D_800A0E89;
L1_D_8009C1EE = D_800A0E8A;
L1_D_8009C1F0 = D_800A0E8C;
L1_D_8009C1F4 = D_800A0E90;
L1_D_8009C1F8 = D_800A0E94;
L1_D_8009C200 = D_800A0E9C;
L1_D_8009C204 = D_800A0EA0;
L1_D_8009C208 = D_800A0EA4;
L1_D_8009C20A = D_800A0EA6;
L1_D_8009C20C = D_800A0EA8;
L1_D_8009CA56 = D_800A16F2;
L1_D_8009CA58 = D_800A16F4;
L1_D_8009CA59 = D_800A16F5;
L1_D_8009CA5A = D_800A16F6;
L1_D_8009CA5C = D_800A16F8;
L1_D_8009CA5E = D_800A16FA;
L1_D_8009CA60 = D_800A16FC;
L1_D_8009CA64 = D_800A1700;
L1_D_8009CA68 = D_800A1704;
L1_D_8009CA70 = D_800A170C;
L1_D_8009CA74 = D_800A1710;
L1_D_8009CA78 = D_800A1714;
L1_D_8009CA7C = D_800A1718;
L1_D_8009CA80 = D_800A171C;
L1_D_8009CA84 = D_800A1720;
L1_D_8009CA8C = D_800A1728;
L1_D_8009CA90 = D_800A172C;
L1_D_8009CA94 = D_800A1730;
L1_D_8009CA98 = D_800A1734;
L1_D_8009CA9C = D_800A1738;
L1_D_8009CAA0 = D_800A173C;
L1_D_8009CAA4 = D_800A1740;
L1_D_8009CAA8 = D_800A1744;
L1_D_8009CAAC = D_800A1748;
L1_D_8009CABD = D_800A1759;
L1_D_8009CABE = D_800A175A;
L1_D_8009CABF = D_800A175B;
L1_D_8009CAC0 = D_800A175C;
L1_D_8009CAC4 = D_800A1760;
L1_D_8009CACC = D_800A1768;
L1_D_8009CAD0 = D_800A176C;
L1_D_8009CD00 = D_800A199C;
L1_D_8009CD30 = D_800A19CC;
L1_D_8009CD3C = D_800A19D8;
L1_D_8009CD4C = D_800A19E8;
L1_D_8009CD50 = D_800A19EC;
L1_D_8009CD54 = D_800A19F0;
L1_D_8009CD58 = D_800A19F4;
L1_D_8009CD5C = D_800A19F8;
L1_D_8009CD5E = D_800A19FA;
L1_D_8009CD60 = D_800A19FC;
L1_D_8009CD62 = D_800A19FE;
L1_D_8009CD6C = D_800A1A08;
L1_D_8009CD6E = D_800A1A0A;
L1_D_8009CD78 = D_800A1A14;
L1_D_8009CD80 = D_800A1A1C;
L1_D_8009CD88 = D_800A1A24;
L1_D_8009CD8C = D_800A1A28;
L1_D_8009CD98 = D_800A1A34;
L1_D_8009CDA0 = D_800A1A3C;
L1_D_8009CDA2 = D_800A1A3E;
L1_D_8009CDA8 = D_800A1A44;
L1_D_8009CDD0 = D_800A1A6C;
L1_D_8009CDDC = D_800A1A78;
L1_D_8009CDE4 = D_800A1A80;
L1_D_8009CDE5 = D_800A1A81;
L1_D_8009CDE6 = D_800A1A82;
L1_D_8009CDE7 = D_800A1A83;
L1_D_8009CDE8 = D_800A1A84;
L1_D_8009CDEC = D_800A1A88;
L1_D_8009CDF0 = D_800A1A8C;
L1_D_8009CE20 = D_800A1ABC;
L1_D_8009CE28 = D_800A1AC4;
L1_D_8009CE38 = D_800A1AD4;
L1_D_8009CE3C = D_800A1AD8;
L1_D_8009CE44 = D_800A1AE0;
L1_D_8009CE48 = D_800A1AE4;
L1_D_8009CEB0 = D_800A1B4C;
L1_D_8009CEE0 = D_800A1B7C;
L1_D_8009CF10 = D_800A1BAC;
L1_D_8009CF14 = D_800A1BB0;
L1_D_8009CF2C = D_800A1BC8;
L1_D_8009CF30 = D_800A1BCC;
L1_D_8009CF34 = D_800A1BD0;
L1_D_8009CF48 = D_800A1BE4;
L1_D_8009CF4C = D_800A1BE8;
L1_D_8009CF50 = D_800A1BEC;
L1_D_8009CF54 = D_800A1BF0;
L1_D_8009CF68 = D_800A1C08;
L1_D_8009CF6C = D_800A1C0C;
L1_D_8009CF70 = D_800A1C10;
L1_D_8009CF74 = D_800A1C14;
L1_D_8009CF7C = D_800A1C1C;
L1_D_8009CF80 = D_800A1C20;
L1_D_8009CF8C = D_800A1C2C;
L1_D_8009CF90 = D_800A1C30;
L1_D_8009CF94 = D_800A1C34;
L1_D_8009CF98 = D_800A1C38;
L1_D_8009CF9C = D_800A1C3C;
L1_D_8009CFA8 = D_800A1C48;
L1_D_8009CFB0 = D_800A1C50;
L1_D_8009CFB4 = D_800A1C54;
L1_D_8009CFBB = D_800A1C5B;
L1_D_8009CFBE = D_800A1C5E;
L1_D_8009CFC0 = D_800A1C60;
L1_D_8009CFC4 = D_800A1C64;
L1_D_8009CFC8 = D_800A1C68;
L1_D_8009CFCC = D_800A1C6C;
L1_D_8009CFE4 = D_800A1C84;
L1_D_8009CFE8 = D_800A1C88;
L1_D_8009CFEC = D_800A1C8C;
L1_D_8009CFF0 = D_800A1C90;
L1_D_8009CFF6 = D_800A1C96;
L1_D_8009CFF8 = D_800A1C98;
L1_D_8009CFFC = D_800A1C9C;
L1_D_8009D000 = D_800A1CA0;
L1_D_8009D002 = D_800A1CA2;
L1_D_8009D004 = D_800A1CA4;
L1_D_8009D008 = D_800A1CA8;
L1_D_8009D00C = D_800A1CAC;
L1_D_8009D00E = D_800A1CAE;
L1_D_8009D010 = D_800A1CB0;
L1_D_8009D014 = D_800A1CB4;
L1_D_8009D018 = D_800A1CB8;
L1_D_8009D01A = D_800A1CBA;
L1_D_8009D020 = D_800A1CC0;
L1_D_8009D038 = D_800A1CD8;
L1_D_8009D03C = D_800A1CDC;
L1_D_8009D040 = D_800A1CE0;
L1_D_8009D084 = D_800A1D24;
L1_D_8009D088 = D_800A1D28;
L1_D_8009D09C = D_800A1D3C;
L1_D_8009D0FC = D_800A1D9C;
L1_D_8009D104 = D_800A1DA4;
L1_D_8009D106 = D_800A1DA6;
L1_D_8009D108 = D_800A1DA8;
L1_D_8009D10A = D_800A1DAA;
L1_D_8009D10C = D_800A1DAC;
L1_D_8009D124 = D_800A1DC4;
L1_D_8009D130 = D_800A1DD0;
L1_D_8009D26C = D_800A1F08;
L1_D_8009D270 = D_800A1F0C;
L1_D_8009D274 = D_800A1F10;
L1_D_8009D280 = D_800A1F18;
L1_D_8009D2A8 = D_800A1F20;
L1_D_8009D2AC = D_800A1F24;
L1_D_8009D2B0 = D_800A1F28;
L1_D_8009D31C = D_800A1F58;
L1_D_8009D320 = D_800A1F50;
L1_D_8009D35C = D_800A2048;
L1_D_8009D368 = D_800A2054;
L1_D_8009D36C = D_800A2058;
L1_D_8009D374 = D_800A2060;
L1_D_8009D384 = D_800A2070;
L1_D_8009D394 = D_800A2080;
L1_D_8009D3A4 = D_800A2090;
L1_D_8009D3A8 = D_800A2094;
L1_D_8009D3AC = D_800A2098;
L1_D_8009D3B0 = D_800A209C;
L1_D_8009D3BC = D_800A20A8;
L1_D_8009D3F0 = D_800A20DC;
L1_D_8009D3F4 = D_800A20E0;
L1_D_8009D3F8 = D_800A20E4;
L1_D_8009D3FC = D_800A20E8;
L1_D_8009D444 = D_800A2130;
L1_D_8009D5A8 = D_800A22B0;
L1_D_8009D5AC = D_800A22B4;
L1_D_8009D5F8 = D_800A2308;
L1_D_8009D5FC = D_800A230C;
L1_D_8009D600 = D_800A2310;
L1_D_8009D610 = D_800A2320;
L1_D_8009D620 = D_800A2330;
L1_D_8009D660 = D_800A2370;
L1_D_8009D7A4 = D_800A24B4;
L1_D_8009D7A8 = D_800A24B8;
L1_D_8009D8B8 = D_800A25C8;
L1_D_8009D8BE = D_800A25CE;
L1_D_8009D8C4 = D_800A25D4;
L1_D_8009D8C8 = D_800A25D8;
L1_D_8009D8CC = D_800A25DC;
L1_D_8009D8D4 = D_800A25E4;
L1_D_8009D8E4 = D_800A25EC;
L1_D_8009D8E8 = D_800A25F0;
L1_D_8009D8F0 = D_800A25F8;
L1_D_8009D8F4 = D_800A25FC;
L1_D_8009D8F8 = D_800A2600;
L1_D_8009D8FC = D_800A2604;
L1_D_8009D900 = D_800A2608;
L1_D_8009D904 = D_800A260C;
L1_D_8009D90C = D_800A2614;
L1_D_8009D910 = D_800A2618;
L1_D_8009D914 = D_800A261C;
L1_D_8009D918 = D_800A2620;
L1_D_8009D91C = D_800A2624;
L1_D_8009D920 = D_800A2628;
L1_D_8009D924 = D_800A262C;
L1_D_8009D928 = D_800A2630;
L1_D_8009DB50 = D_800A2844;
L1_D_8009E410 = D_800A3B7C;
L1_D_8009E480 = D_800A3B54;
L1_D_8009E490 = D_800A3B70;
L1_D_8009E908 = D_800A3F08;
L1_D_8009E9A8 = D_800A3FE8;
L1_D_8009E9B4 = D_800A3FF4;
L1_D_8009E9B8 = D_800A3FF8;
L1_D_8009E9BC = D_800A3FFC;
L1_D_8009E9C0 = D_800A4000;
L1_D_8009E9C4 = D_800A4004;
L1_D_8009E9D8 = D_800A4018;
L1_D_8009EADC = D_800A4244;
L1_D_8009EB5C = D_800A42C4;
L1_D_8009EB7C = D_800A42E4;
L1_D_8009EB88 = D_800A42F0;
L1_D_8009EB8C = D_800A42F4;
L1_D_8009EE0C = D_800A4574;
L1_D_8009EE3D = D_800A45A5;
L1_D_8009EE8C = D_800A45F4;
L1_D_8009EEC4 = D_800A462C;
L1_D_8009EEC8 = D_800A4630;
L1_D_8009EED0 = D_800A4638;
L1_D_8009EED4 = D_800A463C;
L1_D_8009EED8 = D_800A4640;
L1_D_8009EEDC = D_800A4644;
L1_D_8009EEF0 = D_800A465C;
L1_D_8009EEF4 = D_800A4660;
L1_D_8009EEF8 = D_800A4664;
L1_D_8009EF1C = D_800A4688;
L1_D_8009EF94 = D_800A4700;
L1_D_8009EF98 = D_800A4704;
L1_D_8009EF9C = D_800A4708;
L1_D_8009EFA0 = D_800A470C;
L1_D_8009EFA4 = D_800A4710;
L1_D_8009EFA8 = D_800A4714;
L1_D_8009EFC8 = D_800A4734;
L1_D_8009F008 = D_800A4774;
L1_D_8009F00C = D_800A4778;
L1_D_8009F010 = D_800A477C;
L1_D_8009F012 = D_800A477E;
L1_D_8009F013 = D_800A477F;
L1_D_8009F014 = D_800A4780;
L1_D_8009F016 = D_800A4782;
L1_D_8009F018 = D_800A4784;
L1_D_8009F01C = D_800A4788;
L1_D_8009F07C = D_800A47E8;
L1_D_8009F084 = D_800A47F0;
L1_D_8009F090 = D_800A47FC;
L1_D_8009F09C = D_800A4808;
L1_D_8009F0BC = D_800A4828;
L1_D_8009F0D0 = D_800A483C;
L1_D_8009F0E4 = D_800A4850;
L1_D_8009F0E6 = D_800A4852;
L1_D_8009F10C = D_800A4878;
L1_D_8009F114 = D_800A4880;
L1_D_8009F118 = D_800A4884;
L1_D_8009F11C = D_800A4888;
L1_D_8009F120 = D_800A488C;
L1_D_8009F124 = D_800A4890;
L1_D_8009F128 = D_800A4894;
L1_D_8009F12C = D_800A4898;
L1_D_8009F130 = D_800A489C;
L1_D_8009F134 = D_800A48A0;
L1_D_8009F138 = D_800A48A4;
L1_D_8009F13C = D_800A48A8;
L1_D_8009F140 = D_800A48AC;
L1_D_8009F144 = D_800A48B0;
L1_D_8009F148 = D_800A48B4;
L1_D_8009F14C = D_800A48B8;
L1_D_8009F150 = D_800A48BC;
L1_D_8009F160 = D_800A48CC;
L1_D_8009F170 = D_800A48DC;
L1_D_8009F178 = D_800A48E4;
L1_D_8009F17C = D_800A48E8;
L1_D_8009F18C = D_800A48F8;
L1_D_8009F190 = D_800A48FC;
L1_D_8009F194 = D_800A4900;
L1_D_8009F198 = D_800A4904;
L1_D_8009F1B0 = D_800A491C;
L1_D_8009F230 = D_800A499C;
L1_D_8009F234 = D_800A49A0;
L1_D_8009F248 = D_800A49B4;
L1_D_8009F24C = D_800A49B8;
L1_D_8009F250 = D_800A49BC;
L1_D_8009F254 = D_800A49C0;
L1_D_8009F2B8 = D_800A4A24;
L1_D_8009F2BA = D_800A4A26;
L1_D_8009F2BC = D_800A4A28;
L1_D_8009F2E8 = D_800A4A54;
L1_D_8009F2F4 = D_800A4A60;
L1_D_800A0340 = D_800A5AAC;
L1_D_800A0344 = D_800A5AB0;
L1_D_800A0348 = D_800A5AB4;
L1_D_800A034C = D_800A5AB8;
L1_D_800A0350 = D_800A5ABC;
L1_D_800A0370 = D_800A5ADC;
L1_D_800A4370 = D_800A9ADC;
L1_D_800A4374 = D_800A9AE0;
L1_D_800A4378 = D_800A9AE4;
L1_D_800A437C = D_800A9AE8;
L1_D_800A4380 = D_800A9AEC;
L1_D_800A4382 = D_800A9AEE;
L1_D_800A4384 = D_800A9AF0;
L1_D_800A4390 = D_800A9AFC;
L1_D_800A4394 = D_800A9B00;
L1_D_800A43B0 = D_800A9B1C;
L1_D_800A43C8 = D_800A9B34;
L1_D_800A43CC = D_800A9B38;
L1_D_800A43D0 = D_800A9B3C;
L1_D_800A43D4 = D_800A9B40;
L1_D_800A43D8 = D_800A9B44;
L1_D_800A43DC = D_800A9B48;
L1_D_800A43E0 = D_800A9B4C;
L1_D_800A43E4 = D_800A9B50;
L1_D_800A43E8 = D_800A9B54;
L1_D_800A43EC = D_800A9B58;
L1_D_800A43F0 = D_800A9B5C;
L1_D_800A43F4 = D_800A9B60;
L1_D_800A43F8 = D_800A9B64;
L1_D_800A43FC = D_800A9B68;
L1_D_800A4400 = D_800A9B6C;
L1_D_800A4404 = D_800A9B70;
L1_D_800A4408 = D_800A9B74;
L1_D_800A440C = D_800A9B78;
L1_D_800A4410 = D_800A9B7C;
L1_D_800A4414 = D_800A9B80;
L1_D_800A4418 = D_800A9B84;
L1_D_800A441C = D_800A9B88;
L1_D_800A4420 = D_800A9B8C;
L1_D_800A4428 = D_800A9B94;
L1_D_800A442C = D_800A9B98;
L1_D_800A4430 = D_800A9B9C;
L1_D_800A4440 = D_800A9BAC;
L1_D_800A4450 = D_800A9BBC;
L1_D_800A4460 = D_800A9BCC;
L1_D_800A446C = D_800A9BD8;
L1_D_800A4470 = D_800A9BDC;
L1_D_800A4474 = D_800A9BE0;
L1_D_800A4478 = D_800A9BE4;
L1_D_800A447C = D_800A9BE8;
L1_D_800A45D0 = D_800A9D3C;
L1_D_800A45D4 = D_800A9D40;
L1_D_800A45D8 = D_800A9D44;
L1_D_800A4EA0 = D_800AA60C;
L1_D_800A4FD8 = D_800AA744;
L1_D_800A4FDC = D_800AA748;
L1_D_800A4FF0 = D_800AA75C;
L1_D_800A5000 = D_800AA76C;
L1_D_800A5010 = D_800AA77C;
L1_D_800A56A0 = D_800AAE0C;
L1_D_800A5834 = D_800AAFA0;
L1_D_800A59D0 = D_800AB13C;
L1_D_800A59D4 = D_800AB140;
L1_D_800A59D8 = D_800AB144;
L1_D_800A59DC = D_800AB148;
L1_D_800A59E0 = D_800AB14C;
L1_D_800A5B60 = D_800AB2CC;
L1_D_800A5B6C = D_800AB2D8;
L1_D_800A5B90 = D_800AB2FC;
L1_D_800A5BA8 = D_800AB314;
L1_D_800A5CB0 = D_800AB41C;
L1_D_800A5CB4 = D_800AB420;
L1_D_800A5CB8 = D_800AB424;
L1_D_800A5CBC = D_800AB428;
L1_D_800A5CC0 = D_800AB42C;
L1_D_800A5CC8 = D_800AB434;
L1_D_800A5CCC = D_800AB438;
L1_D_800A5CD0 = D_800AB43C;
L1_D_800A5CD4 = D_800AB440;
L1_D_800A5CD8 = D_800AB444;
L1_D_800A5CDC = D_800AB448;
L1_D_800A5CE0 = D_800AB44C;
L1_D_800A5CE4 = D_800AB450;
L1_D_800A5CE8 = D_800AB454;
L1_D_800A5CEC = D_800AB458;
L1_D_800A5CF0 = D_800AB45C;
L1_D_800A5D00 = D_800AB46C;
L1_D_800A5D04 = D_800AB470;
L1_D_800A5D08 = D_800AB474;
L1_D_800A5D18 = D_800AB484;
L1_D_800A5D1C = D_800AB488;
L1_D_800A5D20 = D_800AB48C;
L1_D_800A5D24 = D_800AB490;
L1_D_800A5D28 = D_800AB494;
L1_D_800A5D2C = D_800AB498;
L1_D_800A5D34 = D_800AB4A0;
L1_D_800A5D44 = D_800AB4B0;
L1_D_800A5D48 = D_800AB4B4;
L1_D_800A5D4C = D_800AB4B8;
L1_D_800A5D7A = D_800AB4E6;
L1_D_800A5D7C = D_800AB4E8;
L1_D_800A5D80 = D_800AB4EC;
L1_D_800A5D98 = D_800AB504;
L1_D_800A5D9C = D_800AB508;
L1_D_800A5DA0 = D_800AB50C;
L1_D_800A5DA4 = D_800AB510;
L1_D_800A5DA8 = D_800AB514;
L1_D_800A5DAC = D_800AB518;
L1_D_800A5DB0 = D_800AB51C;
L1_D_800A5DB4 = D_800AB520;
L1_D_800A5DB5 = D_800AB521;
L1_D_800A5DBC = D_800AB528;
L1_D_800A5E3C = D_800AB5A8;
L1_D_800A5E5C = D_800AB5C8;
L1_D_800A5EA0 = D_800AB60C;
L1_D_800A5EDC = D_800AB648;
L1_D_800A5F5C = D_800AB6C8;
L1_D_800A5FDC = D_800AB748;
L1_D_800A605C = D_800AB7C8;
L1_D_800A6060 = D_800AB7CC;
L1_D_800A6064 = D_800AB7D0;
L1_D_800A6068 = D_800AB7D4;
L1_D_800A606C = D_800AB7D8;
L1_D_800A6070 = D_800AB7DC;
L1_D_800A6074 = D_800AB7E0;
L1_D_800A6075 = D_800AB7E1;
L1_D_800A6078 = D_800AB7E4;
L1_D_800A6090 = D_800AB7FC;
L1_D_800A6094 = D_800AB800;
L1_D_800A6098 = D_800AB804;
L1_D_800A609C = D_800AB808;
L1_D_800A60A0 = D_800AB80C;
L1_D_800A60B0 = D_800AB81C;
L1_D_800A60D0 = D_800AB83C;
L1_D_800A60D4 = D_800AB840;
L1_D_800A60E0 = D_800AB84C;
L1_D_800A60E4 = D_800AB850;
L1_D_800A6104 = D_800AB870;
L1_D_800A6110 = D_800AB87C;
L1_D_800A6114 = D_800AB880;
L1_D_800A6118 = D_800AB884;
L1_D_800A611C = D_800AB888;
L1_D_800A6120 = D_800AB88C;
L1_D_800A6140 = D_800AB8AC;
L1_D_800A6170 = D_800AB8DC;
L1_D_800A6174 = D_800AB8E0;
L1_D_800A6178 = D_800AB8E4;
L1_D_800A6180 = D_800AB8EC;
L1_D_800A6198 = D_800AB904;
L1_D_800A62A0 = D_800ABA0C;
L1_D_800A66A0 = D_800ABE0C;
L1_D_800A6EB0 = D_800AC61C;
L1_D_800A6ED0 = D_800AC63C;
L1_D_800A6EF8 = D_800AC664;
L1_D_800A6F00 = D_800AC66C;
L1_D_800A6F1C = D_800AC688;
L1_D_800A6F34 = D_800AC6A0;
L1_D_800A6F4C = D_800AC6B8;
L1_D_800A7048 = D_800AC7B4;
L1_D_800A7060 = D_800AC7CC;
L1_D_800A70A0 = D_800AC80C;
L1_D_800A70C8 = D_800AC834;
L1_D_800A70D4 = D_800AC840;
L1_D_800A70F8 = D_800AC864;
L1_D_800A7190 = D_800AC8FC;
L1_D_800A71EC = D_800AC958;
L1_D_800A71F0 = D_800AC95C;
L1_D_800A71F4 = D_800AC960;
L1_D_800A71F8 = D_800AC964;
L1_D_800A7214 = D_800AC980;
L1_D_800A7260 = D_800AC9CC;
L1_D_800A7290 = D_800AC9FC;
L1_D_800A72E8 = D_800ACA54;
L1_D_800A7300 = D_800ACA6C;
L1_D_800A7310 = D_800ACA7C;
L1_D_800A7320 = D_800ACA8C;
L1_D_800A7324 = D_800ACA90;
L1_D_800A7330 = D_800ACA9C;
L1_D_800A7344 = D_800ACAB0;
L1_D_800A735C = D_800ACAC8;
L1_D_800A73BC = D_800ACB28;
L1_D_800A73D8 = D_800ACB44;
L1_D_800A7418 = D_800ACB84;
L1_D_800A7424 = D_800ACB90;
L1_D_800A7474 = D_800ACBE0;
L1_D_800A747C = D_800ACBE8;
L1_D_800A7498 = D_800ACC04;
L1_D_800A74D4 = D_800ACC40;
L1_D_800A74E0 = D_800ACC4C;
L1_D_800A7510 = D_800ACC7C;
L1_D_800A75D0 = D_800ACD3C;
L1_D_800A7678 = D_800ACDE4;
L1_D_800A76A0 = D_800ACE0C;
L1_D_800A76E4 = D_800ACE50;
L1_D_800A76F8 = D_800ACE64;
L1_D_800A770C = D_800ACE78;
L1_D_800A7714 = D_800ACE80;
L1_D_800A7728 = D_800ACE94;
L1_D_800A773C = D_800ACEA8;
L1_D_800A7750 = D_800ACEBC;
L1_D_800A775C = D_800ACEC8;
L1_D_800A7778 = D_800ACEE4;
L1_D_800A7784 = D_800ACEF0;
L1_D_800A7788 = D_800ACEF4;
L1_D_800A77A0 = D_800ACF0C;
L1_D_800A77B4 = D_800ACF20;
L1_D_800A77CC = D_800ACF38;
L1_D_800A79F0 = D_800AD17C;
L1_D_800A7A0C = D_800AD198;
L1_D_800A7A24 = D_800AD1B0;
L1_D_800A7A30 = D_800AD1BC;
L1_D_800A7CF0 = D_800AD494;
L1_D_800A7D08 = D_800AD4AC;
L1_D_800A7D20 = D_800AD4C4;
L1_D_800A7D44 = D_800AD4E8;
L1_D_800A7D64 = D_800AD508;
L1_D_800A7D74 = D_800AD518;
L1_D_800A7D90 = D_800AD534;
L1_D_800A7DC0 = D_800AD564;
L1_D_800A7DE8 = D_800AD58C;
L1_D_800A7DF4 = D_800AD598;
L1_D_800A7E14 = D_800AD5B8;
L1_D_800A7E34 = D_800AD5D8;
L1_D_800A7E50 = D_800AD5F4;
L1_D_800A7E74 = D_800AD618;
L1_D_800A7E90 = D_800AD634;
L1_D_800A7EC4 = D_800AD668;
L1_D_800A7EFC = D_800AD6A0;
L1_D_800A7F1C = D_800AD6C0;
L1_D_800A7F2C = D_800AD6D0;
L1_D_800A7F5C = D_800AD700;
L1_D_800A7FF8 = D_800AD79C;
L1_D_800A8000 = D_800AD7A4;
L1_D_800A80A4 = D_800AD848;
L1_D_800A80B0 = D_800AD854;
L1_D_800A80BC = D_800AD860;
L1_D_800A80C8 = D_800AD86C;
L1_D_800A811C = D_800AD8C0;
L1_D_800A81F8 = D_800AD99C;
L1_D_800A8210 = D_800AD9B4;
L1_D_800A8224 = D_800AD9C8;
L1_D_800A8238 = D_800AD9DC;
L1_D_800A824C = D_800AD9F0;
L1_D_800A8260 = D_800ADA04;
L1_D_800A8274 = D_800ADA18;
L1_D_800A8280 = D_800ADA24;
L1_D_800A828C = D_800ADA30;
L1_D_800A82B4 = D_800ADA58;
L1_D_800A82DC = D_800ADA80;
L1_D_800A8304 = D_800ADAA8;
L1_D_800A8308 = D_800ADAAC;
L1_D_800A8310 = D_800ADAB4;
L1_D_800A8318 = D_800ADABC;
L1_D_800A8320 = D_800ADAC4;
L1_D_800A832C = D_800ADAD0;
L1_D_800A8340 = D_800ADAE4;
L1_D_800A8370 = D_800ADB14;
L1_D_800A8390 = D_800ADB34;
L1_D_800A83B0 = D_800ADB54;
L1_D_800A83BC = D_800ADB60;
L1_D_800A83C8 = D_800ADB6C;
L1_D_800A83D4 = D_800ADB78;
L1_D_800A83E0 = D_800ADB84;
L1_D_800A83E8 = D_800ADB8C;
L1_D_800A83F0 = D_800ADB94;
L1_D_800A8400 = D_800ADBA4;
L1_D_800A8410 = D_800ADBB4;
L1_D_800A8418 = D_800ADBBC;
L1_D_800A8420 = D_800ADBC4;
L1_D_800A842C = D_800ADBD0;
L1_D_800A8444 = D_800ADBE8;
L1_D_800A844C = D_800ADBF0;
L1_D_800A8458 = D_800ADBFC;
L1_D_800A8460 = D_800ADC04;
L1_D_800A8464 = D_800ADC08;
L1_D_800A8468 = D_800ADC0C;
L1_D_800A8478 = D_800ADC1C;
L1_D_800A8484 = D_800ADC28;
L1_D_800A8490 = D_800ADC34;
L1_D_800A849C = D_800ADC40;
L1_D_800A84A8 = D_800ADC4C;
L1_D_800A84B4 = D_800ADC58;
L1_D_800A84B8 = D_800ADC5C;
L1_D_800A84D0 = D_800ADC74;
L1_D_800A84D8 = D_800ADC7C;
L1_D_800A84E4 = D_800ADC88;
L1_D_800A84F0 = D_800ADC94;
L1_D_800A84FC = D_800ADCA0;
L1_D_800A850C = D_800ADCB0;
L1_D_800A851C = D_800ADCC0;
L1_D_800A8528 = D_800ADCCC;
L1_D_800A8534 = D_800ADCD8;
L1_D_800A8544 = D_800ADCE8;
L1_D_800A857C = D_800ADD20;
L1_D_800A85C4 = D_800ADD68;
L1_D_800A85D4 = D_800ADD78;
L1_D_800A85F8 = D_800ADD9C;
L1_D_800A86C0 = D_800ADE94;
L1_D_800A86CC = D_800ADEA0;
L1_D_800A8764 = D_800ADF48;
L1_D_800A87EC = D_800ADFD0;
L1_D_800A87F8 = D_800ADFDC;
L1_D_800A8808 = D_800ADFEC;
L1_D_800A880C = D_800ADFF0;
L1_D_800A8820 = D_800AE004;
L1_D_800A8858 = D_800AE03C;
L1_D_800A887C = D_800AE060;
L1_D_800A8884 = D_800AE068;
L1_D_800A8894 = D_800AE078;
L1_D_800A88A4 = D_800AE088;
L1_D_800A88D0 = D_800AE0B4;
L1_D_800A89A4 = D_800AE190;
L1_D_800A89F0 = D_800AE1DC;
L1_D_800A8A2C = D_800AE218;
L1_D_800A8AA8 = D_800AE294;
L1_D_800A8C08 = D_800AE3F4;
L1_D_800A8C28 = D_800AE414;
L1_D_800A8C48 = D_800AE434;
L1_D_800A8CB0 = D_800AE49C;
L1_D_800A8CC4 = D_800AE4B0;
L1_D_800A8CEC = D_800AE4D8;
L1_D_800A8CF8 = D_800AE4E4;
L1_D_800A8D14 = D_800AE500;
L1_D_800A8D44 = D_800AE520;
L1_D_800A8D58 = D_800AE534;
L1_D_800A8F94 = D_800AE6BC;
L1_D_800A8FAC = D_800AE6D4;
L1_D_800A9318 = D_800AEA40;
L1_D_800A932C = D_800AEA54;
L1_D_800A9354 = D_800AEA7C;
L1_D_800A9390 = D_800AEAB8;
L1_D_800A9488 = D_800AEB84;
L1_D_800A9498 = D_800AEB94;
L1_D_800A9794 = D_800AF19C;
L1_D_800A97BC = D_800AF1C4;
L1_D_800A988C = D_800AF31C;
L1_D_800A98B4 = D_800AF344;
L1_D_800A98C8 = D_800AF3C4;
L1_D_800A99D0 = D_800AF520;
L1_D_800A99EC = D_800AF53C;
L1_D_800A9A08 = D_800AF558;
L1_D_800A9A60 = D_800AF5B0;
L1_D_800A9A84 = D_800AF5D4;
L1_D_800A9AA8 = D_800AF5F8;
L1_D_800A9B6C = D_800AF6BC;
L1_D_800A9B78 = D_800AF6C8;
L1_D_800A9BE8 = D_800AF738;
L1_D_800A9C08 = D_800AF758;
L1_D_800A9C78 = D_800AF7C8;
L1_D_800A9C8C = D_800AF7DC;
L1_D_800A9CA0 = D_800AF7F0;
L1_D_800A9CAC = D_800AF7FC;
L1_D_800A9CC0 = D_800AF810;
L1_D_800A9CC4 = D_800AF814;
L1_D_800A9CDC = D_800AF82C;
L1_D_800A9D00 = D_800AF850;
L1_D_800A9D18 = D_800AF868;
L1_D_800A9D30 = D_800AF880;
L1_D_800A9D44 = D_800AF894;
L1_D_800A9D78 = D_800AF8C8;
L1_D_800A9D90 = D_800AF8E0;
L1_D_800A9EB0 = D_800AFA00;
L1_D_800A9EC8 = D_800AFA18;
L1_D_800A9EE0 = D_800AFA30;
L1_D_800A9F10 = D_800AFA60;
L1_D_800A9F2C = D_800AFA7C;
L1_D_800A9F44 = D_800AFA94;
L1_D_800A9F60 = D_800AFAB0;
L1_D_800A9F80 = D_800AFAD0;
L1_D_800A9F8C = D_800AFADC;
L1_D_800A9F9C = D_800AFAEC;
L1_D_800A9FC8 = D_800AFB18;
L1_D_800A9FD0 = D_800AFB20;
L1_D_800AA000 = D_800AFB50;
L1_D_800AA024 = D_800AFB74;
L1_D_800AA044 = D_800AFB94;
L1_D_800AA058 = D_800AFBA8;
L1_D_800AA07C = D_800AFBCC;
L1_D_800AA09C = D_800AFBEC;
L1_D_800AA0B8 = D_800AFC08;
L1_D_800AA0BC = D_800AFC0C;
L1_D_800AA0BE = D_800AFC0E;
L1_D_800AA0C0 = D_800AFC10;
L1_D_800AA0DC = D_800AFC2C;
L1_D_800AA110 = D_800AFC60;
L1_D_800AA154 = D_800AFCA4;
L1_D_800AA170 = D_800AFCC0;
L1_D_800AA1B0 = D_800AFD00;
L1_D_800AA1D0 = D_800AFD20;
L1_D_800AA3C0 = D_800AFF10;
L1_D_800AA3E8 = D_800AFF38;
L1_D_800AA410 = D_800AFF60;
L1_D_800AA438 = D_800AFF88;
L1_D_800AA444 = D_800AFF94;
L1_D_800AA46C = D_800AFFBC;
L1_D_800AA494 = D_800AFFE4;
L1_D_800AA4C0 = D_800B0010;
L1_D_800AA4F0 = D_800B0040;
L1_D_800AA518 = D_800B0068;
L1_D_800AA580 = D_800B00D0;
L1_D_800AA590 = D_800B00E0;
L1_D_800AA5A0 = D_800B00F0;
L1_D_800AA5B4 = D_800B0104;
L1_D_800AA70C = D_800B025C;
L1_D_800AA71C = D_800B026C;
L1_D_800AA738 = D_800B0288;
L1_D_800AA744 = D_800B0294;
L1_D_800AA760 = D_800B02B0;
L1_D_800AA774 = D_800B02C4;
L1_D_800AA794 = D_800B02E4;
L1_D_800AA79C = D_800B02EC;
L1_D_800AA7A8 = D_800B02F8;
L1_D_800AA7B0 = D_800B0300;
L1_D_800AA7C0 = D_800B0310;
L1_D_800AA800 = D_800B0350;
L1_D_800AA80C = D_800B035C;
L1_D_800AA818 = D_800B0368;
L1_D_800AA830 = D_800B0380;
L1_D_800AA84C = D_800B039C;
L1_D_800AA8A0 = D_800B03F0;
L1_D_800AA8C8 = D_800B0418;
L1_D_800AA8E0 = D_800B0430;
L1_D_800AA8E8 = D_800B0438;
L1_D_800AA8F0 = D_800B0440;
L1_D_800AB4A0 = D_800B0FF0;
L1_D_800AB540 = D_800B1090;
L1_D_800AB5E0 = D_800B1130;
L1_D_800AB5E4 = D_800B1134;
L1_D_800AB5E8 = D_800B1138;
L1_D_800AB5EC = D_800B113C;
L1_D_800AB5F0 = D_800B1140;
L1_D_800AB5F4 = D_800B1144;
L1_D_800AB5F8 = D_800B1148;
L1_D_800AB5FC = D_800B114C;
L1_D_800AB600 = D_800B1150;
L1_D_800AB604 = D_800B1154;
L1_D_800AB608 = D_800B1158;
L1_D_800AB60C = D_800B115C;
L1_D_800AB610 = D_800B1160;
L1_D_800AB614 = D_800B1164;
L1_D_800AB618 = D_800B1168;
L1_D_800AB744 = D_800B1294;
L1_D_800AB754 = D_800B12A4;
L1_D_800AC284 = D_800B1DD4;
L1_D_800AC384 = D_800B1ED4;
L1_D_800AC38C = D_800B1EDC;
L1_D_800AC4C8 = D_800B2018;
L1_D_800AC4D0 = D_800B2020;
L1_D_800AC4D8 = D_800B2028;
L1_D_800AC4DC = D_800B202C;
L1_D_800AC4E0 = D_800B2030;
L1_D_800AC4E4 = D_800B2034;
L1_D_800AC4E8 = D_800B2038;
L1_D_800AC4EC = D_800B203C;
L1_D_800AC54C = D_800B209C;
L1_D_800AC550 = D_800B20A0;
L1_D_800AE940 = D_800B4490;
L1_D_800AE9B8 = D_800B4508;
L1_D_800AE9C0 = D_800B4510;
L1_D_800AEB1A = D_800B466A;
L1_D_800AEC38 = D_800B4788;
L1_D_800AEDA0 = D_800B48F0;
L1_D_800AEDA4 = D_800B48F4;
L1_D_800AEDA8 = D_800B48F8;
L1_D_800AEDAC = D_800B48FC;
L1_D_800AEDB0 = D_800B4900;
L1_D_800AEDB4 = D_800B4904;
L1_D_800AEDB8 = D_800B4908;
L1_D_800AEDBC = D_800B490C;
L1_D_800AEDD4 = D_800B4924;
L1_D_800AEDD8 = D_800B4928;
L1_D_800AEDDC = D_800B492C;
L1_D_800AEDE0 = D_800B4930;
L1_D_800AEDE4 = D_800B4934;
L1_D_800AEDE8 = D_800B4938;
L1_D_800AEDEC = D_800B493C;
L1_D_800AEDF0 = D_800B4940;
L1_D_800AEE10 = D_800B4960;
L1_D_800AEE14 = D_800B4964;
L1_D_800AF620 = D_800B5170;
L1_D_800AF624 = D_800B5174;
L1_D_800AF6A4 = D_800B51F4;
L1_D_800AF6A5 = D_800B51F5;
L1_D_800AF6A8 = D_800B51F8;
L1_D_800AFEA8 = D_800B59F8;
L1_D_800AFEAC = D_800B59FC;
L1_D_800AFEB0 = D_800B5A00;
L1_D_800AFEB5 = D_800B5A05;
L1_D_800AFEB6 = D_800B5A06;
L1_D_800AFEB7 = D_800B5A07;
L1_D_800AFEB8 = D_800B5A08;
L1_D_800AFEB9 = D_800B5A09;
L1_D_800AFEBC = D_800B5A0C;
L1_D_800AFEC0 = D_800B5A10;
L1_D_800AFEC8 = D_800B5A18;
L1_D_800AFF2C = D_800B5A7C;
L1_D_800AFF48 = D_800B5A98;
L1_D_800AFF4C = D_800B5A9C;
L1_D_800AFF58 = D_800B5AA8;
L1_D_800AFF64 = D_800B5AB4;
L1_D_800AFF68 = D_800B5AB8;
L1_D_800AFF70 = D_800B5AC0;
L1_D_800AFF78 = D_800B5AC8;
L1_D_800AFF80 = D_800B5AD0;
L1_D_800AFF84 = D_800B5AD4;
L1_D_800AFF88 = D_800B5AD8;
L1_D_800AFF8C = D_800B5ADC;
L1_D_800AFF94 = D_800B5AE4;
L1_D_800AFF98 = D_800B5AE8;
L1_D_800AFFA4 = D_800B5AF4;
L1_D_800AFFA8 = D_800B5AF8;
L1_D_800AFFAC = D_800B5AFC;
L1_D_800AFFB0 = D_800B5B00;
L1_D_800AFFB4 = D_800B5B04;
L1_D_800AFFC0 = D_800B5B10;
L1_D_800AFFC4 = D_800B5B14;
L1_D_800AFFC8 = D_800B5B18;
L1_D_800AFFCC = D_800B5B1C;
L1_D_800B0014 = D_800B5B64;
L1_D_800B0018 = D_800B5B68;
L1_D_800B0064 = D_800B5BB4;
L1_D_800B0066 = D_800B5BB6;
L1_D_800B0068 = D_800B5BB8;
L1_D_800B0070 = D_800B5BC0;
L1_D_800B0084 = D_800B5BD4;
L1_D_800B008C = D_800B5BDC;
L1_D_800B0094 = D_800B5BE4;
L1_D_800B00A0 = D_800B5BF0;
L1_D_800B0108 = D_800B5C58;
L1_D_800B05AC = D_800B654C;
L1_D_800B05B0 = D_800B6550;
L1_D_800B077C = D_800B671C;
L1_D_800B0794 = D_800B6734;
L1_D_800B0798 = D_800B6738;
L1_D_800B07A4 = D_800B6744;
L1_D_800B07A8 = D_800B6748;
L1_D_800B07AC = D_800B674C;
L1_D_800B07B0 = D_800B6750;
L1_D_800B07B4 = D_800B6754;
L1_D_800B07B8 = D_800B6758;
L1_D_800B07BC = D_800B675C;
L1_D_800B07C0 = D_800B6760;
L1_D_800B07C4 = D_800B6764;
L1_D_800B0804 = D_800B67A4;
L1_D_800B0808 = D_800B67A8;
L1_D_800B0848 = D_800B67E8;
L1_D_800B0868 = D_800B6808;
L1_D_800B086C = D_800B680C;
L1_D_800B087C = D_800B681C;
L1_D_800B0A94 = D_800B6A34;
L1_D_800B0A98 = D_800B6A38;
L1_D_800B0AA0 = D_800B6A40;
L1_D_800B0AA4 = D_800B6A44;
L1_D_800B0AA8 = D_800B6A48;
L1_D_800B0AB4 = D_800B6A54;
L1_D_800B0AB8 = D_800B6A58;
L1_D_800B0AC0 = D_800B6A60;
L1_D_800B0AC8 = D_800B6A68;
L1_D_800B0ACC = D_800B6A6C;
L1_D_800B0AD0 = D_800B6A70;
L1_D_800B0AD4 = D_800B6A74;
L1_D_800B0AE0 = D_800B6A80;
L1_D_800B0AE4 = D_800B6A84;
L1_D_800B0AE8 = D_800B6A88;
L1_D_800B0AEC = D_800B6A8C;
L1_D_800B0AFC = D_800B6A9C;
L1_D_800B0B10 = D_800B6AB0;
L1_D_800B0B14 = D_800B6AB4;
L1_D_800B0B54 = D_800B6AF4;
L1_D_800B0B58 = D_800B6AF8;
L1_D_800B0B64 = D_800B6B04;
L1_D_800B0B68 = D_800B6B08;
L1_D_800B0B6A = D_800B6B0A;
L1_D_800B0B6C = D_800B6B0C;
L1_D_800B0B70 = D_800B6B10;
L1_D_800B0B72 = D_800B6B12;
L1_D_800B0B78 = D_800B6B18;
L1_D_800B0B80 = D_800B6B20;
L1_D_800B0B84 = D_800B6B24;
L1_D_800B0B88 = D_800B6B28;
L1_D_800B0B8C = D_800B6B2C;
L1_D_800B0B9C = D_800B6B3C;
L1_D_800B0BA0 = D_800B6B40;
L1_D_800B0BB4 = D_800B6B54;
L1_D_800B0BB8 = D_800B6B58;
L1_D_800B0BBC = D_800B6B5C;
L1_D_800B0BC0 = D_800B6B60;
L1_D_800B0C10 = D_800B6BB0;
L1_D_800B0C30 = D_800B6BD0;
L1_D_800B0C38 = D_800B6BD8;
L1_D_800B0C5C = D_800B6BFC;
L1_D_800B0C60 = D_800B6C00;
L1_D_800B0C64 = D_800B6C04;
L1_D_800B0C68 = D_800B6C08;
L1_D_800B0C74 = D_800B6C14;
L1_D_800B0C7C = D_800B6C1C;
L1_D_800B0C84 = D_800B6C24;
L1_D_800B0C8C = D_800B6C2C;
L1_D_800B0C9C = D_800B6C3C;
L1_D_800B0CA0 = D_800B6C40;
L1_D_800B0CA4 = D_800B6C44;
L1_D_800B0CA8 = D_800B6C48;
L1_D_800B0CB0 = D_800B6C50;
L1_D_800B0CC4 = D_800B6C64;
L1_D_800B0D50 = D_800B6CF0;
L1_D_800B0D94 = D_800B6D34;
L1_D_800B0D9C = D_800B6D3C;
L1_D_800B0DA0 = D_800B6D40;
L1_D_800B0DA4 = D_800B6D44;
L1_D_800B0DA8 = D_800B6D48;
L1_D_800B0DAC = D_800B6D4C;
L1_D_800B0DB0 = D_800B6D50;
L1_D_800B0DB4 = D_800B6D54;
L1_D_800B0DB8 = D_800B6D58;
L1_D_800B0DBC = D_800B6D5C;
L1_D_800B0DC0 = D_800B6D60;
L1_D_800B0DC4 = D_800B6D64;
L1_D_800B0DC8 = D_800B6D68;
L1_D_800B0DCC = D_800B6D6C;
L1_D_800B0DD4 = D_800B6D74;
L1_D_800B0DDC = D_800B6D7C;
L1_D_800B0DE4 = D_800B6D84;
L1_D_800B0E34 = D_800B6DD4;
L1_D_800B0E36 = D_800B6DD6;
L1_D_800B0E40 = D_800B6DE0;
L1_D_800B0E48 = D_800B6DE8;
L1_D_800B0E54 = D_800B6DF4;
L1_D_800B0E58 = D_800B6DF8;
L1_D_800B0E5E = D_800B6DFE;
L1_D_800B0E5F = D_800B6DFF;
L1_D_800B0E62 = D_800B6E02;
L1_D_800B0E63 = D_800B6E03;
L1_D_800B0E8C = D_800B6E2C;
L1_D_800B0EA0 = D_800B6E40;
L1_D_800B0EFC = D_800B6E9C;
L1_D_800B8EFC = D_800BEE9C;
L1_D_800B8F24 = D_800BEEC4;
L1_D_800B8F28 = D_800BEEC8;
L1_D_800B8F68 = D_800BEF08;
L1_D_800B8F88 = D_800BEF28;
L1_D_800B8FB0 = D_800BEF50;
L1_D_800B8FB4 = D_800BEF54;
L1_D_800C1C54 = D_800C7BF4;
L1_D_800CA8F4 = D_800D0894;
L1_D_800D28F4 = D_800D8894;
L1_D_800D2AF8 = D_800D8A98;
L1_D_800D2AFC = D_800D8A9C;
L1_D_800D2BC4 = D_800D8B64;
L1_D_800D2BE8 = D_800D8B88;
L1_D_800D2BEC = D_800D8B8C;
L1_D_800D2BF0 = D_800D8B90;
L1_D_800D2D30 = D_800D8CD0;
L1_D_800D2E70 = D_800D8E10;
L1_D_800D2E74 = D_800D8E14;
L1_D_800D2E84 = D_800D8E24;
L1_D_800D2E90 = D_800D8E30;
L1_D_800D2F48 = D_800D8EE8;
L1_D_800D2F68 = D_800D8F08;
L1_D_800D2F8C = D_800D8F2C;
L1_D_800D2F90 = D_800D8F30;
L1_D_800D2F94 = D_800D8F34;
L1_D_800D2FA4 = D_800D8F44;
L1_D_800D2FA8 = D_800D8F48;
L1_D_800D2FAC = D_800D8F4C;
L1_D_800D2FB0 = D_800D8F50;
L1_D_800D2FC0 = D_800D8F60;
L1_D_800D2FC4 = D_800D8F64;
L1_D_800D2FF4 = D_800D8F94;
L1_D_800D305C = D_800D8FFC;
L1_D_800D3068 = D_800D9008;
L1_D_800D308C = D_800D902C;
L1_D_800D30C0 = D_800D9060;
L1_D_800D30D4 = D_800D9074;
L1_D_800D30D8 = D_800D9078;
L1_D_800D31B8 = D_800D9158;
L1_D_800D31C0 = D_800D9160;
L1_D_800D31D0 = D_800D9170;
L1_D_800D3238 = D_800D91D8;
L1_D_800D3288 = D_800D9228;
L1_D_800D3FA8 = D_800D9F48;
L1_D_800D3FAC = D_800D9F4C;
L1_D_800D3FB0 = D_800D9F50;
L1_D_800D3FD4 = D_800D9F74;
L1_D_800D3FD8 = D_800D9F78;
L1_D_800D3FE0 = D_800D9F80;
L1_D_800D3FE4 = D_800D9F84;
L1_D_800D3FEC = D_800D9F8C;
L1_D_800D3FF0 = D_800D9F90;
L1_D_800D4050 = D_800D9FF0;
L1_D_800D4058 = D_800D9FF8;
L1_D_800D4068 = D_800DA008;
L1_D_800D406C = D_800DA00C;
L1_D_800D4070 = D_800DA010;
L1_D_800D4074 = D_800DA014;
L1_D_800D4080 = D_800DA020;
L1_D_800D40D8 = D_800DA078;
L1_D_800D40F8 = D_800DA098;
L1_D_800D40FC = D_800DA09C;
L1_D_800D4100 = D_800DA0A0;
L1_D_800D4104 = D_800DA0A4;
L1_D_800D4108 = D_800DA0A8;
L1_D_800D410C = D_800DA0AC;
L1_D_800D4110 = D_800DA0B0;
L1_D_800D4114 = D_800DA0B4;
L1_D_800D424C = D_800DA1EC;
L1_D_800D4250 = D_800DA1F0;
L1_D_800D4384 = D_800DA324;
L1_D_800D4385 = D_800DA325;
L1_D_800D4386 = D_800DA326;
L1_D_800D4387 = D_800DA327;
L1_D_800D4388 = D_800DA328;
L1_D_800D4389 = D_800DA329;
L1_D_800D438A = D_800DA32A;
L1_D_800D438B = D_800DA32B;
L1_D_800D438C = D_800DA32C;
L1_D_800D438D = D_800DA32D;
L1_D_800D438E = D_800DA32E;
L1_D_800D438F = D_800DA32F;
L1_D_800D4390 = D_800DA330;
L1_D_800D43A8 = D_800DA348;
L1_D_800D43AC = D_800DA34C;
L1_D_800D43C0 = D_800DA360;
L1_D_800D43C4 = D_800DA364;
L1_D_800D43CC = D_800DA36C;
L1_D_800D43D0 = D_800DA370;
L1_D_800D43E4 = D_800DA384;
L1_D_800D43F0 = D_800DA390;
L1_D_800D43F4 = D_800DA394;
L1_D_800D43F8 = D_800DA398;
L1_D_800D4400 = D_800DA3A0;
L1_D_800D4404 = D_800DA3A4;
L1_D_800D440C = D_800DA3AC;
L1_D_800D4410 = D_800DA3B0;
L1_D_800D4414 = D_800DA3B4;
L1_D_800D4424 = D_800DA3C4;
L1_D_800D4440 = D_800DA3E0;
L1_D_800D4444 = D_800DA3E4;
L1_D_800D4450 = D_800DA3FC;
L1_D_800D4454 = D_800DA400;
L1_D_800D4458 = D_800DA404;
L1_D_800D445C = D_800DA408;
L1_D_800D4464 = D_800DA410;
L1_D_800D4468 = D_800DA414;
L1_D_800D446C = D_800DA418;
L1_D_800D4474 = D_800DA424;
L1_D_800D4484 = D_800DA43C;
L1_D_800D4564 = D_800DA51C;
L1_D_800D45C4 = D_800DA57C;
L1_D_800D45F4 = D_800DA5AC;
L1_D_800D4688 = D_800DA640;
L1_D_800D46D8 = D_800DA690;
L1_D_800D4958 = D_800DA910;
L1_D_800D4984 = D_800DA93C;
L1_D_800D5DA4 = D_800DBD5C;
L1_D_800D5E80 = D_800DBE38;
L1_D_800D5ED0 = D_800DBE88;
L1_D_800D5ED8 = D_800DBE90;
L1_D_800D5EF0 = D_800DBEA8;
L1_D_800D5F40 = D_800DBEF8;
L1_D_800D5F48 = D_800DBF00;
L1_D_800D74F8 = D_800DD4B0;
L1_D_800D74FC = D_800DD4B4;
L1_D_800D7500 = D_800DD4B8;
L1_D_800D7550 = D_800DD508;
L1_D_800D7554 = D_800DD50C;
L1_D_800D7588 = D_800DD540;
L1_D_800D77B8 = D_800DD770;
L1_D_800D77E8 = D_800DD7A0;
L1_D_800D7838 = D_800DD7F0;
L1_D_800D7888 = D_800DD840;
L1_D_800D78D8 = D_800DD890;
L1_D_800D7930 = D_800DD8E8;
L1_D_800D7980 = D_800DD938;
L1_D_800D79D0 = D_800DD988;
L1_D_800D79D4 = D_800DD98C;
L1_D_800D7A1C = D_800DD9D4;
L1_D_800D7A20 = D_800DD9D8;
L1_D_800D7AB8 = D_800DDA70;
L1_D_800D7B08 = D_800DDAC0;
L1_D_800D7BE8 = D_800DDBA0;
L1_D_800D7BF0 = D_800DDBA8;
L1_D_800D7C24 = D_800DDBDC;
L1_D_800D7C64 = D_800DDC1C;
L1_D_800D7CB4 = D_800DDC6C;
L1_D_800D7CB8 = D_800DDC70;
L1_D_800D7D08 = D_800DDCC0;
L1_D_800D7DF8 = D_800DDDB0;
L1_D_800D7DFC = D_800DDDB4;
L1_D_800D7E9C = D_800DDE54;
L1_D_800D7EEC = D_800DDEA4;
L1_D_800D7FDC = D_800DDF94;
L1_D_800D811C = D_800DE0D4;
L1_D_800D8138 = D_800DE0F0;
L1_D_800D8150 = D_800DE108;
L1_D_800D8154 = D_800DE10C;
L1_D_800D861C = D_800DE5D4;
L1_D_800D8620 = D_800DE5D8;
L1_D_800D8624 = D_800DE5DC;
L1_D_800D8674 = D_800DE62C;
L1_D_800D86C4 = D_800DE67C;
L1_D_800D86C8 = D_800DE680;
L1_D_800D86DC = D_800DE694;
L1_D_800D86E0 = D_800DE698;
L1_D_800D86E4 = D_800DE69C;
L1_D_800D86E8 = D_800DE6A0;
L1_D_800D8BE8 = D_800DEBA0;
L1_D_800D8C7C = D_800DEC34;
L1_D_800D8C90 = D_800DEC48;
L1_D_800D8C94 = D_800DEC4C;
L1_D_800D8E74 = D_800DEE2C;
L1_D_800D8E8C = D_800DEE44;
L1_D_800D8EA4 = D_800DEE5C;
L1_D_800D8EA8 = D_800DEE60;
L1_D_800D8EE8 = D_800DEEA0;
L1_D_800D8FE8 = D_800DEFA0;
L1_D_800D8FF8 = D_800DEFB0;
L1_D_800D90C0 = D_800DF078;
L1_D_800D911C = D_800DF0D4;
L1_D_800D91E4 = D_800DF19C;
L1_D_800D91E7 = D_800DF19F;
L1_D_800D91E8 = D_800DF1A0;
L1_D_800D91F0 = D_800DF1A8;
L1_D_800D91F8 = D_800DF1B0;
L1_D_800D91FC = D_800DF1B4;
L1_D_800D9200 = D_800DF1B8;
L1_D_800D9208 = D_800DF1C0;
L1_D_800D920C = D_800DF1C4;
L1_D_800D9210 = D_800DF1C8;
L1_D_800D9214 = D_800DF1CC;
L1_D_800D9218 = D_800DF1D0;
L1_D_800D9232 = D_800DF1EA;
L1_D_800D9268 = D_800DF224;
L1_D_800D9278 = D_800DF234;
L1_D_800DA270 = D_800E022C;
L1_D_800DA5C0 = D_800E057C;
L1_D_800DA5C4 = D_800E0580;
L1_D_800DB7E4 = D_800E17A0;
L1_D_800DB884 = D_800E1840;
L1_D_800DCAA4 = D_800E2A60;
L1_D_800DCB44 = D_800E2B00;
L1_D_800DCB4C = D_800E2B08;
L1_D_800DD7F4 = D_800E37B0;
L1_D_800DDC44 = D_800E37B4;
L1_D_800DDC48 = D_800E37B8;
L1_D_800DDC4C = D_800E37BC;
L1_D_800DDC50 = D_800E37C0;
L1_D_800DDC54 = D_800E37C4;
L1_D_800DDC58 = D_800E37C8;
L1_D_800DDC5C = D_800E37CC;
L1_D_800DDC60 = D_800E37D0;
L1_D_800DDC64 = D_800E37D4;
L1_D_800DDC68 = D_800E37D8;
L1_D_800DDC6C = D_800E37DC;
L1_D_800DDCC0 = D_800E3830;
L1_D_800DDCC4 = D_800E3834;
L1_D_800DDCC8 = D_800E3838;
L1_D_800DDCCC = D_800E383C;
L1_D_800DDD8C = D_800E38FC;
L1_D_800DDD90 = D_800E3900;
L1_D_800DDD94 = D_800E3904;
L1_D_800DDD98 = D_800E3908;
L1_D_800DDDA0 = D_800E3910;
L1_D_800DDDA4 = D_800E3914;
L1_D_800DDDA8 = D_800E3918;
L1_D_800DDDAC = D_800E391C;
L1_D_800DDDB0 = D_800E3920;
L1_D_800DDDB4 = D_800E3924;
L1_D_800DDDB8 = D_800E3928;
L1_D_800DDDBC = D_800E392C;
L1_D_800DDDCC = D_800E393C;
L1_D_800DDDDC = D_800E394C;
L1_D_800DDDEC = D_800E395C;
L1_D_800DDE04 = D_800E3974;
L1_D_800DDE08 = D_800E3978;
L1_D_800DDE10 = D_800E3980;
L1_D_800DDE30 = D_800E39A0;
L1_D_800DDE34 = D_800E39A4;
L1_D_800DDEE0 = D_800E3A50;
L1_D_800DDEE4 = D_800E3A54;
L1_D_800DDEE8 = D_800E3A58;
L1_D_800DDEEC = D_800E3A5C;
L1_D_800DDEF0 = D_800E3A60;
L1_D_800DDF08 = D_800E3A78;
L1_D_800DDF24 = D_800E3A94;
L1_D_800DDFEC = D_800E3B5C;
L1_D_800DE000 = D_800E3B70;
L1_D_800DE004 = D_800E3B74;
L1_D_800DE018 = D_800E3B88;
L1_D_800DE0C4 = D_800E3C34;
L1_D_800DE0C8 = D_800E3C38;
L1_D_800DE0D4 = D_800E3C44;
L1_D_800DE0D8 = D_800E3C48;
L1_D_800DE0DC = D_800E3C4C;
L1_D_800DE0E0 = D_800E3C50;
L1_D_800DE0E4 = D_800E3C54;
L1_D_800DE0E8 = D_800E3C58;
L1_D_800DE8E8 = D_800E4458;
L1_D_800DF0E8 = D_800E4C58;
L1_D_800DF0EC = D_800E4C5C;
L1_D_800DF0F0 = D_800E4C60;
L1_D_800DF0F8 = D_800E4C68;
L1_D_800DF10C = D_800E4C7C;
L1_D_800DF12C = D_800E4C9C;
L1_D_800DF1F4 = D_800E4D64;
L1_D_800DF200 = D_800E4D70;
L1_D_800DF540 = D_800E50B0;
L1_D_800DF5B8 = D_800E5128;
L1_D_800DF684 = D_800E51F4;
L1_D_800E02B4 = D_800E5E24;
L1_D_800E23D4 = D_800E88C4;
L1_D_800E23E8 = D_800E88D0;
L1_D_800E2438 = D_800E8950;
L1_D_800E2448 = D_800E8960;
L1_D_800E2DA8 = D_800E92C0;
L1_D_800E2DBC = D_800E92D4;
L1_D_800E2DE0 = D_800E92F8;
L1_D_800E2DE4 = D_800E92FC;
L1_D_800E2DF4 = D_800E930C;
L1_D_800E2E44 = D_800E935C;
L1_D_800E2E48 = D_800E9360;
L1_D_800E2E4C = D_800E9364;
L1_D_800E2F2C = D_800E9444;
L1_D_800E2F38 = D_800E9450;
L1_D_800E2F3C = D_800E9454;
L1_D_800E2F54 = D_800E946C;
L1_D_800E2F58 = D_800E9470;
L1_D_800E2F5C = D_800E9474;
L1_D_800F0F5C = D_800F6474;
L1_D_800F0F80 = D_800F6498;
L1_D_800F10A8 = D_800F65C0;
L1_D_800F1180 = D_800F6850;
L1_D_800F11A0 = D_800F6870;
L1_D_800F11D0 = D_800F68A0;
L1_D_800F11F0 = D_800F68C0;
L1_D_800F128C = D_800F695C;
L1_D_800F1294 = D_800F6964;
L1_D_800F12D4 = D_800F69A4;
L1_D_800F12EC = D_800F69BC;
L1_D_800F12F4 = D_800F69C4;
L1_D_800F1314 = D_800F69E4;
L1_D_800F1354 = D_800F6A24;
L1_D_800F136C = D_800F6A3C;
L1_D_800F1374 = D_800F6A44;
L1_D_800F138C = D_800F6A5C;
L1_D_800F1398 = D_800F6A68;
L1_D_800F13A8 = D_800F6A78;
L1_D_800F1DCC = D_800F749C;
L1_D_800F25D8 = D_800F7CA8;
L1_D_800F2FBC = D_800F868C;
L1_D_800F3848 = D_800F8F18;
L1_D_800F3B48 = D_800F9218;
L1_D_800F3E98 = D_800F9568;
L1_D_800F40DC = D_800F97AC;
L1_D_800F40E0 = D_800F97B0;
L1_D_800F40F8 = D_800F97C8;
L1_D_800F40FC = D_800F97CC;
L1_D_800F4114 = D_800F97E4;
L1_D_800F413C = D_800F980C;
L1_D_800F415C = D_800F982C;
L1_D_800F4264 = D_800F9934;
L1_D_800F4268 = D_800F9938;
L1_D_800F426C = D_800F993C;
L1_D_800F4270 = D_800F9940;
L1_D_800F5A64 = D_800FB134;
L1_D_800F5A65 = D_800FB135;
L1_D_800F5A66 = D_800FB136;
L1_D_800F5A68 = D_800FB138;
L1_D_800F5A6C = D_800FB13C;
L1_D_800F6040 = D_800FB710;
L1_D_800F6064 = D_800FB734;
L1_D_800F6068 = D_800FB738;
L1_D_800F606C = D_800FB73C;
L1_D_800F6070 = D_800FB740;
L1_D_800F7664 = D_800FCD34;
L1_D_800F7E64 = D_800FD534;
L1_D_800F7EC4 = D_800FD594;
L1_D_800F7EC8 = D_800FD598;
L1_D_800F7EC9 = D_800FD599;
L1_D_800F7ECA = D_800FD59A;
L1_D_800F7ECC = D_800FD59C;
L1_D_800F7ECE = D_800FD59E;
L1_D_800F7ED0 = D_800FD5A0;
L1_D_800F7ED2 = D_800FD5A2;
L1_D_800F7EE4 = D_800FD5B4;
L1_D_800F7EE8 = D_800FD5B8;
L1_D_800F7EEC = D_800FD5BC;
L1_D_800F7EF4 = D_800FD5C4;
L1_D_800F7EF8 = D_800FD5C8;
L1_D_800F7EFC = D_800FD5CC;
L1_D_800F7F00 = D_800FD5D0;
L1_D_800F7F04 = D_800FD5D4;
L1_D_800F7F08 = D_800FD5D8;
L1_D_800F7F10 = D_800FD5E0;
L1_D_800F7F1C = D_800FD5EC;
L1_D_800F7F64 = D_800FD634;
L1_D_800F7F68 = D_800FD638;
L1_D_800F7F6C = D_800FD63C;
L1_D_800F7F70 = D_800FD640;
L1_D_800F7F74 = D_800FD644;
L1_D_800F7F81 = D_800FD651;
L1_D_800F7F84 = D_800FD654;
L1_D_800F7FCC = D_800FD69C;
L1_D_800F8014 = D_800FD6E4;
L1_D_800F81F4 = D_800FD8C4;
L1_D_800F81F8 = D_800FD8C8;
L1_D_800F8204 = D_800FD8D4;
L1_D_800F8208 = D_800FD8D8;
L1_D_800F8214 = D_800FD8E4;
L1_D_800F8614 = D_800FDCE4;
L1_D_800FC614 = D_80101CE4;
L1_D_800FC616 = D_80101CE6;
L1_D_800FC624 = D_80101CF4;
L1_D_800FC628 = D_80101CF8;
L1_D_800FC62C = D_80101CFC;
L1_D_800FC630 = D_80101D00;
L1_D_800FC640 = D_80101D10;
L1_D_800FC644 = D_80101D14;
L1_D_800FC648 = D_80101D18;
L1_D_800FC650 = D_80101D20;
L1_D_800FC654 = D_80101D24;
L1_D_800FC658 = D_80101D28;
L1_D_800FC65C = D_80101D2C;
L1_D_800FC660 = D_80101D30;
L1_D_800FC664 = D_80101D34;
L1_D_800FC670 = D_80101D40;
L1_D_800FC67C = D_80101D4C;
L1_D_800FC6A0 = D_80101D70;
L1_D_800FC6B0 = D_80101D80;
L1_D_800FC6C0 = D_80101D90;
L1_D_800FC780 = D_80101E50;
L1_D_800FC784 = D_80101E54;
L1_D_800FC788 = D_80101E58;
L1_D_800FC790 = D_80101E60;
L1_D_800FC794 = D_80101E64;
L1_D_800FCF94 = D_80102664;
L1_D_800FCF98 = D_80102668;
L1_D_800FCF9C = D_8010266C;
L1_D_800FCFA0 = D_80102670;
L1_D_800FCFA4 = D_80102674;
L1_D_800FCFA8 = D_80102678;
L1_D_800FCFAC = D_8010267C;
L1_D_800FCFB0 = D_80102680;
L1_D_800FCFB4 = D_80102684;
L1_D_800FD038 = D_80102708;
L1_D_800FD0B8 = D_80102788;
L1_D_800FD0F8 = D_801027C8;
L1_D_800FD138 = D_80102808;
L1_D_800FD178 = D_80102848;
L1_D_800FD17C = D_8010284C;
L1_D_800FD190 = D_80102860;
L1_D_800FD191 = D_80102861;
L1_D_800FD195 = D_80102865;
L1_D_800FD197 = D_80102867;
L1_D_800FD19A = D_8010286A;
L1_D_800FD19B = D_8010286B;
L1_D_800FD19F = D_8010286F;
L1_D_800FD1A1 = D_80102871;
L1_D_800FD1A2 = D_80102872;
L1_D_800FD1A4 = D_80102874;
L1_D_800FD1A6 = D_80102874 + 0x2;
L1_D_800FD1A8 = D_80102878;
L1_D_800FD1AC = D_8010287C;
L1_D_800FD1BC = D_8010288C;
L1_D_800FD1C0 = D_80102890;
L1_D_800FD1C4 = D_80102894;
L1_D_800FD1C8 = D_80102898;
L1_D_800FD208 = D_801028D8;
L1_D_800FD248 = D_80102918;
L1_D_800FD24C = D_8010291C;
L1_D_800FD254 = D_80102924;
L1_D_800FD258 = D_80102928;
L1_D_800FD25C = D_8010292C;
L1_D_800FD260 = D_80102930;
L1_D_800FD264 = D_80102934;
L1_D_800FD266 = D_80102936;
L1_D_800FD268 = D_80102938;
L1_D_800FD26A = D_8010293A;
L1_D_800FD26C = D_8010293C;
L1_D_800FD3E4 = D_80102AB4;
L1_D_800FD3E8 = D_80102AB8;
L1_D_800FD400 = D_80102AD0;
L1_D_800FD440 = D_80102B10;
L1_D_800FD442 = D_80102B12;
L1_D_800FD444 = D_80102B14;
L1_D_800FD446 = D_80102B16;
L1_D_800FD448 = D_80102B18;
L1_D_800FD44A = D_80102B1A;
L1_D_800FD44C = D_80102B1C;
L1_D_800FD44E = D_80102B1E;
L1_D_800FD450 = D_80102B20;
L1_D_800FD452 = D_80102B22;
L1_D_800FD454 = D_80102B24;
L1_D_800FD456 = D_80102B26;
L1_D_800FD458 = D_80102B28;
L1_D_800FD45A = D_80102B2A;
L1_D_800FD45D = D_80102B2D;
L1_D_800FD45E = D_80102B2E;
L1_D_800FD460 = D_80102B30;
L1_D_800FD462 = D_80102B32;
L1_D_800FD464 = D_80102B34;
L1_D_800FD466 = D_80102B36;
L1_D_800FD46A = D_80102B3A;
L1_D_800FD46C = D_80102B3C;
L1_D_800FD46E = D_80102B3E;
L1_D_800FD470 = D_80102B40;
L1_D_800FD472 = D_80102B42;
L1_D_800FD476 = D_80102B46;
L1_D_800FD824 = D_80102EF4;
L1_D_800FD980 = D_80103050;
L1_D_800FD984 = D_80103054;
L1_D_800FD988 = D_80103058;
L1_D_800FD98C = D_8010305C;
L1_D_800FD990 = D_80103060;
L1_D_800FD994 = D_80103064;
L1_D_800FD998 = D_80103068;
L1_D_800FD99C = D_8010306C;
L1_D_800FD9A0 = D_80103070;
L1_D_800FD9A4 = D_80103074;
L1_D_800FD9AC = D_8010307C;
L1_D_800FD9C0 = D_80103090;
L1_D_800FD9C8 = D_80103098;
L1_D_800FD9D0 = D_801030A0;
L1_D_800FD9D8 = D_801030A8;
L1_D_800FD9DC = D_801030AC;
L1_D_800FD9E0 = D_801030B0;
L1_D_800FD9F4 = D_801030C4;
L1_D_800FDA04 = D_801030D4;
L1_D_800FDA08 = D_801030D8;
L1_D_800FDA0C = D_801030DC;
L1_D_800FDA24 = D_801030F4;
L1_D_800FDB2C = D_801031FC;
L1_DebugPage_ArtProfile = func_80041A88;
func_80041D80 = L1_DebugPage_Camera;
L1_DebugPage_ContourMask = func_80077AA0;
L1_DebugPage_FPWeapon = func_8007E10C;
L1_DebugPage_Framerate = func_80041AC4;
L1_DebugPage_Loadpoint = func_80031F68;
func_80041B10 = L1_DebugPage_ObjectCount;
L1_DebugPage_Profile = func_80041A4C;
func_8002FDCC = L1_DebugScreen_DrawPage;
L1_DeliverEvent = func_800988F0;
func_80032E24 = L1_DevMenu_Draw;
func_80032BCC = L1_DevMenu_HandleInput;
func_80032FEC = L1_DevMenu_Init;
L1_DisableEvent = func_8009F89C;
L1_EVENT_OBJ_11C = func_8008A7C4;
L1_EVENT_OBJ_90 = func_8008A738;
L1_EVENT_OBJ_CC = func_8008A774;
L1_EVENT_OBJ_F4 = func_8008A79C;
L1_EnableEvent = func_80083A24;
L1_FlushCache = func_8009FBAC;
L1_FntFlush = func_8008C898;
L1_FntLoad = func_8008C540;
L1_FntOpen = func_8008C5E0;
L1_FntPrint = func_8008CBB4;
L1_GPU_cw = func_800932D4;
L1_GS_001_OBJ_1F8 = func_80089610;
L1_GS_001_OBJ_74 = func_8008948C;
L1_GS_107_OBJ_4B8 = func_8007B738;
L1_GS_107_OBJ_51C = func_8007B79C;
L1_GetClut = func_80086950;
L1_GetTPage = func_800869D0;
func_8002F7E8 = L1_Gfx_Init;
L1_GsClearOt = func_8008DD20;
L1_GsDefDispBuff = func_8008F000;
L1_GsGetActiveBuff = func_80089988;
L1_GsGetHeadpUnit = func_8009300C;
L1_GsGetLs = func_8007EEB0;
L1_GsGetLsUnit = func_80091778;
L1_GsGetLwUnit = func_80091A48;
L1_GsGetTimInfo = func_80090BA0;
L1_GsInit3D = func_8008EF80;
L1_GsInitGraph = func_80089418;
L1_GsInitGraph2 = func_800895A8;
L1_GsInitVcount = func_8008A888;
L1_GsLinkAnim = func_80092CA0;
L1_GsLinkObject4 = func_8008A8C8;
L1_GsMapCoordUnit = func_800922A8;
L1_GsMapModelingData = func_800904E0;
L1_GsMapUnit = func_80092328;
L1_GsScanAnim = func_80092BF8;
L1_GsScanUnit = func_80092E54;
L1_GsSetAmbient = func_80093184;
L1_GsSetDrawBuffClip = func_80097C48;
L1_GsSetDrawBuffOffset = func_80089998;
L1_GsSetFlatLight = func_8007B280;
L1_GsSetRefView2 = func_80089B68;
L1_GsSortClear = func_80089830;
L1_GsSortObject4 = func_800801CC;
L1_GsSortOt = func_8008C440;
L1_GsSortUnit = func_800915A4;
L1_GsSwapDispBuff = func_8008DD80;
L1_GsTMDdivF3NL = func_8008F5F0;
L1_GsTMDdivG3NL = func_8008F7E0;
L1_GsTMDdivNF3 = func_8008EB90;
L1_GsTMDdivNG3 = func_8008ED80;
L1_GsTMDdivTF3L = func_8008F9E0;
L1_GsTMDdivTF3LFG = func_8008DE30;
L1_GsTMDdivTF3NL = func_8008D400;
L1_GsTMDdivTG3NL = func_8008D6B0;
L1_GsTMDdivTNF3 = func_8008FF90;
L1_GsTMDdivTNG3 = func_80090240;
L1_GsTMDfastF3GL = func_8008D900;
L1_GsTMDfastF3GLFG = func_8008F0C0;
L1_GsTMDfastF3GNL = func_8008E660;
L1_GsTMDfastF3L = func_80081838;
L1_GsTMDfastF3LFG = func_80081980;
L1_GsTMDfastF3NL = func_800816F8;
L1_GsTMDfastG3GL = func_8008DB20;
L1_GsTMDfastG3GLFG = func_8008F2E0;
L1_GsTMDfastG3GNL = func_8008EA20;
L1_GsTMDfastG3L = func_80081294;
L1_GsTMDfastG3LFG = func_80081424;
L1_GsTMDfastG3NL = func_80081154;
L1_GsTMDfastNF3 = func_800815BC;
L1_GsTMDfastNG3 = func_8008100C;
L1_GsTMDfastTF3L = func_80080D2C;
L1_GsTMDfastTF3LFG = func_80080E9C;
L1_GsTMDfastTF3NL = func_80080BC8;
L1_GsTMDfastTG3L = func_8007FE60;
L1_GsTMDfastTG3LFG = func_80080014;
L1_GsTMDfastTG3NL = func_8007FD04;
L1_GsTMDfastTNF3 = func_80080A5C;
L1_GsTMDfastTNG3 = func_8007FB8C;
L1_GsU_00000008 = func_8009E16C;
L1_GsU_00000009 = func_8009E2EC;
L1_GsU_0000000c = func_8009D82C;
L1_GsU_0000000d = func_8009D9EC;
L1_GsU_0000000f = func_8009DBBC;
L1_GsU_00000209 = func_8009E47C;
L1_GsU_0000020d = func_8009DD9C;
L1_GsU_00200009 = func_8009E61C;
L1_GsU_0020000d = func_8009DF8C;
L1_GsU_01000000 = func_8009C88C;
L1_GsU_0100000c = func_8009C3EC;
L1_GsU_0100000d = func_8009C65C;
L1_GsU_02000000 = func_8009C2AC;
L1_GsU_02000001 = func_8009C33C;
L1_GsU_03000000 = D_8009C9BC;
L1_GsU_03000001 = func_8009D0FC;
L1_GsU_03000010 = func_8009D2DC;
L1_GsU_03000011 = func_8009D4CC;
L1_Gssub_make_matrix = func_80090FB0;
L1_HookEntryInt = func_80097908;
L1_INTR_DMA_OBJ_1CC = func_80097AE4;
L1_INTR_DMA_OBJ_278 = func_80097B90;
L1_INTR_DMA_OBJ_4C = func_80097964;
L1_INTR_VB_OBJ_58 = func_80097810;
L1_INTR_VB_OBJ_C4 = func_8009787C;
L1_INTR_VB_OBJ_F0 = func_800978A8;
L1_ISO9660_OBJ_2D8 = func_800884E4;
L1_ISO9660_OBJ_2F8 = func_80088504;
L1_ISO9660_OBJ_5BC = func_800887C8;
L1_ISO9660_OBJ_660 = func_8008886C;
L1_ISO9660_OBJ_8FC = func_80088B08;
L1_InitGeom = func_8008C3B8;
L1_InitHeap3 = func_80090480;
L1_LoadClut = func_80090AC0;
L1_LoadClut2 = func_80090B30;
L1_LoadTPage = func_8009A4C0;
func_80077DE4 = L1_Math_Abs;
func_80077E20 = L1_Math_Max;
func_80077ED4 = L1_Math_Max3;
func_80077E6C = L1_Math_Min3;
L1_Menu_ResetState = func_800291D4;
L1_MulMatrix = func_8007F510;
L1_MulMatrix2 = func_8007F620;
L1_OpenEvent = func_80083B48;
L1_PADIF_OBJ_120 = func_80099EC0;
L1_PADIF_OBJ_1CC = func_80099F6C;
L1_PADIF_OBJ_290 = func_8009A030;
L1_PADIF_OBJ_48 = func_80099DE8;
L1_PADPORTD_OBJ_160 = func_8008AD18;
L1_PADPORTD_OBJ_1C8 = func_8008AD80;
L1_PADPORTD_OBJ_2BC = func_8008AE74;
L1_PADPORTD_OBJ_2CC = func_8008AE84;
L1_PADPORTD_OBJ_388 = func_8008AF40;
L1_PADPORTD_OBJ_604 = func_8008B1BC;
L1_PADPORTD_OBJ_63C = func_8008B1F4;
L1_PADSEQD_OBJ_144 = func_80098D44;
L1_PADSEQD_OBJ_34 = func_80098C34;
L1_PADSEQD_OBJ_488 = func_80099088;
L1_PATCHGTE_OBJ_DC = D_8009A4BC;
L1_PCcreat = func_80089968;
L1_PClseek = func_80088B8C;
L1_PCopen = func_800881EC;
L1_PCread = func_80087AB4;
L1_PadInitDirect = func_8008ABB8;
func_800455EC = L1_Pad_StickToSpeed;
func_8002F37C = L1_Pad_Update;
func_8004240C = L1_PauseMenu_Open;
L1_PopMatrix = func_8007B954;
L1_PushMatrix = func_8007B8B0;
L1_ResetEntryInt = func_80097BE8;
func_80042DEC = L1_RestartPrompt_Open;
L1_ReturnFromException = func_80097BD8;
L1_RotAverage3 = func_8009B000;
L1_RotAverageNclip3 = func_8009AF70;
L1_RotAverageNclipColorCol3 = func_8009B97C;
L1_RotAverageNclipColorDpq3 = func_8009A610;
L1_RotAverageNclipColorDpq3_1 = func_8009AA68;
L1_RotMatrix = func_800926D8;
L1_RotMatrixY = func_80090E10;
L1_RotMatrixYXZ = func_80092968;
L1_RotMatrixYXZ_gte = func_800913A4;
L1_RotTrans = func_800932A4;
L1_ScaleMatrix = func_80093044;
L1_SetBackColor = func_8009E7BC;
L1_SetColorMatrix = func_8007B880;
L1_SetDefDispEnv = func_8008F5B0;
L1_SetDefDrawEnv = func_8008F4E0;
L1_SetDrawMode = func_80086850;
L1_SetDumpFnt = func_8008C500;
L1_SetFarColor = func_8009EEBC;
L1_SetLightMatrix = func_80093264;
L1_SetLineF4 = func_80086830;
L1_SetRotMatrix = func_80093214;
L1_SetTransMatrix = func_80093244;
L1_SpuClearReverbWorkArea = func_80098920;
L1_SpuFree = func_80098B40;
L1_SpuGetVoiceEnvelope = func_8009EB2C;
L1_SpuInitMalloc = func_8009FBCC;
L1_SpuIsTransferCompleted = func_8009BB3C;
L1_SpuMalloc = func_8009BFDC;
L1_SpuRead = func_8009BADC;
L1_SpuSetCommonAttr = func_8009519C;
L1_SpuSetKey = func_8009EB7C;
L1_SpuSetNoiseClock = func_8009ED6C;
L1_SpuSetTransferMode = func_8009BA4C;
L1_SpuSetTransferStartAddr = func_8009BA7C;
L1_SpuSetVoiceAttr = func_80098080;
L1_SpuStart = func_80095FFC;
L1_SquareRoot0 = func_8007B7F0;
L1_SquareRoot12 = func_800911B0;
L1_SsEnd = func_8008AB08;
L1_SsPitchFromNote = func_800940C8;
L1_SsSeqCalledTbyT = func_80098680;
L1_SsSetSerialAttr = func_80086740;
L1_SsSetSerialVol = func_80086594;
L1_SsSetTickMode = func_8008A268;
L1_SsUtAllKeyOff = func_8008A108;
L1_SsVabClose = func_8008AA58;
L1_SsVabOpenHead = func_80090A20;
L1_SsVabTransBody = func_800907D0;
L1_SsVabTransCompleted = func_800908A0;
L1_SsVoKeyOn = func_800861EC;
L1_SysDeqIntRP = func_80099CC0;
L1_SysEnqIntRP = func_80099CD0;
L1_TestEvent = func_8009FBBC;
L1_TransposeMatrix = func_80091080;
L1_VSYNC_OBJ_178 = func_80088D38;
L1_VS_VH2_OBJ_34 = func_80090A54;
L1_VSync = func_80088BC0;
func_80077B10 = L1_Vec_Dot;
func_80077B8C = L1_Vec_ProjectXZ;
func_80077C34 = L1_Vec_Scale;
L1_WaitEvent = func_8009F88C;
L1__SN_read = func_80096104;
L1__SN_write = func_80097CE8;
L1__SpuInit = func_80095F14;
L1__SpuSetAnyVoice = func_8009FC2C;
L1__SsGetSeqData = func_800A022C;
L1__SsInit = func_800932E4;
L1__SsReadDeltaValue = func_800A0D6C;
L1__SsSeqGetEof = func_8009FFE8;
L1__SsSeqPlay = func_8009FEEC;
L1__SsSndCrescendo = func_8009F14C;
L1__SsSndNextSep = func_800A0C6C;
L1__SsSndPause = func_8009F57C;
L1__SsSndPlay = func_8009F11C;
L1__SsSndReplay = func_8009F61C;
L1__SsSndTempo = func_8009F35C;
L1__SsVmAlloc = func_80094EEC;
L1__SsVmDoAllocate = func_800938D4;
L1__SsVmFlush = func_80093444;
L1__SsVmInit = func_8009E7DC;
L1__SsVmKeyOffNow = func_800946C4;
L1__SsVmKeyOnNow = func_800941F4;
L1__SsVmSelectToneAndVag = func_8009EDBC;
L1__SsVmVSetUp = func_80093384;
L1__dirFailAuto = func_80098FA8;
L1__gp = D_800B0430;
L1__padInitDirSeq = func_80098C00;
L1__patch_gte = func_8009A3E0;
L1__spu_gcSPU = func_8009F8AC;
L1_bzero = func_800990C0;
L1_calloc3 = func_80090550;
L1_chkRC2wait = func_80099D00;
L1_exit = func_80086970;
L1_free3 = func_80090680;
PROVIDE(L1_func_800274F4 = func_80027690);
PROVIDE(func_80027690 = L1_func_800274F4);
func_8002850C = L1_func_80028370;
PROVIDE(L1_func_8002847C = func_80028618);
PROVIDE(func_80028618 = L1_func_8002847C);
func_80028814 = L1_func_80028678;
L1_func_800286EC = func_80028888;
func_800288C8 = L1_func_8002872C;
func_800289AC = L1_func_80028810;
func_800289F4 = L1_func_80028858;
func_80028AF4 = L1_func_80028958;
L1_func_800289C0 = func_80028B5C;
func_80028CF4 = L1_func_80028B58;
func_80028DA4 = L1_func_80028C08;
func_80028F58 = L1_func_80028DBC;
func_80029200 = L1_func_80029064;
PROVIDE(L1_func_800291B0 = func_8002934C);
PROVIDE(func_8002934C = L1_func_800291B0);
func_80029650 = L1_func_800294B4;
func_800296A0 = L1_func_80029504;
L1_func_8002967C = func_80029818;
func_80029820 = L1_func_80029684;
func_80029A04 = L1_func_80029868;
L1_func_800299CC = func_80029B68;
PROVIDE(L1_func_80029A34 = func_80029BD0);
PROVIDE(func_80029BD0 = L1_func_80029A34);
func_8002A564 = L1_func_8002A3C8;
func_8002A7B8 = L1_func_8002A61C;
func_8002A8BC = L1_func_8002A720;
func_8002A9F0 = L1_func_8002A854;
func_8002AC30 = L1_func_8002AA94;
L1_func_8002AAC4 = func_8002AC60;
func_8002AC98 = L1_func_8002AAFC;
func_8002AE2C = L1_func_8002AC90;
L1_func_8002ADF0 = func_8002AF8C;
func_8002AFD0 = L1_func_8002AE34;
L1_func_8002AF08 = func_8002B0A4;
func_8002B194 = L1_func_8002AFF8;
L1_func_8002B064 = func_8002B200;
func_8002B23C = L1_func_8002B0A0;
func_8002B318 = L1_func_8002B17C;
PROVIDE(L1_func_8002B29C = func_8002B438);
PROVIDE(func_8002B438 = L1_func_8002B29C);
func_8002B838 = L1_func_8002B69C;
L1_func_8002BB34 = func_8002BCD0;
func_8002BD04 = L1_func_8002BB68;
func_8002BDB4 = L1_func_8002BC18;
func_8002BFC0 = L1_func_8002BE24;
func_8002C0D0 = L1_func_8002BF34;
func_8002C304 = L1_func_8002C168;
L1_func_8002C2D8 = func_8002C474;
func_8002C62C = L1_func_8002C490;
L1_func_8002C664 = func_8002C800;
func_8002C858 = L1_func_8002C6BC;
L1_func_8002C83C = func_8002C9D8;
L1_func_8002C844 = func_8002C9E0;
func_8002D28C = L1_func_8002D0F0;
func_8002D370 = L1_func_8002D1D4;
func_8002D680 = L1_func_8002D4E4;
func_8002D7A0 = L1_func_8002D604;
func_8002D8A4 = L1_func_8002D708;
func_8002DEA0 = L1_func_8002DD6C;
L1_func_8002E0E8 = func_8002E220;
L1_func_8002E190 = func_8002E2C8;
func_8002E2E8 = L1_func_8002E1B0;
func_8002E454 = L1_func_8002E318;
L1_func_8002E3A0 = func_8002E4DC;
L1_func_8002E410 = func_8002E54C;
L1_func_8002E430 = func_8002E56C;
L1_func_8002E48C = func_8002E5C8;
L1_func_8002E4B4 = func_8002E5F0;
L1_func_8002E4D4 = func_8002E610;
func_8002E618 = L1_func_8002E4DC;
L1_func_8002E534 = func_8002E670;
L1_func_8002E5C4 = func_8002E700;
PROVIDE(L1_func_8002E798 = func_8002E8DC);
PROVIDE(func_8002E8DC = L1_func_8002E798);
L1_func_8002F0A4 = func_8002F1E8;
L1_func_8002F114 = func_8002F258;
L1_func_8002F53C = func_8002F680;
func_8002F6A8 = L1_func_8002F564;
func_8002F768 = L1_func_8002F624;
L1_func_8002F7CC = func_8002F910;
PROVIDE(L1_func_8002FFD8 = func_800300FC);
PROVIDE(func_800300FC = L1_func_8002FFD8);
func_8003023C = L1_func_80030118;
func_800303D0 = L1_func_800302AC;
L1_func_80030304 = func_80030428;
L1_func_80030324 = func_80030448;
func_80030458 = L1_func_80030334;
func_800304D8 = L1_func_800303B4;
PROVIDE(L1_func_8003052C = func_80030650);
PROVIDE(func_80030650 = L1_func_8003052C);
L1_func_800305B4 = func_800306D8;
L1_func_80030610 = func_80030734;
func_80030794 = L1_func_80030670;
L1_func_800306A8 = func_800307CC;
L1_func_800306F0 = func_80030814;
func_800308BC = L1_func_80030798;
L1_func_80030868 = func_8003098C;
PROVIDE(L1_func_80030994 = func_80030AB8);
PROVIDE(func_80030AB8 = L1_func_80030994);
func_80030C28 = L1_func_80030B04;
func_80030E2C = L1_func_80030D08;
func_80030EC4 = L1_func_80030DA0;
L1_func_80030EB0 = func_80030FD4;
func_80031044 = L1_func_80030F20;
func_800310CC = L1_func_80030FA8;
func_800311D8 = L1_func_800310B4;
func_800315C4 = L1_func_800314A0;
func_8003179C = L1_func_80031678;
L1_func_80031F18 = func_800321E4;
func_80032340 = L1_func_80032074;
func_800324BC = L1_func_800321F0;
func_8003275C = L1_func_8003246C;
L1_func_800324C0 = func_800327B0;
func_800327C0 = L1_func_800324D0;
L1_func_80032648 = func_80032938;
func_80032A14 = L1_func_80032724;
func_80032A58 = L1_func_80032768;
L1_func_80032880 = func_80032B70;
func_8003313C = L1_func_80032E4C;
PROVIDE(L1_func_80032EFC = func_800331EC);
PROVIDE(func_800331EC = L1_func_80032EFC);
func_80033380 = L1_func_80033090;
func_80033594 = L1_func_800332A4;
func_800336C0 = L1_func_80033348;
func_8003374C = L1_func_800333D4;
func_80033798 = L1_func_80033420;
func_8003386C = L1_func_800334F4;
L1_func_80033F38 = func_80034B0C;
func_8003556C = L1_func_80034998;
func_800355CC = L1_func_800349F8;
func_80035C30 = L1_func_80035030;
L1_func_800350F0 = func_80035CF0;
PROVIDE(L1_func_800352B8 = func_80035F34);
PROVIDE(func_80035F34 = L1_func_800352B8);
func_800365E0 = L1_func_80035964;
func_80036668 = L1_func_800359EC;
func_80036838 = L1_func_80035BBC;
func_80036A64 = L1_func_80035DE8;
func_80036B80 = L1_func_80035F04;
func_80036E38 = L1_func_800361BC;
func_80036FA4 = L1_func_80036328;
func_80037230 = L1_func_800365B4;
func_800372EC = L1_func_80036670;
L1_func_800368A8 = func_80037524;
L1_func_80036938 = func_800375B4;
func_80037A84 = L1_func_80036E10;
L1_func_800373FC = func_800382B4;
func_800385DC = L1_func_80037768;
func_80038668 = L1_func_800377F4;
func_80038770 = L1_func_800378FC;
func_80038898 = L1_func_80037A24;
func_80038940 = L1_func_80037ACC;
L1_func_80037B6C = func_800389E0;
func_80038FF8 = L1_func_800380DC;
PROVIDE(L1_func_800381CC = func_800390E8);
PROVIDE(func_800390E8 = L1_func_800381CC);
func_80039320 = L1_func_80038404;
func_80039620 = L1_func_8003872C;
func_800399A4 = L1_func_80038984;
func_80039CA0 = L1_func_80038C04;
func_80039D28 = L1_func_80038C8C;
L1_func_800390F8 = func_8003A194;
PROVIDE(L1_func_800391B0 = func_8003A24C);
PROVIDE(func_8003A24C = L1_func_800391B0);
L1_func_800393AC = func_8003A448;
func_8003A480 = L1_func_800393E4;
L1_func_80039520 = func_8003A5BC;
L1_func_800395E8 = func_8003A684;
func_8003A81C = L1_func_800397A8;
PROVIDE(L1_func_8003982C = func_8003A8A0);
PROVIDE(func_8003A8A0 = L1_func_8003982C);
func_8003AAA8 = L1_func_80039A34;
PROVIDE(L1_func_80039A9C = func_8003AB10);
PROVIDE(func_8003AB10 = L1_func_80039A9C);
PROVIDE(L1_func_8003A51C = func_8003B590);
PROVIDE(func_8003B590 = L1_func_8003A51C);
PROVIDE(L1_func_8003A68C = func_8003B700);
PROVIDE(func_8003B700 = L1_func_8003A68C);
L1_func_8003A71C = func_8003B790;
func_8003B90C = L1_func_8003A898;
func_8003BA88 = L1_func_8003AA14;
PROVIDE(L1_func_8003AC1C = func_8003BC90);
PROVIDE(func_8003BC90 = L1_func_8003AC1C);
func_8003C568 = L1_func_8003B4F4;
PROVIDE(L1_func_8003B53C = func_8003C5B0);
PROVIDE(func_8003C5B0 = L1_func_8003B53C);
L1_func_8003B750 = func_8003C7C4;
PROVIDE(L1_func_8003B808 = func_8003C87C);
PROVIDE(func_8003C87C = L1_func_8003B808);
func_8003C9B4 = L1_func_8003B940;
func_8003CD0C = L1_func_8003BC98;
func_8003CEDC = L1_func_8003BE68;
func_8003D02C = L1_func_8003BFB8;
func_8003D230 = L1_func_8003C1BC;
func_8003D724 = L1_func_8003C6B0;
func_8003D758 = L1_func_8003C6E4;
func_8003D900 = L1_func_8003C88C;
func_8003D918 = L1_func_8003C8A4;
func_8003DA38 = L1_func_8003C9C4;
L1_func_8003CA4C = func_8003DAC0;
func_8003DB30 = L1_func_8003CABC;
L1_func_8003CC8C = func_8003DD00;
PROVIDE(L1_func_8003D76C = func_8003E770);
PROVIDE(func_8003E770 = L1_func_8003D76C);
func_8003EE5C = L1_func_8003DE58;
func_8003F15C = L1_func_8003E158;
func_8003F498 = L1_func_8003E494;
PROVIDE(L1_func_8003E5A0 = func_8003F5A4);
PROVIDE(func_8003F5A4 = L1_func_8003E5A0);
func_8003FA28 = L1_func_8003EA24;
func_8003FB04 = L1_func_8003EB00;
PROVIDE(L1_func_8003EC44 = func_8003FC48);
PROVIDE(func_8003FC48 = L1_func_8003EC44);
func_8004076C = L1_func_8003F768;
func_80040CD0 = L1_func_8003FCE4;
func_80040F88 = L1_func_8003FF9C;
L1_func_8004009C = func_80041088;
PROVIDE(L1_func_80040778 = func_800415C8);
PROVIDE(func_800415C8 = L1_func_80040778);
func_800417C8 = L1_func_80040978;
func_800418F8 = L1_func_80040AA8;
func_80041EAC = L1_func_8004105C;
func_8004200C = L1_func_800411BC;
L1_func_8004133C = func_8004218C;
func_80042244 = L1_func_800413F4;
L1_func_800414AC = func_800422FC;
L1_func_80041578 = func_800423C8;
func_80042614 = L1_func_800417C4;
L1_func_800419CC = func_800428E0;
func_8004294C = L1_func_80041A38;
func_80042AB4 = L1_func_80041BA0;
func_80042B3C = L1_func_80041C28;
func_80042C04 = L1_func_80041CF0;
func_80042CD0 = L1_func_80041DBC;
func_80042D8C = L1_func_80041E78;
func_80042F34 = L1_func_80042020;
func_800430A0 = L1_func_8004218C;
PROVIDE(L1_func_800425E4 = func_800434F8);
PROVIDE(func_800434F8 = L1_func_800425E4);
L1_func_80042A94 = func_800439A8;
L1_func_80042B28 = func_80043A3C;
func_80043C30 = L1_func_80042D1C;
L1_func_80042E34 = func_80043D48;
L1_func_80042E6C = func_80043D80;
func_80043F8C = L1_func_80043078;
func_80044114 = L1_func_80043200;
L1_func_800433A8 = func_800442BC;
L1_func_800433F4 = func_80044308;
PROVIDE(L1_func_80043610 = func_80044524);
PROVIDE(func_80044524 = L1_func_80043610);
PROVIDE(L1_func_80043B14 = func_80044A28);
PROVIDE(func_80044A28 = L1_func_80043B14);
L1_func_80043EE0 = func_80044DF4;
func_80045794 = L1_func_800448F4;
L1_func_80044B3C = func_800459C4;
L1_func_80044BAC = func_80045A34;
L1_func_80044BBC = func_80045A44;
PROVIDE(L1_func_80044BCC = func_80045A54);
PROVIDE(func_80045A54 = L1_func_80044BCC);
func_80045F0C = L1_func_80045084;
func_80045FD4 = L1_func_8004514C;
func_800461CC = L1_func_80045344;
func_80046554 = L1_func_800456D0;
PROVIDE(L1_func_80045A28 = func_800468AC);
PROVIDE(func_800468AC = L1_func_80045A28);
func_800470F0 = L1_func_8004626C;
PROVIDE(L1_func_800463C8 = func_8004724C);
PROVIDE(func_8004724C = L1_func_800463C8);
func_8004819C = L1_func_80047318;
PROVIDE(L1_func_800474AC = func_80048330);
PROVIDE(func_80048330 = L1_func_800474AC);
func_80048440 = L1_func_800475BC;
L1_func_800477C0 = func_80048644;
L1_func_8004782C = func_800486B0;
L1_func_8004783C = func_800486C0;
func_80048888 = L1_func_80047A04;
func_800489D4 = L1_func_80047B50;
func_80048C40 = L1_func_80047DBC;
L1_func_80047ECC = func_80048D50;
func_80049260 = L1_func_800483D8;
func_800492A4 = L1_func_8004841C;
PROVIDE(L1_func_80048794 = func_8004961C);
PROVIDE(func_8004961C = L1_func_80048794);
func_800499D4 = L1_func_80048B4C;
func_80049C6C = L1_func_80048DE4;
func_80049CE8 = L1_func_80048E60;
L1_func_80048FE8 = func_80049E70;
L1_func_8004900C = func_80049E94;
func_8004A248 = L1_func_800493C0;
func_8004A2F8 = L1_func_80049470;
func_8004A5C4 = L1_func_8004973C;
func_8004A76C = L1_func_800498E4;
func_8004A910 = L1_func_80049A88;
L1_func_80049B7C = func_8004AA04;
func_8004AA0C = L1_func_80049B84;
PROVIDE(L1_func_80049D60 = func_8004ABE8);
PROVIDE(func_8004ABE8 = L1_func_80049D60);
L1_func_8004A294 = func_8004B11C;
L1_func_8004A29C = func_8004B124;
L1_func_8004A304 = func_8004B18C;
L1_func_8004A338 = func_8004B1C0;
L1_func_8004A370 = func_8004B1F8;
L1_func_8004A380 = func_8004B208;
L1_func_8004A398 = func_8004B220;
L1_func_8004A81C = func_8004B65C;
L1_func_8004A85C = func_8004B69C;
L1_func_8004A8A8 = func_8004B6E8;
func_8004B724 = L1_func_8004A8E4;
PROVIDE(L1_func_8004A9E4 = func_8004B824);
PROVIDE(func_8004B824 = L1_func_8004A9E4);
func_8004BD4C = L1_func_8004AF0C;
L1_func_8004B028 = func_8004BE68;
L1_func_8004B04C = func_8004BE8C;
L1_func_8004B05C = func_8004BE9C;
L1_func_8004B06C = func_8004BEAC;
L1_func_8004B084 = func_8004BEC4;
func_8004BEF0 = L1_func_8004B0B0;
func_8004BFD4 = L1_func_8004B194;
L1_func_8004B270 = func_8004C0B0;
L1_func_8004B334 = func_8004D67C;
func_8004D704 = L1_func_8004B3BC;
func_8004D8D4 = L1_func_8004B58C;
func_8004DD44 = L1_func_8004B9FC;
func_8004DE48 = L1_func_8004BB00;
func_8004DFB8 = L1_func_8004BC70;
func_8004E0F0 = L1_func_8004BDA8;
L1_func_8004BE84 = func_8004E2B4;
L1_func_8004BF70 = func_8004E3A0;
func_8004E4F0 = L1_func_8004C0C0;
PROVIDE(L1_func_8004C368 = func_8004E798);
PROVIDE(func_8004E798 = L1_func_8004C368);
func_8004E8C8 = L1_func_8004C498;
L1_func_8004C50C = func_8004E93C;
func_8004E988 = L1_func_8004C558;
L1_func_8004C5C8 = func_8004E9F8;
L1_func_8004C698 = func_8004EAC8;
L1_func_8004C768 = func_8004EB98;
L1_func_8004C824 = func_8004EC54;
func_8004EC5C = L1_func_8004C82C;
func_8004ED74 = L1_func_8004C944;
func_8004EE8C = L1_func_8004CA5C;
func_8004EF5C = L1_func_8004CB2C;
func_8004F024 = L1_func_8004CBF4;
func_8004F108 = L1_func_8004CCD8;
func_8004F144 = L1_func_8004CD14;
func_8004F1D0 = L1_func_8004CDA0;
L1_func_8004CE38 = func_8004F268;
func_8004F2A4 = L1_func_8004CE74;
func_8004F330 = L1_func_8004CF00;
L1_func_8004D048 = func_8004F478;
func_8004F644 = L1_func_8004D214;
func_8004F700 = L1_func_8004D2D0;
L1_func_8004D5A8 = func_8004F9D8;
func_8004FB5C = L1_func_8004D72C;
func_8004FBA0 = L1_func_8004D770;
func_8004FC74 = L1_func_8004D844;
func_8004FCBC = L1_func_8004D88C;
func_8004FDA8 = L1_func_8004D978;
func_8004FE90 = L1_func_8004DA60;
func_8004FFFC = L1_func_8004DBCC;
func_800501CC = L1_func_8004DD9C;
func_80050428 = L1_func_8004DFF8;
func_800504AC = L1_func_8004E07C;
func_80050734 = L1_func_8004E304;
func_80050758 = L1_func_8004E328;
L1_func_8004E37C = func_800507AC;
PROVIDE(L1_func_8004E5D8 = func_80050904);
PROVIDE(func_80050904 = L1_func_8004E5D8);
L1_func_8004E78C = func_80050AB8;
func_80050AC0 = L1_func_8004E794;
func_80050BC8 = L1_func_8004E89C;
func_80050C98 = L1_func_8004E96C;
func_80050CD8 = L1_func_8004E9AC;
L1_func_8004EA68 = func_80050D94;
func_80050DE4 = L1_func_8004EAB8;
func_80050E4C = L1_func_8004EB20;
func_80050F9C = L1_func_8004EC70;
func_80051270 = L1_func_8004EF44;
L1_func_8004F134 = func_80051460;
func_80051474 = L1_func_8004F148;
func_80051674 = L1_func_8004F348;
L1_func_8004F3D8 = func_80051704;
PROVIDE(L1_func_8004F3E8 = func_80051714);
PROVIDE(func_80051714 = L1_func_8004F3E8);
PROVIDE(L1_func_8004F880 = func_80051BAC);
PROVIDE(func_80051BAC = L1_func_8004F880);
PROVIDE(L1_func_8004FD3C = func_80052068);
PROVIDE(func_80052068 = L1_func_8004FD3C);
func_800524AC = L1_func_80050180;
func_800526B8 = L1_func_8005038C;
PROVIDE(L1_func_800503D8 = func_80052704);
PROVIDE(func_80052704 = L1_func_800503D8);
func_80052C8C = L1_func_80050960;
func_80052CC8 = L1_func_8005099C;
func_80052D10 = L1_func_800509E4;
func_80052D3C = L1_func_80050A10;
PROVIDE(L1_func_80050A70 = func_80052D9C);
PROVIDE(func_80052D9C = L1_func_80050A70);
func_80053A54 = L1_func_80051728;
func_800546F8 = L1_func_800523E4;
func_80054944 = L1_func_80052630;
func_80054B1C = L1_func_80052808;
func_80054E40 = L1_func_80052B2C;
L1_func_80052BEC = func_80054F00;
func_80055164 = L1_func_80053004;
func_800551E0 = L1_func_80053080;
func_80055870 = L1_func_80053684;
L1_func_800536F0 = func_800558DC;
L1_func_80053790 = func_8005597C;
func_800559F0 = L1_func_80053804;
func_80055B68 = L1_func_8005397C;
func_80055C18 = L1_func_80053A2C;
func_80055C68 = L1_func_80053A7C;
func_80055D50 = L1_func_80053B64;
L1_func_80053BD0 = func_80055DBC;
func_80055DCC = L1_func_80053BE0;
L1_func_80053DAC = func_80055F98;
func_80055FD0 = L1_func_80053DE4;
func_800560C4 = L1_func_80053ED8;
func_800563B8 = L1_func_80054098;
func_800563EC = L1_func_800540CC;
func_80056438 = L1_func_80054118;
func_8005648C = L1_func_8005416C;
func_80056588 = L1_func_80054268;
func_8005662C = L1_func_8005430C;
func_800566DC = L1_func_800543BC;
L1_func_80054414 = func_80056734;
func_80056964 = L1_func_80054604;
func_800569FC = L1_func_8005469C;
func_80056B24 = L1_func_800547C4;
func_80056B9C = L1_func_8005483C;
func_80056CC4 = L1_func_80054964;
func_80056E28 = L1_func_80054AC8;
func_80056F58 = L1_func_80054BF8;
func_80057104 = L1_func_80054DA4;
func_80057198 = L1_func_80054E38;
func_80057294 = L1_func_80054F34;
func_8005733C = L1_func_80054FDC;
func_800573C0 = L1_func_80055060;
func_800574CC = L1_func_8005516C;
func_80057564 = L1_func_80055204;
func_800575FC = L1_func_8005529C;
func_8005765C = L1_func_800552FC;
func_800576BC = L1_func_8005535C;
func_80057720 = L1_func_800553C0;
func_80057870 = L1_func_80055510;
func_800578F8 = L1_func_80055598;
func_800579D0 = L1_func_80055670;
func_80057B28 = L1_func_800557C8;
PROVIDE(L1_func_800557F4 = func_80057B54);
PROVIDE(func_80057B54 = L1_func_800557F4);
func_80057B74 = L1_func_80055814;
PROVIDE(L1_func_80055878 = func_80057BD8);
PROVIDE(func_80057BD8 = L1_func_80055878);
PROVIDE(L1_func_80055BA8 = func_80057F08);
PROVIDE(func_80057F08 = L1_func_80055BA8);
func_80058184 = L1_func_80055E24;
func_800582B8 = L1_func_80055F58;
func_800583B4 = L1_func_80056054;
func_80058470 = L1_func_80056110;
PROVIDE(L1_func_80056154 = func_800584B4);
PROVIDE(func_800584B4 = L1_func_80056154);
func_800586B8 = L1_func_80056358;
func_8005871C = L1_func_800563BC;
func_800587A4 = L1_func_80056444;
func_8005880C = L1_func_800564AC;
func_80058898 = L1_func_80056538;
func_800588D0 = L1_func_80056570;
func_8005893C = L1_func_800565DC;
func_80058974 = L1_func_80056614;
func_80058A58 = L1_func_800566F8;
func_80058B9C = L1_func_8005683C;
func_80058BF4 = L1_func_80056894;
func_8005907C = L1_func_80056D1C;
func_800592F0 = L1_func_80056F90;
func_800593D4 = L1_func_80057074;
func_80059458 = L1_func_800570F8;
func_800594F4 = L1_func_80057194;
func_80059518 = L1_func_800571B8;
PROVIDE(L1_func_800572F4 = func_80059654);
PROVIDE(func_80059654 = L1_func_800572F4);
func_80059704 = L1_func_800573A4;
func_80059770 = L1_func_80057410;
func_8005979C = L1_func_8005743C;
func_800597DC = L1_func_8005747C;
func_8005995C = L1_func_800575FC;
L1_func_80057648 = func_800599A8;
PROVIDE(L1_func_80057750 = func_80059AB0);
PROVIDE(func_80059AB0 = L1_func_80057750);
func_80059E10 = L1_func_80057AB0;
L1_func_80057AD8 = func_80059E38;
func_80059E8C = L1_func_80057B2C;
L1_func_80057B94 = func_80059EF4;
L1_func_80057BFC = func_80059F5C;
func_80059FA0 = L1_func_80057C40;
PROVIDE(L1_func_80057E80 = func_8005A1E0);
PROVIDE(func_8005A1E0 = L1_func_80057E80);
L1_func_80058694 = func_8005A9F4;
func_8005ABBC = L1_func_8005885C;
func_8005ADB8 = L1_func_80058A58;
func_8005AE70 = L1_func_80058B10;
func_8005AECC = L1_func_80058B6C;
func_8005B060 = L1_func_80058D00;
func_8005B0BC = L1_func_80058D5C;
func_8005B15C = L1_func_8005AD6C;
L1_func_8005ADB0 = func_8005B1A0;
PROVIDE(L1_func_8005ADD4 = func_8005B1C4);
PROVIDE(func_8005B1C4 = L1_func_8005ADD4);
PROVIDE(L1_func_8005AEF8 = func_8005B2E8);
PROVIDE(func_8005B2E8 = L1_func_8005AEF8);
func_8005B8F8 = L1_func_8005B508;
func_8005B974 = L1_func_8005B584;
func_8005B99C = L1_func_8005B5AC;
func_8005BABC = L1_func_8005B6CC;
func_8005BB5C = L1_func_8005B76C;
func_8005BBAC = L1_func_8005B7BC;
func_8005BC5C = L1_func_8005B86C;
func_8005BD5C = L1_func_8005B96C;
func_8005BE20 = L1_func_8005BA30;
func_8005BED8 = L1_func_8005BAE8;
func_8005C070 = L1_func_8005BC80;
func_8005C2E0 = L1_func_8005BEF0;
func_8005C4FC = L1_func_8005C10C;
PROVIDE(L1_func_8005C214 = func_8005C604);
PROVIDE(func_8005C604 = L1_func_8005C214);
func_8005C72C = L1_func_8005C33C;
L1_func_8005C864 = func_8005CC54;
L1_func_8005C894 = func_8005CC84;
func_8005CCB4 = L1_func_8005C8C4;
func_8005CE10 = L1_func_8005CA20;
L1_func_8005CB38 = func_8005CF28;
func_8005D190 = L1_func_8005CED0;
func_8005D288 = L1_func_8005CFC8;
func_8005D570 = L1_func_8005D2B0;
L1_func_8005D58C = func_8005D84C;
func_8005D884 = L1_func_8005D5C4;
func_8005D8F0 = L1_func_8005D630;
L1_func_8005D654 = func_8005D914;
func_8005D954 = L1_func_8005D694;
func_8005DA20 = L1_func_8005D760;
L1_func_8005DA90 = func_8005DD50;
PROVIDE(L1_func_8005DB7C = func_8005DE3C);
PROVIDE(func_8005DE3C = L1_func_8005DB7C);
func_8005DF00 = L1_func_8005DC40;
L1_func_8005DF40 = func_8005E200;
func_8005E23C = L1_func_8005DF7C;
func_8005E2E0 = L1_func_8005E020;
func_8005E4E8 = L1_func_8005E228;
PROVIDE(L1_func_8005E424 = func_8005E6E4);
PROVIDE(func_8005E6E4 = L1_func_8005E424);
func_8005ED9C = L1_func_8005EADC;
func_8005EE2C = L1_func_8005EB6C;
func_8005EF44 = L1_func_8005EC84;
func_8005F0B8 = L1_func_8005EE6C;
L1_func_8005F3B0 = func_8005F5F4;
func_8005FB2C = L1_func_8005F93C;
func_8005FC98 = L1_func_8005FAA8;
L1_func_8005FF60 = func_80060144;
L1_func_80060094 = func_80060274;
L1_func_800600EC = func_800602CC;
func_8006061C = L1_func_8006043C;
func_80060690 = L1_func_800604B0;
L1_func_8006060C = func_800607EC;
func_800607F4 = L1_func_80060614;
func_80060978 = L1_func_80060798;
func_80060AC4 = L1_func_800608E4;
func_80060CA0 = L1_func_80060AC0;
L1_func_80060E28 = func_80060FDC;
L1_func_80061018 = func_80061180;
PROVIDE(L1_func_80061068 = func_80061214);
PROVIDE(func_80061214 = L1_func_80061068);
func_80061774 = L1_func_800615C8;
L1_func_80061700 = func_800618AC;
func_800618B4 = L1_func_80061708;
L1_func_80061DC0 = func_80061F04;
func_80061FD8 = L1_func_80061EC4;
L1_func_80061F38 = func_8006204C;
L1_func_80061FB4 = func_800620C8;
func_80062418 = L1_func_80062300;
func_800624AC = L1_func_80062394;
func_8006289C = L1_func_80062784;
func_80062C80 = L1_func_80062B68;
func_80063050 = L1_func_80062F38;
PROVIDE(L1_func_80062FAC = func_800630C4);
PROVIDE(func_800630C4 = L1_func_80062FAC);
func_80063348 = L1_func_800632AC;
func_8006344C = L1_func_800633B0;
func_8006355C = L1_func_800634C0;
func_80063754 = L1_func_800636B8;
func_8006384C = L1_func_800637B0;
L1_func_80063858 = func_800638F4;
L1_func_80063ADC = func_80063B78;
func_80063BBC = L1_func_80063B20;
func_80063D48 = L1_func_80063CAC;
func_80063DDC = L1_func_80063D40;
L1_func_80063ED4 = func_80063F70;
L1_func_80063EF8 = func_80063F94;
func_80063FD0 = L1_func_80063F34;
func_80064020 = L1_func_80063F84;
func_800641C8 = L1_func_8006412C;
func_80064218 = L1_func_8006417C;
func_800642B8 = L1_func_8006439C;
func_800643F8 = L1_func_800644DC;
func_80064538 = L1_func_8006461C;
func_8006457C = L1_func_80064660;
func_80064768 = L1_func_8006484C;
func_8006492C = L1_func_80064A10;
func_80064B44 = L1_func_80064C28;
L1_func_80064E40 = func_80064D5C;
func_80064FD0 = L1_func_80065510;
L1_func_80065588 = func_80065048;
func_80065078 = L1_func_800655B8;
func_800650D4 = L1_func_80065614;
L1_func_800658B4 = func_80065374;
func_800653E8 = L1_func_80065928;
PROVIDE(L1_func_80065A20 = func_800654E0);
PROVIDE(func_800654E0 = L1_func_80065A20);
func_80065B58 = L1_func_80066098;
func_80065D68 = L1_func_800662A8;
func_80065F78 = L1_func_800664B8;
func_800661C4 = L1_func_80066704;
L1_func_8006692C = func_800663EC;
L1_func_80066968 = func_80066428;
func_80066464 = L1_func_800669A4;
L1_func_80066A60 = func_80066520;
L1_func_80066B14 = func_80066974;
L1_func_80067F18 = func_800683F0;
func_8006998C = L1_func_800689F0;
L1_func_80069318 = func_8006A6B0;
L1_func_80069328 = func_8006A6C0;
L1_func_800693DC = func_8006A788;
func_8006ADCC = L1_func_8006981C;
L1_func_80069850 = func_8006AE00;
L1_func_800698B8 = func_8006AE44;
L1_func_8006B198 = func_8006DE50;
L1_func_8006B1DC = func_8006DE94;
L1_func_8006B230 = func_8006DEE8;
func_8006DF2C = L1_func_8006B274;
PROVIDE(L1_func_8006B2C4 = func_8006DF7C);
PROVIDE(func_8006DF7C = L1_func_8006B2C4);
func_8006F14C = L1_func_8006C494;
func_8006F5AC = L1_func_8006C8F4;
PROVIDE(L1_func_8006CB88 = func_8006F840);
PROVIDE(func_8006F840 = L1_func_8006CB88);
PROVIDE(L1_func_8006CEA4 = func_8006FB5C);
PROVIDE(func_8006FB5C = L1_func_8006CEA4);
func_80070078 = L1_func_8006D3C0;
PROVIDE(L1_func_8006D470 = func_80070128);
PROVIDE(func_80070128 = L1_func_8006D470);
func_800709D8 = L1_func_8006DD20;
PROVIDE(L1_func_8006E054 = func_80070D0C);
PROVIDE(func_80070D0C = L1_func_8006E054);
func_800712D8 = L1_func_8006E620;
func_80071698 = L1_func_8006E9E0;
func_80071974 = L1_func_8006ECBC;
func_80071B60 = L1_func_8006EEA8;
func_80071CEC = L1_func_8006F034;
PROVIDE(L1_func_8006F168 = func_80071E20);
PROVIDE(func_80071E20 = L1_func_8006F168);
func_80072364 = L1_func_8006F6AC;
PROVIDE(L1_func_8006F784 = func_8007243C);
PROVIDE(func_8007243C = L1_func_8006F784);
func_8007265C = L1_func_8006F9A4;
func_8007270C = L1_func_8006FA54;
func_800727BC = L1_func_8006FB04;
func_80072B8C = L1_func_8006FED4;
func_80072D28 = L1_func_80070070;
func_80072F84 = L1_func_800702CC;
func_80073260 = L1_func_800705A8;
func_800733A8 = L1_func_800706F0;
func_800742F0 = L1_func_80071638;
PROVIDE(L1_func_80072190 = func_80074E48);
PROVIDE(func_80074E48 = L1_func_80072190);
func_800750C4 = L1_func_8007240C;
PROVIDE(L1_func_800726D0 = func_80075388);
PROVIDE(func_80075388 = L1_func_800726D0);
func_80075A00 = L1_func_80072D48;
func_80075AE0 = L1_func_80072E28;
PROVIDE(L1_func_8007369C = func_80076354);
PROVIDE(func_80076354 = L1_func_8007369C);
func_800770A0 = L1_func_800743E8;
PROVIDE(L1_func_800746D0 = func_80077388);
PROVIDE(func_80077388 = L1_func_800746D0);
func_80077CA0 = L1_func_80074FE8;
func_80077F78 = L1_func_800752C0;
PROVIDE(L1_func_800752E8 = func_80077FA0);
PROVIDE(func_80077FA0 = L1_func_800752E8);
L1_func_800753A4 = func_8007805C;
L1_func_800753F0 = func_800780A8;
func_80078114 = L1_func_8007545C;
func_80078274 = L1_func_800755BC;
func_80078334 = L1_func_8007567C;
func_80078478 = L1_func_800757C0;
L1_func_800758C0 = func_80078578;
func_800785A8 = L1_func_800758F0;
func_800785D8 = L1_func_80075920;
func_80078A00 = L1_func_80075D48;
func_80078B54 = L1_func_80075E9C;
func_80078BD8 = L1_func_80075F20;
L1_func_80075FA0 = func_80078C58;
L1_func_80075FE4 = func_80078C9C;
func_80078CCC = L1_func_80076014;
L1_func_800760B4 = func_80078D6C;
func_80078DBC = L1_func_80076104;
func_80078E3C = L1_func_80076184;
func_80079888 = L1_func_80076BF8;
func_8007996C = L1_func_80076CDC;
L1_func_80077764 = func_8007BA00;
L1_func_800779FC = func_8007BC98;
L1_func_80077CCC = func_8007BF68;
L1_func_80077D50 = func_8007BFEC;
L1_func_80077FC4 = func_8007C260;
L1_func_800781B4 = func_8007C450;
L1_func_80078534 = func_8007C7D0;
L1_func_800785A8 = func_8007C844;
L1_func_800787FC = func_8007CA98;
L1_func_80078840 = func_8007CADC;
L1_func_800788E0 = func_8007CB7C;
L1_func_800792B8 = func_8007DAF0;
L1_func_80079390 = func_8007DBC8;
L1_func_800793EC = func_8007E00C;
L1_func_800794A0 = func_8007E0C0;
L1_func_800794D4 = func_8007E0F4;
L1_func_80079588 = func_8007E1A8;
L1_func_800797A8 = func_8007E3C8;
L1_func_8007980C = func_8007E418;
L1_func_8007987C = func_8007E488;
L1_func_800798A8 = func_8007E4E0;
L1_func_800798D4 = func_8007E538;
L1_func_80079B94 = func_8007E7F8;
L1_func_80079C04 = func_8007E868;
L1_func_80079C54 = func_8007E8B8;
L1_func_80079D84 = func_8007E9E8;
L1_func_80079DB8 = func_8007EA34;
L1_func_80079E10 = func_8007EA8C;
L1_func_80079F84 = func_8007EC00;
L1_func_8007A040 = func_8007ECF4;
L1_func_8007A17C = func_8007EE30;
L1_func_8007A1B0 = func_8007EE64;
L1_func_8007A4E4 = func_8007F180;
L1_func_8007A554 = func_8007F1F0;
L1_func_8007A580 = func_8007F21C;
L1_func_8007A614 = func_8007F2B0;
L1_func_8007A694 = func_8007F330;
L1_func_8007AA94 = func_8007F730;
L1_func_8007AC7C = func_8007F918;
L1_func_8007CE30 = func_80081ACC;
L1_func_8007D184 = func_80081E20;
L1_func_8007D1E8 = func_80081E84;
L1_func_8007D260 = func_80081EFC;
L1_func_8007D2B4 = func_80081F50;
L1_func_8007D914 = func_800825B0;
L1_func_8007DA88 = func_80082724;
L1_func_8007DE50 = func_80082AEC;
L1_func_8007E610 = func_800832AC;
L1_func_8007E6A4 = func_80083340;
L1_func_8007EB7C = func_80083818;
L1_func_8007EC78 = func_80083914;
L1_func_8007ED98 = func_80083A34;
L1_func_8007EE34 = func_80083AD0;
L1_func_8007EE64 = func_80083B00;
L1_func_8007EEBC = func_80083B58;
L1_func_8007EECC = func_80083B68;
L1_func_8007F040 = func_80083CDC;
L1_func_8007F0D8 = func_80083D74;
L1_func_8007F140 = func_80083DDC;
L1_func_8007F25C = func_80083EF8;
L1_func_8007F2EC = func_80083F88;
L1_func_8007F34C = func_80083FE8;
L1_func_8007F414 = func_800840B0;
L1_func_8007F4C0 = func_8008415C;
L1_func_8007F530 = func_800841CC;
L1_func_8007F5F0 = func_8008428C;
L1_func_8007FAE8 = func_80084784;
L1_func_8007FCE0 = func_8008497C;
L1_func_8007FF50 = func_80084BEC;
L1_func_8007FF70 = func_80084C0C;
L1_func_80080008 = func_80084CA4;
L1_func_800800A0 = func_80084D3C;
L1_func_800800BC = func_80084D58;
L1_func_8008013C = func_80084DD8;
L1_func_80080154 = func_80084DF0;
L1_func_80080234 = func_80084ED0;
L1_func_80080464 = func_80085100;
L1_func_800806A0 = func_8008533C;
L1_func_80080920 = func_800855BC;
L1_func_80080944 = func_800855E0;
L1_func_80080958 = func_800855F4;
L1_func_80080998 = func_80085634;
L1_func_800809E0 = func_8008567C;
L1_func_80080A10 = func_800856AC;
L1_func_80080A34 = func_800856D0;
L1_func_80080CE4 = func_80085980;
L1_func_80080F44 = func_80085BE0;
L1_func_80081094 = func_80085D30;
L1_func_800811D0 = func_80085E6C;
L1_func_80081204 = func_80085EA0;
L1_func_80081348 = func_80085FE4;
L1_func_800813E8 = func_80086084;
L1_func_80081410 = func_800860AC;
L1_func_80081448 = func_800860E4;
L1_func_80081458 = func_800860F4;
L1_func_800814CC = func_80086168;
L1_func_800815A0 = func_8008623C;
L1_func_80081A08 = func_800866A4;
L1_func_80081B74 = func_80086810;
L1_func_80081C54 = func_800868F0;
L1_func_80081C84 = func_80086920;
L1_func_80081CE4 = func_80086980;
L1_func_80081D14 = func_800869B0;
L1_func_80082638 = func_800872D4;
L1_func_800828AC = func_80087548;
L1_func_8008297C = func_80087618;
L1_func_80082B64 = func_80087800;
L1_func_80082D00 = func_8008799C;
L1_func_80082E04 = func_80087AA0;
L1_func_80082ED8 = func_80087B74;
L1_func_80082EE8 = func_80087B84;
L1_func_80082EF8 = func_80087B94;
L1_func_80082F04 = func_80087BA0;
L1_func_80082F24 = func_80087BC0;
L1_func_80082F44 = func_80087BE0;
L1_func_80082F64 = func_80087C00;
L1_func_80082F78 = func_80087C14;
L1_func_80082F8C = func_80087C28;
L1_func_800830C8 = func_80087D64;
L1_func_800831FC = func_80087E98;
L1_func_80083348 = func_80087FE4;
L1_func_80083368 = func_80088004;
L1_func_80083388 = func_80088024;
L1_func_800833AC = func_80088048;
L1_func_800833CC = func_80088068;
L1_func_800834D0 = func_8008816C;
L1_func_80083F14 = func_80088BB0;
L1_func_80084134 = func_80088DD0;
L1_func_80084164 = func_80088E00;
L1_func_80084194 = func_80088E30;
L1_func_800841C4 = func_80088E60;
L1_func_800841F8 = func_80088E94;
L1_func_80084228 = func_80088EC4;
L1_func_80084238 = func_80088ED4;
L1_func_80084250 = func_80088EEC;
L1_func_80084328 = func_80088FC4;
L1_func_800844F8 = func_80089194;
L1_func_80084640 = func_800892DC;
L1_func_800846E0 = func_8008937C;
L1_func_80084758 = func_800893F4;
L1_func_80084E0C = func_80089AA8;
L1_func_800855BC = func_8008A258;
L1_func_8008571C = func_8008A3B8;
L1_func_8008596C = func_8008A608;
L1_func_800859B8 = func_8008A654;
L1_func_80085B5C = func_8008A7F8;
L1_func_80085BD0 = func_8008A86C;
L1_func_800865BC = func_8008B258;
L1_func_80086688 = func_8008B324;
L1_func_80086780 = func_8008B41C;
L1_func_80086854 = func_8008B4F0;
L1_func_8008688C = func_8008B528;
L1_func_800868D4 = func_8008B570;
L1_func_80086928 = func_8008B5C4;
L1_func_80086A40 = func_8008B6DC;
L1_func_80086A6C = func_8008B708;
L1_func_80086AD4 = func_8008B770;
L1_func_80086C64 = func_8008B900;
L1_func_80086D30 = func_8008B9CC;
L1_func_80086D74 = func_8008BA10;
L1_func_800870A8 = func_8008BD44;
L1_func_80087198 = func_8008BE34;
L1_func_800873A8 = func_8008C044;
L1_func_80087620 = func_8008C2BC;
L1_func_800876B0 = func_8008C34C;
L1_func_800876E4 = func_8008C380;
L1_func_80088C44 = func_8008D8E0;
L1_func_8008A404 = func_8008F0A0;
L1_func_8008A904 = func_8008F5A0;
L1_func_8008C5A4 = func_80091250;
L1_func_8008C5C4 = func_80091270;
L1_func_8008C5D8 = func_80091284;
L1_func_8008C638 = func_800912E4;
L1_func_8008CCB8 = func_800916D4;
L1_func_8008D2EC = func_80091D08;
L1_func_8008DAAC = func_800924C8;
L1_func_8008DB68 = func_80092584;
L1_func_8008DBDC = func_800925F8;
L1_func_8008E03C = func_80092CE8;
L1_func_8008E378 = func_80093024;
L1_func_8008FAE8 = func_80094784;
L1_func_80090004 = func_80094CA0;
L1_func_80090164 = func_80094E00;
L1_func_80090880 = func_8009551C;
L1_func_80090B00 = func_8009579C;
L1_func_80090CC0 = func_8009595C;
L1_func_80090D7C = func_80095A18;
L1_func_80090FFC = func_80095C98;
L1_func_80091080 = func_80095D1C;
L1_func_800910C4 = func_80095D60;
L1_func_80091168 = func_80095E04;
L1_func_800911C0 = func_80095E5C;
L1_func_800911E8 = func_80095E84;
L1_func_80091210 = func_80095EAC;
L1_func_80091450 = func_800960EC;
L1_func_80091480 = func_8009611C;
L1_func_800919DC = func_80096678;
L1_func_80091C5C = func_800968F8;
L1_func_80091F24 = func_80096BC0;
L1_func_80092330 = func_80096FCC;
L1_func_80092404 = func_800970A0;
L1_func_800924F4 = func_80097190;
L1_func_800926D4 = func_80097370;
L1_func_8009283C = func_800974D8;
L1_func_8009293C = func_800975D8;
L1_func_80092A34 = func_800976D0;
L1_func_80092F24 = func_80097BC0;
L1_func_80092F5C = func_80097BF8;
L1_func_8009302C = func_80097CC8;
L1_func_80093C64 = func_80098900;
L1_func_80093E24 = func_80098AC0;
L1_func_80093F24 = func_80098BC0;
L1_func_80093F4C = func_80098BE8;
L1_func_80094434 = func_800990D0;
L1_func_80094440 = func_800990DC;
L1_func_800944C4 = func_80099160;
L1_func_80094734 = func_800993D0;
L1_func_8009476C = func_80099408;
L1_func_80094840 = func_800994DC;
L1_func_800948E8 = func_80099584;
L1_func_80094CE0 = func_8009997C;
L1_func_80094D48 = func_800999E4;
L1_func_80094D64 = func_80099A00;
L1_func_80094E2C = func_80099AC8;
L1_func_80094EC4 = func_80099B60;
L1_func_80094F18 = func_80099BB4;
L1_func_80094F78 = func_80099C14;
L1_func_80094F98 = func_80099C34;
L1_func_80094FAC = func_80099C48;
L1_func_80094FCC = func_80099C68;
L1_func_80094FEC = func_80099C88;
L1_func_8009500C = func_80099CA8;
L1_func_80095104 = func_80099DA0;
L1_func_800957F0 = func_8009A48C;
L1_func_80095914 = func_8009A5B0;
L1_func_80095934 = func_8009A5D0;
L1_func_80095954 = func_8009A5F0;
L1_func_80095A44 = func_8009A6E0;
L1_func_80095A64 = func_8009A700;
L1_func_80095D7C = func_8009AA18;
L1_func_80095ECC = func_8009AB68;
L1_func_80096270 = func_8009AF0C;
L1_func_800963C4 = func_8009B060;
L1_func_80096738 = func_8009B3D4;
L1_func_800967BC = func_8009B458;
L1_func_80096BC0 = func_8009B85C;
L1_func_80096C54 = func_8009B8F0;
L1_func_80096C9C = func_8009B938;
L1_func_80096F50 = func_8009BBEC;
L1_func_80099EB0 = func_8009EB4C;
L1_func_8009A0A0 = func_8009ED3C;
L1_func_8009A1F0 = func_8009EE8C;
L1_func_8009A3B0 = func_8009F04C;
L1_func_8009A9E0 = func_8009F67C;
L1_func_8009AB60 = func_8009F7FC;
L1_func_8009B940 = func_800A05DC;
L1_func_8009BEAC = func_800A0B48;
L1_func_8009BF10 = func_800A0BAC;
L1_func_8009BFC0 = func_800A0C5C;
L1_func_800AACFC = func_800B084C;
L1_func_800AAEF8 = func_800B0A48;
L1_gPsi = D_800B5AEC;
L1_g_Args = D_800B5ACC;
L1_g_CamPosX = D_800B5B7C;
L1_g_CamPosY = D_800B5B80;
L1_g_CamRotX = D_800B5B44;
L1_g_CamTargetX = D_800B5B38;
L1_g_Camera = D_800B5B34;
L1_g_CheatCodeProgress = D_800B6AB8;
L1_g_CheatCodes = D_800A1958;
L1_g_CutScene = D_800A1998;
L1_g_DebugPageNames = D_800A1AEC;
L1_g_DebugTextX = D_800A1CBC;
L1_g_DebugTextY = D_800A1CBE;
L1_g_DevMenu = D_800D8FC4;
L1_g_FrameCap = D_800B6A3C;
L1_g_FrameRate = D_800A1A48;
L1_g_GodMode = D_800A19D6;
L1_g_Invincible = D_800A1724;
L1_g_MenuUpdateFunc = D_800DA3BC;
L1_g_PadAxes = D_800B6DFC;
L1_g_PadAxesPrev = D_800B6E00;
L1_g_PadHeld = D_800B6DE4;
L1_g_PadPressed = D_800B6DEC;
L1_g_PadPrev = D_800B6DF0;
L1_g_Player = D_800B6AA0;
L1_g_Projection = D_800B5BE0;
L1_g_Weapons = D_800B5BF4;
L1_gteMIMefunc = func_80091130;
L1_gte_rotate_z_matrix = func_80097D00;
L1_jtbl_800A6F68 = jtbl_800AC6D4;
L1_jtbl_800A7168 = jtbl_800AC8D4;
L1_jtbl_800A74B0 = jtbl_800ACC1C;
L1_jtbl_800A7764 = jtbl_800ACED0;
L1_jtbl_800A7ED8 = jtbl_800AD67C;
L1_jtbl_800A8028 = jtbl_800AD7CC;
L1_jtbl_800A8088 = jtbl_800AD82C;
L1_jtbl_800A859C = jtbl_800ADD40;
L1_jtbl_800A8AC0 = jtbl_800AE2AC;
L1_jtbl_800A8B20 = jtbl_800AE30C;
L1_jtbl_800A8BE8 = jtbl_800AE3D4;
L1_jtbl_800A98E4 = jtbl_800AF3E0;
L1_jtbl_800A9AEC = jtbl_800AF63C;
L1_jtbl_800A9DF8 = jtbl_800AF948;
L1_jtbl_800AA190 = jtbl_800AFCE0;
L1_jtbl_800AA1F0 = jtbl_800AFD40;
L1_jtbl_800AA270 = jtbl_800AFDC0;
L1_jtbl_800AA2A8 = jtbl_800AFDF8;
L1_jtbl_800AA330 = jtbl_800AFE80;
L1_jtbl_800AA540 = jtbl_800B0090;
L1_jtbl_800AA560 = jtbl_800B00B0;
L1_jtbl_800AA780 = jtbl_800B02D0;
L1_jtbl_800AA860 = jtbl_800B03B0;
L1_jtbl_800AA880 = jtbl_800B03D0;
L1_malloc3 = func_800905D0;
L1_memchr = func_80090890;
L1_memcpy = func_80091120;
L1_memmove = func_80096074;
L1_memset = func_80091110;
L1_note2pitch = func_80094014;
L1_note2pitch2 = func_80094060;
L1_printf = func_80083B38;
L1_rand = func_80086730;
L1_ratan2 = func_80090C90;
L1_rcos = func_8009EEDC;
L1_rsin = func_8009EF7C;
L1_setRC2wait = func_80099CE0;
L1_setjmp = func_800978F8;
L1_sin_1 = func_8009EFB8;
L1_sprintf = func_80086A10;
L1_start = func_8002C9A4;
L1_startIntrDMA = func_80097918;
L1_startIntrVSync = func_800977B8;
L1_strcat = func_80088B7C;
L1_strcmp = func_800908D0;
L1_strcpy = func_80086940;
L1_strlen = func_80086910;
L1_strncmp = func_800977A8;
L1_strncpy = func_80093294;
L1_strstr = func_80090A10;
L1_strtok = func_800908E0;
L1_strtol = func_80090A00;
L1_toupper = func_80086800;
L1_vmNoiseOff = func_8009515C;
L1_vmNoiseOn = func_80093AA4;
L1_func_80026F30 = func_80026F30;
L1_func_80027248 = func_80027248;
L1_func_80027394 = func_80027394;
L2_D_800A03C0 = D_800A0E24;
L2_D_800A0425 = D_800A0E89;
L2_D_800A0426 = D_800A0E8A;
L2_D_800A0438 = D_800A0E9C;
L2_D_800A0C92 = D_800A16F6;
L2_D_800A0CC0 = D_800A1724;
L2_D_800A0CC4 = D_800A1728;
L2_D_800A0CD4 = D_800A1738;
L2_D_800A0CDC = D_800A1740;
L2_D_800A0CEC = D_800A1750;
L2_D_800A0CF7 = D_800A175B;
L2_D_800A0CFC = D_800A1760;
L2_D_800A0EF4 = D_800A1958;
L2_D_800A0F34 = D_800A1998;
L2_D_800A0F88 = D_800A19EC;
L2_D_800A0F8C = D_800A19F0;
L2_D_800A0F9C = D_800A1A00;
L2_D_800A0FAB = D_800A1A0F;
L2_D_800A0FD0 = D_800A1A34;
L2_D_800A0FE0 = D_800A1A44;
L2_D_800A0FE4 = D_800A1A48;
L2_D_800A106C = D_800A1AD0;
L2_D_800A1070 = D_800A1AD4;
L2_D_800A1078 = D_800A1ADC;
L2_D_800A11F0 = D_800A1C50;
L2_D_800A11FE = D_800A1C5E;
L2_D_800A1200 = D_800A1C60;
L2_D_800A1204 = D_800A1C64;
L2_D_800A1208 = D_800A1C68;
L2_D_800A1230 = D_800A1C90;
L2_D_800A123C = D_800A1C9C;
L2_D_800A1240 = D_800A1CA0;
L2_D_800A1242 = D_800A1CA2;
L2_D_800A1244 = D_800A1CA4;
L2_D_800A1248 = D_800A1CA8;
L2_D_800A124C = D_800A1CAC;
L2_D_800A1254 = D_800A1CB4;
L2_D_800A1258 = D_800A1CB8;
L2_D_800A125A = D_800A1CBA;
L2_D_800A125C = D_800A1CBC;
L2_D_800A125E = D_800A1CBE;
L2_D_800A1268 = D_800A1CC8;
L2_D_800A1278 = D_800A1CD8;
L2_D_800A12CC = D_800A1D2C;
L2_D_800A12D0 = D_800A1D30;
L2_D_800A12D4 = D_800A1D34;
L2_D_800A1344 = D_800A1DA4;
L2_D_800A1346 = D_800A1DA6;
L2_D_800A1366 = D_800A1DC6;
L2_D_800A14A8 = D_800A1F08;
L2_D_800A1510 = D_800A1FB4;
L2_D_800A1520 = D_800A2014;
L2_D_800A160C = D_800A1F8C;
L2_D_800A1614 = D_800A1F84;
L2_D_800A1634 = D_800A2048;
L2_D_800A1640 = D_800A2054;
L2_D_800A167C = D_800A2090;
L2_D_800A19A0 = D_800A22F4;
L2_D_800A1A1C = D_800A2370;
L2_D_800A1C74 = D_800A25C8;
L2_D_800A1CC4 = D_800A2618;
L2_D_800A1EEC = D_800A2840;
L2_D_800A3E74 = D_800A4004;
L2_D_800A3E8C = D_800A401C;
L2_D_800A3F0C = D_800A409C;
L2_D_800A40AC = D_800A423C;
L2_D_800AC49C = D_800AC62C;
L2_D_800AC4AC = D_800AC63C;
L2_D_800AC4D4 = D_800AC664;
L2_D_800AC6FC = D_800AC88C;
L2_D_800AC80C = D_800AC99C;
L2_D_800AC820 = D_800AC9B0;
L2_D_800AC94C = D_800ACADC;
L2_D_800ACB1C = D_800ACCAC;
L2_D_800ACB40 = D_800ACCD0;
L2_D_800ACB4C = D_800ACCDC;
L2_D_800ACB88 = D_800ACD18;
L2_D_800ACB9C = D_800ACD2C;
L2_D_800ACC18 = D_800ACDA8;
L2_D_800ACC2C = D_800ACDBC;
L2_D_800ACC40 = D_800ACDD0;
L2_D_800ACC54 = D_800ACDE4;
L2_D_800ACC7C = D_800ACE0C;
L2_D_800ACC88 = D_800ACE18;
L2_D_800ACC9C = D_800ACE2C;
L2_D_800ACDC0 = D_800ACF50;
L2_D_800ACF24 = D_800AD0D4;
L2_D_800ACF38 = D_800AD0E8;
L2_D_800ACF48 = D_800AD0F8;
L2_D_800ACF5C = D_800AD10C;
L2_D_800ACF70 = D_800AD120;
L2_D_800ACF94 = D_800AD144;
L2_D_800ACFCC = D_800AD17C;
L2_D_800AD400 = D_800AD564;
L2_D_800AD428 = D_800AD58C;
L2_D_800AD820 = D_800AD984;
L2_D_800ADA08 = D_800ADB6C;
L2_D_800ADA50 = D_800ADBB4;
L2_D_800ADA58 = D_800ADBBC;
L2_D_800ADC24 = D_800ADD88;
L2_D_800ADD00 = D_800ADE64;
L2_D_800ADE00 = D_800ADF84;
L2_D_800ADE10 = D_800ADF94;
L2_D_800ADE20 = D_800ADFA4;
L2_D_800ADE6C = D_800ADFF0;
L2_D_800ADE80 = D_800AE004;
L2_D_800ADEB8 = D_800AE03C;
L2_D_800AE5A4 = D_800AE70C;
L2_D_800AF09C = D_800AF114;
L2_D_800AF0A0 = D_800AF118;
L2_D_800AF140 = D_800AF1B8;
L2_D_800AF160 = D_800AF1D8;
L2_D_800AF188 = D_800AF200;
L2_D_800AF198 = D_800AF210;
L2_D_800AF1B0 = D_800AF228;
L2_D_800B0F58 = D_800B1090;
L2_D_800B0FF8 = D_800B1130;
L2_D_800B0FFC = D_800B1134;
L2_D_800B1018 = D_800B1150;
L2_D_800B102C = D_800B1164;
L2_D_800B117C = D_800B1294;
L2_D_800B118C = D_800B12A4;
L2_D_800B1DC4 = D_800B1EDC;
L2_D_800B1F2C = D_800B2028;
L2_D_800B1F30 = D_800B202C;
L2_D_800B1FA0 = D_800B209C;
L2_D_800B4E3C = D_800B48F8;
L2_D_800B4E6C = D_800B4928;
L2_D_800B56B4 = D_800B5170;
L2_D_800B5738 = D_800B51F4;
L2_D_800B5739 = D_800B51F5;
L2_D_800B5F3C = D_800B59F8;
L2_D_800B5F49 = D_800B5A05;
L2_D_800B5F4A = D_800B5A06;
L2_D_800B5F4B = D_800B5A07;
L2_D_800B5F50 = D_800B5A0C;
L2_D_800B5FB4 = D_800B5A70;
L2_D_800B6010 = D_800B5ACC;
L2_D_800B6014 = D_800B5AD0;
L2_D_800B6030 = D_800B5AEC;
L2_D_800B6038 = D_800B5AF4;
L2_D_800B603C = D_800B5AF8;
L2_D_800B6054 = D_800B5B10;
L2_D_800B6058 = D_800B5B14;
L2_D_800B605C = D_800B5B18;
L2_D_800B6060 = D_800B5B1C;
L2_D_800B6064 = D_800B5B20;
L2_D_800B60C0 = D_800B5B7C;
L2_D_800B6104 = D_800B5BC0;
L2_D_800B6120 = D_800B5BDC;
L2_D_800B6138 = D_800B5BF4;
L2_D_800B6A94 = D_800B6550;
L2_D_800B6C78 = D_800B6734;
L2_D_800B6C8C = D_800B6748;
L2_D_800B6C94 = D_800B6750;
L2_D_800B6CA8 = D_800B6764;
L2_D_800B6D4C = D_800B6808;
L2_D_800B6F80 = D_800B6A3C;
L2_D_800B6F88 = D_800B6A44;
L2_D_800B6F8C = D_800B6A48;
L2_D_800B6FC4 = D_800B6A80;
L2_D_800B6FE4 = D_800B6AA0;
L2_D_800B6FFC = D_800B6AB8;
L2_D_800B70F4 = D_800B6BB0;
L2_D_800B7114 = D_800B6BD0;
L2_D_800B7140 = D_800B6BFC;
L2_D_800B7170 = D_800B6C2C;
L2_D_800B7284 = D_800B6D40;
L2_D_800B7288 = D_800B6D44;
L2_D_800B72A4 = D_800B6D60;
L2_D_800B72B4 = D_800B6D70;
L2_D_800B72B8 = D_800B6D74;
L2_D_800B72C0 = D_800B6D7C;
L2_D_800B72C8 = D_800B6D84;
L2_D_800B7318 = D_800B6DD4;
L2_D_800B7324 = D_800B6DE0;
L2_D_800B7328 = D_800B6DE4;
L2_D_800B7330 = D_800B6DEC;
L2_D_800B7334 = D_800B6DF0;
L2_D_800B7338 = D_800B6DF4;
L2_D_800B733C = D_800B6DF8;
L2_D_800B7340 = D_800B6DFC;
L2_D_800B7344 = D_800B6E00;
L2_D_800BF408 = D_800BEEC4;
L2_D_800BF46C = D_800BEF28;
L2_D_800C625C = D_800C7BF4;
L2_D_800CD020 = D_800D0894;
L2_D_800D5318 = D_800D8B8C;
L2_D_800D55A0 = D_800D8E14;
L2_D_800D55A4 = D_800D8E18;
L2_D_800D55A8 = D_800D8E1C;
L2_D_800D5670 = D_800D8EE4;
L2_D_800D56BC = D_800D8F30;
L2_D_800D58E0 = D_800D9154;
L2_D_800D6978 = D_800DA1EC;
L2_D_800D6B48 = D_800DA3BC;
L2_D_800D6B70 = D_800DA3E4;
L2_D_800D6BB8 = D_800DA414;
L2_D_800D6D20 = D_800DA57C;
L2_D_800D6D54 = D_800DA5B0;
L2_D_800D6D6C = D_800DA5C8;
L2_D_800D6D84 = D_800DA5E0;
L2_D_800D6D9C = D_800DA5F8;
L2_D_800D70B4 = D_800DA910;
L2_D_800D8500 = D_800DBD5C;
L2_D_800D85DC = D_800DBE38;
L2_D_800D869C = D_800DBEF8;
L2_D_800D8840 = D_800DC09C;
L2_D_800D9C5C = D_800DD4B8;
L2_D_800D9FE4 = D_800DD840;
L2_D_800DA034 = D_800DD890;
L2_D_800DA084 = D_800DD8E0;
L2_D_800DA088 = D_800DD8E4;
L2_D_800DA12C = D_800DD988;
L2_D_800DA20C = D_800DDA68;
L2_D_800DA210 = D_800DDA6C;
L2_D_800DA348 = D_800DDBA4;
L2_D_800DA410 = D_800DDC6C;
L2_D_800DA414 = D_800DDC70;
L2_D_800DA894 = D_800DE0F0;
L2_D_800DA8AC = D_800DE108;
L2_D_800DAD80 = D_800DE5DC;
L2_D_800DADD0 = D_800DE62C;
L2_D_800DAE20 = D_800DE67C;
L2_D_800DAE24 = D_800DE680;
L2_D_800DAE44 = D_800DE6A0;
L2_D_800DB3D8 = D_800DEC34;
L2_D_800DB814 = D_800DEFB0;
L2_D_800DBA48 = D_800DF19C;
L2_D_800DBA6C = D_800DF1C0;
L2_D_800DBA70 = D_800DF1C4;
L2_D_800DBA98 = D_800DF1EC;
L2_D_800DCAE0 = D_800E022C;
L2_D_800DCD68 = D_800E04B4;
L2_D_800E0068 = D_800E37B4;
L2_D_800E006C = D_800E37B8;
L2_D_800E0070 = D_800E37BC;
L2_D_800E0074 = D_800E37C0;
L2_D_800E0078 = D_800E37C4;
L2_D_800E007C = D_800E37C8;
L2_D_800E0080 = D_800E37CC;
L2_D_800E0084 = D_800E37D0;
L2_D_800E0088 = D_800E37D4;
L2_D_800E008C = D_800E37D8;
L2_D_800E00E4 = D_800E3830;
L2_D_800E00E8 = D_800E3834;
L2_D_800E00EC = D_800E3838;
L2_D_800E01B0 = D_800E38FC;
L2_D_800E01B4 = D_800E3900;
L2_D_800E01B8 = D_800E3904;
L2_D_800E01BC = D_800E3908;
L2_D_800E01C4 = D_800E3910;
L2_D_800E01C8 = D_800E3914;
L2_D_800E01D0 = D_800E391C;
L2_D_800E01D4 = D_800E3920;
L2_D_800E01D8 = D_800E3924;
L2_D_800E01DC = D_800E3928;
L2_D_800E0228 = D_800E3974;
L2_D_800E022C = D_800E3978;
L2_D_800E030C = D_800E3A58;
L2_D_800E0310 = D_800E3A5C;
L2_D_800E04FC = D_800E3C48;
L2_D_800E0500 = D_800E3C4C;
L2_D_800E0504 = D_800E3C50;
L2_D_800E1510 = D_800E4C58;
L2_D_800E1514 = D_800E4C5C;
L2_D_800E1554 = D_800E4C9C;
L2_D_800E1628 = D_800E4D70;
L2_D_800E6694 = D_800E92F8;
L2_D_800E680C = D_800E9470;
L2_D_800E6810 = D_800E9474;
L2_D_800F4010 = D_800F6474;
L2_D_800F415C = D_800F65C0;
L2_D_800F4160 = D_800F65C4;
L2_D_800F430C = D_800F6770;
L2_D_800F4458 = D_800F68C0;
L2_D_800F44DC = D_800F6944;
L2_D_80100D94 = D_801031FC;
L2_func_8002680C = func_8002680C;
func_800268CC = L2_func_800268CC;
func_80026B00 = L2_func_80026B00;
func_80026C14 = L2_func_80026C14;
func_80026C38 = L2_func_80026C38;
L2_func_80026C90 = func_80026C90;
L2_func_80026F5C = func_80026F30;
L2_func_80027274 = func_80027248;
func_800274F4 = L2_func_80027520;
func_800275D0 = L2_func_800275FC;
func_80027608 = L2_func_80027634;
func_80027648 = L2_func_80027674;
func_80028888 = L2_func_800288B4;
L2_func_800288F4 = func_800288C8;
L2_func_800289D8 = func_800289AC;
L2_func_80028B20 = func_80028AF4;
func_80028B5C = L2_func_80028B88;
func_800291D4 = L2_func_80029200;
L2_func_80029378 = func_8002934C;
L2_func_80029A30 = func_80029A04;
L2_func_8002A7E4 = func_8002A7B8;
L2_func_8002A8E8 = func_8002A8BC;
func_8002AC60 = L2_func_8002AC8C;
func_8002AF8C = L2_func_8002AFB8;
func_8002B0A4 = L2_func_8002B0D0;
func_8002B200 = L2_func_8002B22C;
L2_func_8002B268 = func_8002B23C;
L2_func_8002B464 = func_8002B438;
func_8002BCD0 = L2_func_8002BCFC;
func_8002BF80 = L2_func_8002BFAC;
L2_func_8002C330 = func_8002C304;
func_8002C474 = L2_func_8002C4A0;
func_8002C800 = L2_func_8002C82C;
L2_func_8002D39C = func_8002D370;
func_8002DB1C = L2_func_8002DB48;
func_8002E130 = L2_func_8002E15C;
func_8002E220 = L2_func_8002E24C;
func_8002E278 = L2_func_8002E2A4;
func_8002E2D0 = L2_func_8002E2FC;
func_8002E360 = L2_func_8002E38C;
func_8002E3CC = L2_func_8002E3F8;
func_8002E414 = L2_func_8002E440;
func_8002E4DC = L2_func_8002E508;
func_8002E56C = L2_func_8002E598;
func_8002E5C8 = L2_func_8002E5F4;
func_8002E670 = L2_func_8002E69C;
func_8002F1E8 = L2_func_8002F214;
func_8002F258 = L2_func_8002F284;
func_8002F300 = L2_func_8002F32C;
func_8002F338 = L2_func_8002F364;
func_8002F5B8 = L2_func_8002F5E4;
L2_func_8002F68C = func_8002F660;
func_8002F680 = L2_func_8002F6AC;
L2_func_8002F6D4 = func_8002F6A8;
L2_func_8002F814 = func_8002F7E8;
func_8002FF28 = L2_func_8002FF60;
func_80030428 = L2_func_80030454;
func_80030478 = L2_func_800304A4;
L2_func_80030504 = func_800304D8;
func_800306D8 = L2_func_80030704;
func_80030734 = L2_func_80030760;
L2_func_800307C0 = func_80030794;
func_80030814 = L2_func_80030840;
func_8003098C = L2_func_800309B8;
func_80030FD4 = L2_func_80031000;
L2_func_80031CF8 = func_80031C7C;
func_80031F68 = L2_func_80031E68;
L2_func_80031F34 = func_80032034;
func_800321F4 = L2_func_800320C8;
func_80032220 = L2_func_800320F4;
L2_func_800322F0 = func_8003241C;
func_80032614 = L2_func_800324E8;
func_80032648 = L2_func_8003251C;
func_800326F0 = L2_func_800325C4;
L2_func_80032684 = func_800327B0;
func_80032938 = L2_func_8003280C;
L2_func_8003292C = func_80032A58;
func_80032B70 = L2_func_80032A44;
L2_func_80033254 = func_80033380;
func_8003360C = L2_func_800334E0;
L2_func_80035C7C = func_80035F34;
L2_func_800368C8 = func_80036B80;
func_80037524 = L2_func_8003726C;
func_800381E4 = L2_func_80037CD8;
L2_func_8003815C = func_80038668;
L2_func_8003838C = func_80038898;
L2_func_800387C4 = func_80038DC0;
func_80039364 = L2_func_80038D5C;
func_800397DC = L2_func_800393F8;
func_80039974 = L2_func_800398F0;
L2_func_80039920 = func_800399A4;
func_80039AC4 = L2_func_80039A40;
func_80039C24 = L2_func_80039BA0;
func_80039CE0 = L2_func_80039C5C;
func_8003A194 = L2_func_8003A110;
func_8003A448 = L2_func_8003A3C4;
L2_func_8003A3FC = func_8003A480;
func_8003A5BC = L2_func_8003A538;
func_8003A684 = L2_func_8003A600;
L2_func_8003AA8C = func_8003AB10;
func_8003B790 = L2_func_8003B70C;
L2_func_8003BC0C = func_8003BC90;
func_8003C7C4 = L2_func_8003C740;
L2_func_8003D7CC = func_8003D900;
L2_func_8003D7E4 = func_8003D918;
func_8003DAC0 = L2_func_8003D98C;
func_80040C64 = L2_func_80040B30;
func_80041AC4 = L2_func_80041990;
func_8004218C = L2_func_80042058;
func_800421D0 = L2_func_8004209C;
func_800422FC = L2_func_800421C8;
func_8004281C = L2_func_800426E8;
func_800428E0 = L2_func_800427AC;
L2_func_80042A08 = func_80042B3C;
func_800439A8 = L2_func_80043874;
L2_func_80043908 = func_80043A3C;
L2_func_80043AFC = func_80043C30;
func_80043D48 = L2_func_80043C14;
L2_func_80043C4C = func_80043D80;
L2_func_80043E58 = func_80043F8C;
func_80045758 = L2_func_80045624;
func_8004585C = L2_func_80045728;
func_800458F4 = L2_func_800457C0;
func_800459FC = L2_func_800458C8;
func_80045FBC = L2_func_80045E88;
L2_func_80046098 = func_800461CC;
func_800462A8 = L2_func_80046174;
func_80046400 = L2_func_800462CC;
L2_func_80046638 = func_8004676C;
func_8004680C = L2_func_800466D8;
L2_func_800481FC = func_80048330;
L2_func_8004857C = func_800486B0;
func_800486C0 = L2_func_8004858C;
func_8004874C = L2_func_80048618;
func_80048BF8 = L2_func_80048AC4;
L2_func_80048B04 = func_80048C38;
func_80048D50 = L2_func_80048C74;
L2_func_80048F5C = func_80049038;
L2_func_800497E4 = func_800499D4;
func_80049E70 = L2_func_80049C80;
L2_func_80049EB8 = func_8004A0A8;
L2_func_8004A9F8 = func_8004ABE8;
func_8004B124 = L2_func_8004AF34;
func_8004B168 = L2_func_8004AF78;
func_8004B18C = L2_func_8004AF9C;
func_8004B1C0 = L2_func_8004AFD0;
func_8004B1F8 = L2_func_8004B008;
func_8004B208 = L2_func_8004B018;
func_8004B65C = L2_func_8004B46C;
func_8004B69C = L2_func_8004B4AC;
func_8004B6E8 = L2_func_8004B4F8;
func_8004BE68 = L2_func_8004BC78;
func_8004BE9C = L2_func_8004BCAC;
func_8004BEAC = L2_func_8004BCBC;
func_8004BEC4 = L2_func_8004BCD4;
L2_func_8004BDD8 = func_8004BFC8;
L2_func_8004BE84 = func_8004C074;
func_8004C0B0 = L2_func_8004BEC0;
func_8004C32C = L2_func_8004C13C;
func_8004C720 = L2_func_8004C530;
L2_func_8004C604 = func_8004C7F4;
func_8004CDE4 = L2_func_8004CBF4;
func_8004CEB4 = L2_func_8004CCC4;
func_8004D0A8 = L2_func_8004CEB8;
func_8004D364 = L2_func_8004D174;
func_8004D67C = L2_func_8004D48C;
L2_func_8004DC58 = func_8004DE48;
func_8004E1CC = L2_func_8004DFDC;
func_8004E2B4 = L2_func_8004E0C4;
func_8004E3A0 = L2_func_8004E1B0;
func_8004E93C = L2_func_8004E88C;
func_8004EB98 = L2_func_8004EAE8;
L2_func_8004EDDC = func_8004EE8C;
func_8004F268 = L2_func_8004F24C;
L2_func_8004F288 = func_8004F2A4;
L2_func_8004F314 = func_8004F330;
func_8004F9D8 = L2_func_8004F9BC;
L2_func_800501B0 = func_800501CC;
func_800507AC = L2_func_80050790;
L2_func_80050AA4 = func_80050AC0;
func_80050D94 = L2_func_80050D78;
func_80051460 = L2_func_80051444;
func_80054F20 = L2_func_80054E54;
func_80055254 = L2_func_80055188;
func_8005583C = L2_func_80055698;
func_800558DC = L2_func_80055738;
L2_func_8005590C = func_80055C18;
func_80055C44 = L2_func_80055938;
func_80055D2C = L2_func_80055A20;
func_80055F98 = L2_func_80055C8C;
func_80056284 = L2_func_80055F78;
func_8005637C = L2_func_80055FFC;
func_8005646C = L2_func_800560EC;
func_80058860 = L2_func_80058570;
func_80059A8C = L2_func_8005979C;
func_80059D84 = L2_func_80059A94;
func_80059E38 = L2_func_80059B48;
func_80059EF4 = L2_func_80059C04;
func_80059F5C = L2_func_80059C6C;
L2_func_80059EF0 = func_8005A1E0;
func_8005A9F4 = L2_func_8005A704;
L2_func_8005AE6C = func_8005B15C;
func_8005B1A0 = L2_func_8005AEB0;
L2_func_8005BA6C = func_8005BD5C;
L2_func_8005C964 = func_8005CC54;
L2_func_8005C994 = func_8005CC84;
L2_func_8005C9C4 = func_8005CCB4;
L2_func_8005CB20 = func_8005CE10;
func_8005CEE8 = L2_func_8005CBF8;
func_8005D84C = L2_func_8005D5CC;
L2_func_8005D670 = func_8005D8F0;
L2_func_8005D6D4 = func_8005D954;
func_8005DD50 = L2_func_8005DAD0;
func_8005E200 = L2_func_8005DF80;
func_8005EF74 = L2_func_8005ECF4;
func_8005F048 = L2_func_8005EDC8;
L2_func_8005EF48 = func_8005F1C8;
L2_func_8005F374 = func_8005F5F4;
func_8005F9CC = L2_func_8005F74C;
L2_func_8005F8AC = func_8005FB2C;
L2_func_8005FBBC = func_8005FE3C;
func_80060144 = L2_func_8005FEC4;
L2_func_80060594 = func_80060690;
func_80060768 = L2_func_8006066C;
L2_func_800606F8 = func_800607F4;
L2_func_800609C8 = func_80060AC4;
func_80060D3C = L2_func_80060C40;
func_80060FC0 = L2_func_80060EC4;
func_80060FDC = L2_func_80060EE0;
L2_func_8006114C = func_80061214;
L2_func_800616AC = func_80061774;
L2_func_800617EC = func_800618B4;
func_80061958 = L2_func_80061890;
func_80061A80 = L2_func_800619B8;
L2_func_80061A24 = func_80061B0C;
L2_func_80061CE8 = func_80061DD0;
func_80061F04 = L2_func_80061E1C;
func_8006204C = L2_func_80061F64;
L2_func_800622F4 = func_80062418;
L2_func_80063630 = func_80063754;
func_800638F4 = L2_func_800637D0;
func_80063B78 = L2_func_80063A54;
L2_func_80063A98 = func_80063BBC;
func_80063F70 = L2_func_80063E4C;
L2_func_80063EFC = func_80064020;
func_80064D5C = L2_func_80064C38;
func_80065048 = L2_func_80064F24;
L2_func_80064FB0 = func_800650D4;
func_80065374 = L2_func_80065250;
func_80066520 = L2_func_800663FC;
func_8006A6B0 = L2_func_80069DD8;
L2_func_8006B2F0 = func_8006C248;
L2_func_8006BE78 = func_8006AE00;
func_8006A1E8 = L2_func_8006DC08;
func_8006DE94 = L2_func_8006E97C;
func_8006DEE8 = L2_func_8006E9D0;
L2_func_80072648 = func_80071B60;
L2_func_800727D4 = func_80071CEC;
func_80077AA0 = L2_func_80078588;
func_80077AF0 = L2_func_800785D8;
func_80077F48 = L2_func_80078A30;
L2_func_80078A60 = func_80077F78;
func_8007805C = L2_func_80078B44;
func_800780A8 = L2_func_80078B90;
func_80078558 = L2_func_80079040;
func_80078584 = L2_func_8007906C;
func_80078BC4 = L2_func_800796AC;
func_80078C58 = L2_func_80079740;
func_80078C9C = L2_func_80079784;
func_80078D6C = L2_func_80079854;
func_80078E94 = L2_func_8007997C;
func_80079044 = L2_func_80079B2C;
L2_func_8007A190 = func_80079254;
func_80079364 = L2_func_8007A2A0;
func_80079418 = L2_func_8007A354;
L2_func_8007A4D4 = func_80079598;
func_8007973C = L2_func_8007A678;
L2_func_8007D6E0 = func_8007E1A8;
L2_func_8007E33C = func_8007EE30;
L2_func_8007E370 = func_8007EE64;
L2_func_8007F098 = func_8007FB8C;
L2_func_8007F210 = func_8007FD04;
L2_func_8007F36C = func_8007FE60;
L2_func_8007F520 = func_80080014;
L2_func_8007FF68 = func_80080A5C;
L2_func_800800D4 = func_80080BC8;
L2_func_80080238 = func_80080D2C;
L2_func_800803A8 = func_80080E9C;
L2_func_80080518 = func_8008100C;
L2_func_80080660 = func_80081154;
L2_func_800807A0 = func_80081294;
L2_func_80080930 = func_80081424;
L2_func_80080AC8 = func_800815BC;
L2_func_80080C04 = func_800816F8;
L2_func_80080D44 = func_80081838;
L2_func_80080E8C = func_80081980;
L2_func_80081390 = func_80081E84;
L2_func_80083044 = func_80083B38;
L2_func_80083064 = func_80083B58;
L2_func_80083074 = func_80083B68;
L2_func_80083280 = func_80083D74;
L2_func_80083494 = func_80083F88;
L2_func_800855E0 = func_800860D4;
L2_func_800855F0 = func_800860E4;
L2_func_80085600 = func_800860F4;
L2_func_80085C3C = func_80086730;
L2_func_80085D5C = func_80086850;
L2_func_80085E1C = func_80086910;
L2_func_80085E4C = func_80086940;
L2_func_80085E7C = func_80086970;
L2_func_80085EDC = func_800869D0;
L2_func_80085F1C = func_80086A10;
L2_func_80086EA8 = func_8008799C;
L2_func_80086FAC = func_80087AA0;
L2_func_800870CC = func_80087BC0;
L2_func_8008710C = func_80087C00;
L2_func_80087120 = func_80087C14;
L2_func_80087134 = func_80087C28;
L2_func_800873A4 = func_80087E98;
L2_func_80087530 = func_80088024;
L2_func_80087574 = func_80088068;
L2_func_8008836C = func_80088E60;
L2_func_80089774 = func_8008A268;
L2_func_80089AF4 = func_8008A5E8;
L2_func_80089BB4 = func_8008A6A8;
L2_func_80089D04 = func_8008A7F8;
L2_func_80089D44 = func_8008A838;
L2_func_80089D64 = func_8008A858;
L2_func_80089D94 = func_8008A888;
L2_func_80089F64 = func_8008AA58;
L2_func_8008A014 = func_8008AB08;
L2_func_8008A0C4 = func_8008ABB8;
L2_func_8008A724 = func_8008B218;
L2_func_8008AAD0 = func_8008B5C4;
L2_func_8008C0C0 = func_8008CBB4;
L2_func_8008C48C = func_8008CF80;
L2_func_8008C6CC = func_8008D1C0;
L2_func_8008C90C = func_8008D400;
L2_func_8008CBBC = func_8008D6B0;
L2_func_8008CE0C = func_8008D900;
L2_func_8008D02C = func_8008DB20;
L2_func_8008D33C = func_8008DE30;
L2_func_8008D66C = func_8008E160;
L2_func_8008D92C = func_8008E420;
L2_func_8008DB6C = func_8008E660;
L2_func_8008DCEC = func_8008E7E0;
L2_func_8008DF2C = func_8008EA20;
L2_func_8008E09C = func_8008EB90;
L2_func_8008E28C = func_8008ED80;
L2_func_8008E5CC = func_8008F0C0;
L2_func_8008E7EC = func_8008F2E0;
L2_func_8008EAFC = func_8008F5F0;
L2_func_8008ECEC = func_8008F7E0;
L2_func_8008EEEC = func_8008F9E0;
L2_func_8008F21C = func_8008FD10;
L2_func_8008F49C = func_8008FF90;
L2_func_8008F74C = func_80090240;
L2_func_8008FCDC = func_800907D0;
L2_func_8008FDAC = func_800908A0;
L2_func_8008FF2C = func_80090A20;
L2_func_8008FFCC = func_80090AC0;
L2_func_8009003C = func_80090B30;
L2_func_800900AC = func_80090BA0;
L2_func_800912A4 = func_80091D08;
L3_D_800B37BC = D_800B6C1C;
func_80029B68 = L3_func_800299F8;
func_80048644 = L3_func_80048204;
func_800605F0 = L3_func_800600D8;
D_1F8003D4 = 0x1F8003D4;
D_1F8003D8 = 0x1F8003D8;
D_1F8003DC = 0x1F8003DC;
L1_D_800AB540_b = L1_D_800AB540;
L1_D_800AB540_c = L1_D_800AB540;
L1_D_8009CE24 = L1_D_8009CE20 + 4;
