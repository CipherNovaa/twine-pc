/* Generated by tools/port_level.py: LEVEL01 names (L1_ prefix) bound to level10's symbols. */
L1_AddPrim = func_8008D8F4;
L1_ApplyBonusCheats = func_8002E198;
L1_ApplyMatrix = func_800905D4;
L1_ApplyMatrixLV = func_8007E8C4;
L1_ApplyMatrixSV = func_800926C8;
L1_Args_GetFlag115 = func_8002E334;
L1_CALLOC3_OBJ_54 = func_8008FAB8;
func_80050B3C = L1_Camera_ResetZoom;
func_8002C3DC = L1_CdBin_Disable;
func_8002C420 = L1_CdBin_Enable;
func_8002C53C = L1_CdBin_SetLevel;
L1_CdInit = func_80089BBC;
L1_CdSearchFile = func_80087720;
L1_ChangeClearPAD = func_80096DEC;
L1_ChangeClearRCnt = func_80096DFC;
func_8002DE10 = L1_Cheat_CheckCodes;
L1_Cheat_DoAction = func_8002DB1C;
L1_Cheat_ResetCodes = func_8002E2DC;
L1_CloseEvent = func_800855E8;
L1_D_80082604 = func_800867B4;
L1_D_80095808 = D_800999B8;
L1_D_8009C180 = D_800A0330;
L1_D_8009C184 = D_800A0334;
L1_D_8009C1EC = D_800A039C;
L1_D_8009C1ED = D_800A039D;
L1_D_8009C1EE = D_800A039E;
L1_D_8009C1F4 = D_800A03A4;
L1_D_8009C1F8 = D_800A03A8;
L1_D_8009C200 = D_800A03B0;
L1_D_8009C204 = D_800A03B4;
L1_D_8009C208 = D_800A03B8;
L1_D_8009C20A = D_800A03BA;
L1_D_8009C20C = D_800A03BC;
L1_D_8009CA56 = D_800A0C06;
L1_D_8009CA58 = D_800A0C08;
L1_D_8009CA59 = D_800A0C09;
L1_D_8009CA5A = D_800A0C0A;
L1_D_8009CA5C = D_800A0C0C;
L1_D_8009CA5E = D_800A0C0E;
L1_D_8009CA60 = D_800A0C10;
L1_D_8009CA64 = D_800A0C14;
L1_D_8009CA68 = D_800A0C18;
L1_D_8009CA70 = D_800A0C20;
L1_D_8009CA74 = D_800A0C24;
L1_D_8009CA78 = D_800A0C28;
L1_D_8009CA7C = D_800A0C2C;
L1_D_8009CA80 = D_800A0C30;
L1_D_8009CA84 = D_800A0C34;
L1_D_8009CA8C = D_800A0C3C;
L1_D_8009CA90 = D_800A0C40;
L1_D_8009CA98 = D_800A0C48;
L1_D_8009CA9C = D_800A0C4C;
L1_D_8009CAA0 = D_800A0C50;
L1_D_8009CAA4 = D_800A0C54;
L1_D_8009CAA8 = D_800A0C58;
L1_D_8009CAAC = D_800A0C5C;
L1_D_8009CABD = D_800A0C6D;
L1_D_8009CABE = D_800A0C6E;
L1_D_8009CABF = D_800A0C6F;
L1_D_8009CAC0 = D_800A0C70;
L1_D_8009CAC4 = D_800A0C74;
L1_D_8009CACC = D_800A0C7C;
L1_D_8009CAD0 = D_800A0C80;
L1_D_8009CD00 = D_800A0EB0;
L1_D_8009CD30 = D_800A0EE0;
L1_D_8009CD3C = D_800A0EEC;
L1_D_8009CD4C = D_800A0EFC;
L1_D_8009CD50 = D_800A0F00;
L1_D_8009CD54 = D_800A0F04;
L1_D_8009CD58 = D_800A0F08;
L1_D_8009CD5C = D_800A0F0C;
L1_D_8009CD5E = D_800A0F0E;
L1_D_8009CD60 = D_800A0F10;
L1_D_8009CD62 = D_800A0F12;
L1_D_8009CD6C = D_800A0F1C;
L1_D_8009CD6E = D_800A0F1E;
L1_D_8009CD80 = D_800A0F30;
L1_D_8009CD88 = D_800A0F38;
L1_D_8009CD8C = D_800A0F3C;
L1_D_8009CD98 = D_800A0F48;
L1_D_8009CDA0 = D_800A0F50;
L1_D_8009CDA2 = D_800A0F52;
L1_D_8009CDA8 = D_800A0F58;
L1_D_8009CDC0 = D_800A0F70;
L1_D_8009CDC4 = D_800A0F74;
L1_D_8009CDD0 = D_800A0F80;
L1_D_8009CDDC = D_800A0F8C;
L1_D_8009CDE4 = D_800A0F94;
L1_D_8009CDE5 = D_800A0F95;
L1_D_8009CDE6 = D_800A0F96;
L1_D_8009CDE7 = D_800A0F97;
L1_D_8009CDE8 = D_800A0F98;
L1_D_8009CDEC = D_800A0F9C;
L1_D_8009CDF0 = D_800A0FA0;
L1_D_8009CE20 = D_800A0FD0;
L1_D_8009CE28 = D_800A0FD8;
L1_D_8009CE38 = D_800A0FE8;
L1_D_8009CE44 = D_800A0FF4;
L1_D_8009CEB0 = D_800A1060;
L1_D_8009CEE0 = D_800A1090;
L1_D_8009CF10 = D_800A10C0;
L1_D_8009CF14 = D_800A10C4;
L1_D_8009CF2C = D_800A10DC;
L1_D_8009CF30 = D_800A10E0;
L1_D_8009CF34 = D_800A10E4;
L1_D_8009CF48 = D_800A10F8;
L1_D_8009CF4C = D_800A10FC;
L1_D_8009CF50 = D_800A1100;
L1_D_8009CF54 = D_800A1104;
L1_D_8009CF68 = D_800A1114;
L1_D_8009CF6C = D_800A1118;
L1_D_8009CF70 = D_800A111C;
L1_D_8009CF74 = D_800A1120;
L1_D_8009CF79 = D_800A1125;
L1_D_8009CF7C = D_800A1128;
L1_D_8009CF80 = D_800A112C;
L1_D_8009CF82 = D_800A112E;
L1_D_8009CF8C = D_800A1138;
L1_D_8009CF90 = D_800A113C;
L1_D_8009CF94 = D_800A1140;
L1_D_8009CF98 = D_800A1144;
L1_D_8009CF9C = D_800A1148;
L1_D_8009CFA8 = D_800A1154;
L1_D_8009CFB0 = D_800A115C;
L1_D_8009CFB4 = D_800A1160;
L1_D_8009CFBB = D_800A1167;
L1_D_8009CFBE = D_800A116A;
L1_D_8009CFC0 = D_800A116C;
L1_D_8009CFC4 = D_800A1170;
L1_D_8009CFCC = D_800A1178;
L1_D_8009CFEC = D_800A1198;
L1_D_8009CFF0 = D_800A119C;
L1_D_8009CFFC = D_800A11A8;
L1_D_8009D000 = D_800A11AC;
L1_D_8009D002 = D_800A11AE;
L1_D_8009D00E = D_800A11BA;
L1_D_8009D010 = D_800A11BC;
L1_D_8009D014 = D_800A11C0;
L1_D_8009D018 = D_800A11C4;
L1_D_8009D01A = D_800A11C6;
L1_D_8009D020 = D_800A11CC;
L1_D_8009D040 = D_800A11F4;
L1_D_8009D09C = D_800A1250;
L1_D_8009D0FC = D_800A12B0;
L1_D_8009D104 = D_800A12B8;
L1_D_8009D106 = D_800A12BA;
L1_D_8009D108 = D_800A12BC;
L1_D_8009D10A = D_800A12BE;
L1_D_8009D10C = D_800A12C0;
L1_D_8009D124 = D_800A12D8;
L1_D_8009D130 = D_800A12E4;
L1_D_8009D26C = D_800A1420;
L1_D_8009D270 = D_800A1424;
L1_D_8009D274 = D_800A1428;
L1_D_8009D280 = D_800A1434;
L1_D_8009D2A8 = D_800A145C;
L1_D_8009D2AC = D_800A1460;
L1_D_8009D2B0 = D_800A1464;
L1_D_8009D35C = D_800A159C;
L1_D_8009D368 = D_800A15A8;
L1_D_8009D36C = D_800A15AC;
L1_D_8009D374 = D_800A15B4;
L1_D_8009D384 = D_800A15C4;
L1_D_8009D394 = D_800A15D4;
L1_D_8009D3A4 = D_800A15E4;
L1_D_8009D3A8 = D_800A15E8;
L1_D_8009D3AC = D_800A15EC;
L1_D_8009D3B0 = D_800A15F0;
L1_D_8009D3BC = D_800A15FC;
L1_D_8009D3F0 = D_800A1630;
L1_D_8009D3F4 = D_800A1634;
L1_D_8009D3F8 = D_800A1638;
L1_D_8009D3FC = D_800A163C;
L1_D_8009D444 = D_800A1684;
L1_D_8009D5A8 = D_800A172C;
L1_D_8009D5AC = D_800A1730;
L1_D_8009D5F8 = D_800A1784;
L1_D_8009D5FC = D_800A1788;
L1_D_8009D600 = D_800A178C;
L1_D_8009D610 = D_800A179C;
L1_D_8009D620 = D_800A17AC;
L1_D_8009D660 = D_800A17EC;
L1_D_8009D7A4 = D_800A1930;
L1_D_8009D7A8 = D_800A1934;
L1_D_8009D8B8 = D_800A1A44;
L1_D_8009D8D4 = D_800A1A60;
L1_D_8009D8D5 = D_800A1A61;
L1_D_8009D8D6 = D_800A1A62;
L1_D_8009D8D8 = D_800A1A64;
L1_D_8009D8DC = D_800A1A68;
L1_D_8009D8DD = D_800A1A69;
L1_D_8009D8E4 = D_800A1A70;
L1_D_8009D8E8 = D_800A1A74;
L1_D_8009D8F0 = D_800A1A7C;
L1_D_8009D8F4 = D_800A1A80;
L1_D_8009D8F8 = D_800A1A84;
L1_D_8009D8FC = D_800A1A88;
L1_D_8009D900 = D_800A1A8C;
L1_D_8009D904 = D_800A1A90;
L1_D_8009D90C = D_800A1A98;
L1_D_8009D910 = D_800A1A9C;
L1_D_8009D914 = D_800A1AA0;
L1_D_8009D918 = D_800A1AA4;
L1_D_8009D91C = D_800A1AA8;
L1_D_8009D920 = D_800A1AAC;
L1_D_8009D924 = D_800A1AB0;
L1_D_8009D928 = D_800A1AB4;
L1_D_8009DB50 = D_800A1CC8;
L1_D_8009E480 = D_800A3200;
L1_D_8009E490 = D_800A3214;
L1_D_8009E908 = D_800A3594;
L1_D_8009E9A8 = D_800A3680;
L1_D_8009E9B4 = D_800A368C;
L1_D_8009E9B8 = D_800A3690;
L1_D_8009E9BC = D_800A3694;
L1_D_8009E9C0 = D_800A3698;
L1_D_8009E9C4 = D_800A369C;
L1_D_8009E9D8 = D_800A36B0;
L1_D_8009EADC = D_800A3870;
L1_D_8009EB5C = D_800A38F0;
L1_D_8009EB7C = D_800A3910;
L1_D_8009EB88 = D_800A391C;
L1_D_8009EB8C = D_800A3920;
L1_D_8009EE0C = D_800A3BA0;
L1_D_8009EE3D = D_800A3BD1;
L1_D_8009EE8C = D_800A3C20;
L1_D_8009EEC4 = D_800A3C58;
L1_D_8009EEC8 = D_800A3C5C;
L1_D_8009EED0 = D_800A3C64;
L1_D_8009EED4 = D_800A3C68;
L1_D_8009EED8 = D_800A3C6C;
L1_D_8009EEF0 = D_800A3C88;
L1_D_8009EEF4 = D_800A3C8C;
L1_D_8009EEF8 = D_800A3C90;
L1_D_8009EF1C = D_800A3CB4;
L1_D_8009EF94 = D_800A3D2C;
L1_D_8009EF98 = D_800A3D30;
L1_D_8009EF9C = D_800A3D34;
L1_D_8009EFA0 = D_800A3D38;
L1_D_8009EFA4 = D_800A3D3C;
L1_D_8009EFA8 = D_800A3D40;
L1_D_8009EFC8 = D_800A3D60;
L1_D_8009F008 = D_800A3DA0;
L1_D_8009F00C = D_800A3DA4;
L1_D_8009F010 = D_800A3DA8;
L1_D_8009F012 = D_800A3DAA;
L1_D_8009F013 = D_800A3DAB;
L1_D_8009F014 = D_800A3DAC;
L1_D_8009F016 = D_800A3DAE;
L1_D_8009F018 = D_800A3DB0;
L1_D_8009F01C = D_800A3DB4;
L1_D_8009F07C = D_800A3E14;
L1_D_8009F084 = D_800A3E1C;
L1_D_8009F090 = D_800A3E28;
L1_D_8009F09C = D_800A3E34;
L1_D_8009F0BC = D_800A3E54;
L1_D_8009F0D0 = D_800A3E68;
L1_D_8009F0E4 = D_800A3E7C;
L1_D_8009F0E6 = D_800A3E7E;
L1_D_8009F10C = D_800A3EA4;
L1_D_8009F114 = D_800A3EAC;
L1_D_8009F118 = D_800A3EB0;
L1_D_8009F11C = D_800A3EB4;
L1_D_8009F120 = D_800A3EB8;
L1_D_8009F124 = D_800A3EBC;
L1_D_8009F128 = D_800A3EC0;
L1_D_8009F12C = D_800A3EC4;
L1_D_8009F130 = D_800A3EC8;
L1_D_8009F134 = D_800A3ECC;
L1_D_8009F138 = D_800A3ED0;
L1_D_8009F13C = D_800A3ED4;
L1_D_8009F140 = D_800A3ED8;
L1_D_8009F144 = D_800A3EDC;
L1_D_8009F148 = D_800A3EE0;
L1_D_8009F14C = D_800A3EE4;
L1_D_8009F150 = D_800A3EE8;
L1_D_8009F160 = D_800A3EF8;
L1_D_8009F170 = D_800A3F08;
L1_D_8009F178 = D_800A3F10;
L1_D_8009F17C = D_800A3F14;
L1_D_8009F18C = D_800A3F24;
L1_D_8009F190 = D_800A3F28;
L1_D_8009F194 = D_800A3F2C;
L1_D_8009F198 = D_800A3F30;
L1_D_8009F1B0 = D_800A3F48;
L1_D_8009F230 = D_800A3FC8;
L1_D_8009F234 = D_800A3FCC;
L1_D_8009F248 = D_800A3FE0;
L1_D_8009F24C = D_800A3FE4;
L1_D_8009F250 = D_800A3FE8;
L1_D_8009F254 = D_800A3FEC;
L1_D_8009F2B8 = D_800A4050;
L1_D_8009F2BA = D_800A4052;
L1_D_8009F2BC = D_800A4054;
L1_D_8009F2E8 = D_800A4080;
L1_D_8009F2F4 = D_800A408C;
L1_D_800A0340 = D_800A50D8;
L1_D_800A0344 = D_800A50DC;
L1_D_800A0348 = D_800A50E0;
L1_D_800A034C = D_800A50E4;
L1_D_800A0350 = D_800A50E8;
L1_D_800A0370 = D_800A5108;
L1_D_800A4370 = D_800A9108;
L1_D_800A4374 = D_800A910C;
L1_D_800A4378 = D_800A9110;
L1_D_800A437C = D_800A9114;
L1_D_800A4380 = D_800A9118;
L1_D_800A4382 = D_800A911A;
L1_D_800A4384 = D_800A911C;
L1_D_800A4390 = D_800A9128;
L1_D_800A4394 = D_800A912C;
L1_D_800A43B0 = D_800A9148;
L1_D_800A43C8 = D_800A9160;
L1_D_800A43CC = D_800A9164;
L1_D_800A43D0 = D_800A9168;
L1_D_800A43D4 = D_800A916C;
L1_D_800A43D8 = D_800A9170;
L1_D_800A43DC = D_800A9174;
L1_D_800A43E0 = D_800A9178;
L1_D_800A43E4 = D_800A917C;
L1_D_800A43E8 = D_800A9180;
L1_D_800A43EC = D_800A9184;
L1_D_800A43F0 = D_800A9188;
L1_D_800A43F4 = D_800A918C;
L1_D_800A43F8 = D_800A9190;
L1_D_800A43FC = D_800A9194;
L1_D_800A4400 = D_800A9198;
L1_D_800A4404 = D_800A919C;
L1_D_800A4408 = D_800A91A0;
L1_D_800A440C = D_800A91A4;
L1_D_800A4410 = D_800A91A8;
L1_D_800A4414 = D_800A91AC;
L1_D_800A4418 = D_800A91B0;
L1_D_800A441C = D_800A91B4;
L1_D_800A4420 = D_800A91B8;
L1_D_800A4428 = D_800A91C0;
L1_D_800A442C = D_800A91C4;
L1_D_800A4430 = D_800A91C8;
L1_D_800A4440 = D_800A91D8;
L1_D_800A4450 = D_800A91E8;
L1_D_800A4460 = D_800A91F8;
L1_D_800A446C = D_800A9204;
L1_D_800A4470 = D_800A9208;
L1_D_800A4474 = D_800A920C;
L1_D_800A4478 = D_800A9210;
L1_D_800A447C = D_800A9214;
L1_D_800A45D0 = D_800A9368;
L1_D_800A45D4 = D_800A936C;
L1_D_800A45D8 = D_800A9370;
L1_D_800A4EA0 = D_800A9C38;
L1_D_800A4FD8 = D_800A9D70;
L1_D_800A4FDC = D_800A9D74;
L1_D_800A4FF0 = D_800A9D88;
L1_D_800A5000 = D_800A9D98;
L1_D_800A5010 = D_800A9DA8;
L1_D_800A56A0 = D_800AA438;
L1_D_800A5834 = D_800AA5CC;
L1_D_800A59D0 = D_800AA768;
L1_D_800A59D4 = D_800AA76C;
L1_D_800A59D8 = D_800AA770;
L1_D_800A59DC = D_800AA774;
L1_D_800A59E0 = D_800AA778;
L1_D_800A5B60 = D_800AA8F8;
L1_D_800A5B6C = D_800AA904;
L1_D_800A5B90 = D_800AA928;
L1_D_800A5BA8 = D_800AA940;
L1_D_800A5CB0 = D_800AAA48;
L1_D_800A5CB4 = D_800AAA4C;
L1_D_800A5CB8 = D_800AAA50;
L1_D_800A5CBC = D_800AAA54;
L1_D_800A5CC0 = D_800AAA58;
L1_D_800A5CC8 = D_800AAA60;
L1_D_800A5CCC = D_800AAA64;
L1_D_800A5CD0 = D_800AAA68;
L1_D_800A5CD4 = D_800AAA6C;
L1_D_800A5CD8 = D_800AAA70;
L1_D_800A5CDC = D_800AAA74;
L1_D_800A5CE0 = D_800AAA78;
L1_D_800A5CE4 = D_800AAA7C;
L1_D_800A5CE8 = D_800AAA80;
L1_D_800A5CEC = D_800AAA84;
L1_D_800A5CF0 = D_800AAA88;
L1_D_800A5D00 = D_800AAA98;
L1_D_800A5D04 = D_800AAA9C;
L1_D_800A5D08 = D_800AAAA0;
L1_D_800A5D18 = D_800AAAB0;
L1_D_800A5D1C = D_800AAAB4;
L1_D_800A5D20 = D_800AAAB8;
L1_D_800A5D24 = D_800AAABC;
L1_D_800A5D28 = D_800AAAC0;
L1_D_800A5D2C = D_800AAAC4;
L1_D_800A5D34 = D_800AAACC;
L1_D_800A5D44 = D_800AAADC;
L1_D_800A5D48 = D_800AAAE0;
L1_D_800A5D4C = D_800AAAE4;
L1_D_800A5D7A = D_800AAB12;
L1_D_800A5D7C = D_800AAB14;
L1_D_800A5D80 = D_800AAB18;
L1_D_800A5D98 = D_800AAB30;
L1_D_800A5D9C = D_800AAB34;
L1_D_800A5DA0 = D_800AAB38;
L1_D_800A5DA4 = D_800AAB3C;
L1_D_800A5DA8 = D_800AAB40;
L1_D_800A5DAC = D_800AAB44;
L1_D_800A5DB0 = D_800AAB48;
L1_D_800A5DB4 = D_800AAB4C;
L1_D_800A5DB5 = D_800AAB4D;
L1_D_800A5DBC = D_800AAB54;
L1_D_800A5E3C = D_800AABD4;
L1_D_800A5E5C = D_800AABF4;
L1_D_800A5EA0 = D_800AAC38;
L1_D_800A5EDC = D_800AAC74;
L1_D_800A5F5C = D_800AACF4;
L1_D_800A5FDC = D_800AAD74;
L1_D_800A605C = D_800AADF4;
L1_D_800A6060 = D_800AADF8;
L1_D_800A6064 = D_800AADFC;
L1_D_800A6068 = D_800AAE00;
L1_D_800A606C = D_800AAE04;
L1_D_800A6070 = D_800AAE08;
L1_D_800A6074 = D_800AAE0C;
L1_D_800A6075 = D_800AAE0D;
L1_D_800A6078 = D_800AAE10;
L1_D_800A6090 = D_800AAE28;
L1_D_800A6094 = D_800AAE2C;
L1_D_800A6098 = D_800AAE30;
L1_D_800A609C = D_800AAE34;
L1_D_800A60A0 = D_800AAE38;
L1_D_800A60B0 = D_800AAE48;
L1_D_800A60D0 = D_800AAE68;
L1_D_800A60D4 = D_800AAE6C;
L1_D_800A60E0 = D_800AAE78;
L1_D_800A60E4 = D_800AAE7C;
L1_D_800A6104 = D_800AAE9C;
L1_D_800A6110 = D_800AAEA8;
L1_D_800A6114 = D_800AAEAC;
L1_D_800A6118 = D_800AAEB0;
L1_D_800A611C = D_800AAEB4;
L1_D_800A6120 = D_800AAEB8;
L1_D_800A6140 = D_800AAED8;
L1_D_800A6170 = D_800AAF08;
L1_D_800A6174 = D_800AAF0C;
L1_D_800A6178 = D_800AAF10;
L1_D_800A6180 = D_800AAF18;
L1_D_800A6198 = D_800AAF30;
L1_D_800A62A0 = D_800AB038;
L1_D_800A66A0 = D_800AB438;
L1_D_800A6EB0 = D_800ABC48;
L1_D_800A6ED0 = D_800ABC68;
L1_D_800A6EF8 = D_800ABC90;
L1_D_800A6F00 = D_800ABC98;
L1_D_800A6F1C = D_800ABCB4;
L1_D_800A6F34 = D_800ABCCC;
L1_D_800A6F4C = D_800ABCE4;
L1_D_800A7048 = D_800ABDE0;
L1_D_800A7060 = D_800ABDF8;
L1_D_800A70A0 = D_800ABE38;
L1_D_800A70C8 = D_800ABE60;
L1_D_800A70D4 = D_800ABE6C;
L1_D_800A70F8 = D_800ABE90;
L1_D_800A7190 = D_800ABF28;
L1_D_800A71EC = D_800ABF84;
L1_D_800A71F0 = D_800ABF88;
L1_D_800A71F4 = D_800ABF8C;
L1_D_800A71F8 = D_800ABF90;
L1_D_800A7214 = D_800ABFAC;
L1_D_800A7260 = D_800ABFF8;
L1_D_800A7290 = D_800AC028;
L1_D_800A72E8 = D_800AC080;
L1_D_800A7300 = D_800AC098;
L1_D_800A7310 = D_800AC0A8;
L1_D_800A7320 = D_800AC0B8;
L1_D_800A7324 = D_800AC0BC;
L1_D_800A7330 = D_800AC0C8;
L1_D_800A7344 = D_800AC0DC;
L1_D_800A735C = D_800AC0F4;
L1_D_800A73BC = D_800AC154;
L1_D_800A73D8 = D_800AC170;
L1_D_800A7418 = D_800AC1B0;
L1_D_800A7424 = D_800AC1BC;
L1_D_800A7474 = D_800AC20C;
L1_D_800A747C = D_800AC214;
L1_D_800A7498 = D_800AC230;
L1_D_800A74D4 = D_800AC26C;
L1_D_800A74E0 = D_800AC278;
L1_D_800A7510 = D_800AC2A8;
L1_D_800A75D0 = D_800AC368;
L1_D_800A7678 = D_800AC410;
L1_D_800A76A0 = D_800AC438;
L1_D_800A76E4 = D_800AC47C;
L1_D_800A76F8 = D_800AC490;
L1_D_800A770C = D_800AC4A4;
L1_D_800A7714 = D_800AC4AC;
L1_D_800A7728 = D_800AC4C0;
L1_D_800A773C = D_800AC4D4;
L1_D_800A7750 = D_800AC4E8;
L1_D_800A775C = D_800AC4F4;
L1_D_800A7778 = D_800AC510;
L1_D_800A7784 = D_800AC51C;
L1_D_800A77B4 = D_800AC54C;
L1_D_800A77CC = D_800AC564;
L1_D_800A79F0 = D_800AC788;
L1_D_800A7A0C = D_800AC7A4;
L1_D_800A7A24 = D_800AC7BC;
L1_D_800A7A30 = D_800AC7C8;
L1_D_800A7CF0 = D_800ACAC4;
L1_D_800A7D08 = D_800ACADC;
L1_D_800A7D20 = D_800ACAF4;
L1_D_800A7D44 = D_800ACB18;
L1_D_800A7D64 = D_800ACB38;
L1_D_800A7D74 = D_800ACB48;
L1_D_800A7D90 = D_800ACB64;
L1_D_800A7DC0 = D_800ACB94;
L1_D_800A7DE8 = D_800ACBBC;
L1_D_800A7DF4 = D_800ACBC8;
L1_D_800A7E14 = D_800ACBE8;
L1_D_800A7E34 = D_800ACC08;
L1_D_800A7E50 = D_800ACC24;
L1_D_800A7E74 = D_800ACC48;
L1_D_800A7E90 = D_800ACC64;
L1_D_800A7EC4 = D_800ACC98;
L1_D_800A7EFC = D_800ACCD0;
L1_D_800A7F1C = D_800ACCF0;
L1_D_800A7F2C = D_800ACD00;
L1_D_800A7F80 = D_800ACD54;
L1_D_800A7FA0 = D_800ACD74;
L1_D_800A7FC8 = D_800ACD9C;
L1_D_800A7FF8 = D_800ACDCC;
L1_D_800A8000 = D_800ACDD4;
L1_D_800A80A4 = D_800ACE78;
L1_D_800A80B0 = D_800ACE84;
L1_D_800A80BC = D_800ACE90;
L1_D_800A80C8 = D_800ACE9C;
L1_D_800A811C = D_800ACEF0;
L1_D_800A8144 = D_800ACF18;
L1_D_800A81F8 = D_800ACFCC;
L1_D_800A8210 = D_800ACFE4;
L1_D_800A8224 = D_800ACFF8;
L1_D_800A8238 = D_800AD00C;
L1_D_800A824C = D_800AD020;
L1_D_800A8260 = D_800AD034;
L1_D_800A8274 = D_800AD048;
L1_D_800A8280 = D_800AD054;
L1_D_800A828C = D_800AD060;
L1_D_800A82B4 = D_800AD088;
L1_D_800A82DC = D_800AD0B0;
L1_D_800A8304 = D_800AD0D8;
L1_D_800A8308 = D_800AD0DC;
L1_D_800A8310 = D_800AD0E4;
L1_D_800A8318 = D_800AD0EC;
L1_D_800A8320 = D_800AD0F4;
L1_D_800A832C = D_800AD100;
L1_D_800A8340 = D_800AD114;
L1_D_800A8370 = D_800AD144;
L1_D_800A8390 = D_800AD164;
L1_D_800A83B0 = D_800AD184;
L1_D_800A83BC = D_800AD190;
L1_D_800A83C8 = D_800AD19C;
L1_D_800A83D4 = D_800AD1A8;
L1_D_800A83E0 = D_800AD1B4;
L1_D_800A83E8 = D_800AD1BC;
L1_D_800A83F0 = D_800AD1C4;
L1_D_800A8400 = D_800AD1D4;
L1_D_800A8410 = D_800AD1E4;
L1_D_800A8418 = D_800AD1EC;
L1_D_800A8420 = D_800AD1F4;
L1_D_800A842C = D_800AD200;
L1_D_800A8444 = D_800AD218;
L1_D_800A844C = D_800AD220;
L1_D_800A8458 = D_800AD22C;
L1_D_800A8460 = D_800AD234;
L1_D_800A8464 = D_800AD238;
L1_D_800A8468 = D_800AD23C;
L1_D_800A8478 = D_800AD24C;
L1_D_800A8484 = D_800AD258;
L1_D_800A8490 = D_800AD264;
L1_D_800A849C = D_800AD270;
L1_D_800A84A8 = D_800AD27C;
L1_D_800A84B4 = D_800AD288;
L1_D_800A84B8 = D_800AD28C;
L1_D_800A84D0 = D_800AD2A4;
L1_D_800A84D8 = D_800AD2AC;
L1_D_800A84E4 = D_800AD2B8;
L1_D_800A84F0 = D_800AD2C4;
L1_D_800A84FC = D_800AD2D0;
L1_D_800A850C = D_800AD2E0;
L1_D_800A851C = D_800AD2F0;
L1_D_800A8528 = D_800AD2FC;
L1_D_800A8534 = D_800AD308;
L1_D_800A8544 = D_800AD318;
L1_D_800A85C4 = D_800AD398;
L1_D_800A85D4 = D_800AD3A8;
L1_D_800A85F8 = D_800AD3CC;
L1_D_800A86C0 = D_800AD4C4;
L1_D_800A86CC = D_800AD4D0;
L1_D_800A8764 = D_800AD584;
L1_D_800A87EC = D_800AD60C;
L1_D_800A87F8 = D_800AD618;
L1_D_800A8808 = D_800AD628;
L1_D_800A880C = D_800AD62C;
L1_D_800A8820 = D_800AD640;
L1_D_800A8858 = D_800AD678;
L1_D_800A887C = D_800AD69C;
L1_D_800A8884 = D_800AD6A4;
L1_D_800A8894 = D_800AD6B4;
L1_D_800A88A4 = D_800AD6C4;
L1_D_800A88D0 = D_800AD6F0;
L1_D_800A89A4 = D_800AD7D4;
L1_D_800A89F0 = D_800AD820;
L1_D_800A8A2C = D_800AD85C;
L1_D_800A8AA8 = D_800AD8D8;
L1_D_800A8C08 = D_800ADA38;
L1_D_800A8C28 = D_800ADA58;
L1_D_800A8C48 = D_800ADA78;
L1_D_800A8D14 = D_800ADB44;
L1_D_800A8D34 = D_800ADB64;
L1_D_800A8D44 = D_800ADB74;
L1_D_800A8D58 = D_800ADB88;
L1_D_800A8FAC = D_800ADD2C;
L1_D_800A9390 = D_800AE110;
L1_D_800A9488 = D_800AE1CC;
L1_D_800A9498 = D_800AE1DC;
L1_D_800A9794 = D_800AE70C;
L1_D_800A97BC = D_800AE734;
L1_D_800A98C8 = D_800AE88C;
L1_D_800A99D0 = D_800AE9CC;
L1_D_800A99EC = D_800AE9E8;
L1_D_800A9A08 = D_800AEA04;
L1_D_800A9A60 = D_800AEA5C;
L1_D_800A9A84 = D_800AEA80;
L1_D_800A9AA8 = D_800AEAA4;
L1_D_800A9B6C = D_800AEB68;
L1_D_800A9B78 = D_800AEB74;
L1_D_800A9BE8 = D_800AEBE4;
L1_D_800A9C08 = D_800AEC04;
L1_D_800A9C78 = D_800AEC74;
L1_D_800A9C8C = D_800AEC88;
L1_D_800A9CA0 = D_800AEC9C;
L1_D_800A9CAC = D_800AECA8;
L1_D_800A9CC0 = D_800AECBC;
L1_D_800A9CC4 = D_800AECC0;
L1_D_800A9CDC = D_800AECD8;
L1_D_800A9D00 = D_800AECFC;
L1_D_800A9D18 = D_800AED14;
L1_D_800A9D30 = D_800AED2C;
L1_D_800A9D44 = D_800AED40;
L1_D_800A9D78 = D_800AED74;
L1_D_800A9D90 = D_800AED8C;
L1_D_800A9EB0 = D_800AEEAC;
L1_D_800A9EC8 = D_800AEEC4;
L1_D_800A9EE0 = D_800AEEDC;
L1_D_800A9F10 = D_800AEF0C;
L1_D_800A9F2C = D_800AEF28;
L1_D_800A9F44 = D_800AEF40;
L1_D_800A9F60 = D_800AEF5C;
L1_D_800A9F80 = D_800AEF7C;
L1_D_800A9F8C = D_800AEF88;
L1_D_800A9F9C = D_800AEF98;
L1_D_800A9FC8 = D_800AEFC4;
L1_D_800A9FD0 = D_800AEFCC;
L1_D_800AA000 = D_800AEFFC;
L1_D_800AA024 = D_800AF020;
L1_D_800AA044 = D_800AF040;
L1_D_800AA058 = D_800AF054;
L1_D_800AA07C = D_800AF078;
L1_D_800AA09C = D_800AF098;
L1_D_800AA0B8 = D_800AF0B4;
L1_D_800AA0BC = D_800AF0B8;
L1_D_800AA0BE = D_800AF0BA;
L1_D_800AA0C0 = D_800AF0BC;
L1_D_800AA0DC = D_800AF0D8;
L1_D_800AA110 = D_800AF10C;
L1_D_800AA154 = D_800AF150;
L1_D_800AA170 = D_800AF16C;
L1_D_800AA1B0 = D_800AF1AC;
L1_D_800AA1D0 = D_800AF1CC;
L1_D_800AA3C0 = D_800AF3BC;
L1_D_800AA3E8 = D_800AF3E4;
L1_D_800AA410 = D_800AF40C;
L1_D_800AA438 = D_800AF434;
L1_D_800AA444 = D_800AF440;
L1_D_800AA46C = D_800AF468;
L1_D_800AA494 = D_800AF490;
L1_D_800AA4C0 = D_800AF4BC;
L1_D_800AA4F0 = D_800AF4EC;
L1_D_800AA518 = D_800AF514;
L1_D_800AA580 = D_800AF57C;
L1_D_800AA590 = D_800AF58C;
L1_D_800AA5A0 = D_800AF59C;
L1_D_800AA5B4 = D_800AF5B0;
L1_D_800AA70C = D_800AF708;
L1_D_800AA71C = D_800AF718;
L1_D_800AA738 = D_800AF734;
L1_D_800AA744 = D_800AF740;
L1_D_800AA760 = D_800AF75C;
L1_D_800AA774 = D_800AF770;
L1_D_800AA794 = D_800AF790;
L1_D_800AA79C = D_800AF798;
L1_D_800AA7A8 = D_800AF7A4;
L1_D_800AA7B0 = D_800AF7AC;
L1_D_800AA7C0 = D_800AF7BC;
L1_D_800AA800 = D_800AF7FC;
L1_D_800AA80C = D_800AF808;
L1_D_800AA818 = D_800AF814;
L1_D_800AA830 = D_800AF82C;
L1_D_800AA84C = D_800AF848;
L1_D_800AA8A0 = D_800AF89C;
L1_D_800AA8C8 = D_800AF8C4;
L1_D_800AA8E0 = D_800AF8DC;
L1_D_800AA8E8 = D_800AF8E4;
L1_D_800AA8F0 = D_800AF8EC;
L1_D_800AB540 = D_800B0540;
L1_D_800AB5E0 = D_800B05E0;
L1_D_800AB5E4 = D_800B05E4;
L1_D_800AB5E8 = D_800B05E8;
L1_D_800AB5EC = D_800B05EC;
L1_D_800AB5F0 = D_800B05F0;
L1_D_800AB5F4 = D_800B05F4;
L1_D_800AB5F8 = D_800B05F8;
L1_D_800AB5FC = D_800B05FC;
L1_D_800AB604 = D_800B0604;
L1_D_800AB608 = D_800B0608;
L1_D_800AB60C = D_800B060C;
L1_D_800AB610 = D_800B0610;
L1_D_800AB618 = D_800B0618;
L1_D_800AB744 = D_800B0744;
L1_D_800AB754 = D_800B0754;
L1_D_800AC284 = D_800B1284;
L1_D_800AC384 = D_800B1384;
L1_D_800AC38C = D_800B138C;
L1_D_800AC4C8 = D_800B14C8;
L1_D_800AC4D0 = D_800B14D0;
L1_D_800AC4D8 = D_800B14D8;
L1_D_800AC4DC = D_800B14DC;
L1_D_800AC4E0 = D_800B14E0;
L1_D_800AC4E4 = D_800B14E4;
L1_D_800AC4E8 = D_800B14E8;
L1_D_800AC4EC = D_800B14EC;
L1_D_800AC54C = D_800B154C;
L1_D_800AC550 = D_800B1550;
L1_D_800AE940 = D_800B3940;
L1_D_800AE9B8 = D_800B39B8;
L1_D_800AE9C0 = D_800B39C0;
L1_D_800AEB1A = D_800B3B1A;
L1_D_800AEC38 = D_800B3C38;
L1_D_800AEDA0 = D_800B3DA0;
L1_D_800AEDA4 = D_800B3DA4;
L1_D_800AEDA8 = D_800B3DA8;
L1_D_800AEDAC = D_800B3DAC;
L1_D_800AEDB0 = D_800B3DB0;
L1_D_800AEDB4 = D_800B3DB4;
L1_D_800AEDB8 = D_800B3DB8;
L1_D_800AEDBC = D_800B3DBC;
L1_D_800AEDD4 = D_800B3DD4;
L1_D_800AEDD8 = D_800B3DD8;
L1_D_800AEDDC = D_800B3DDC;
L1_D_800AEDE0 = D_800B3DE0;
L1_D_800AEDE4 = D_800B3DE4;
L1_D_800AEDE8 = D_800B3DE8;
L1_D_800AEDEC = D_800B3DEC;
L1_D_800AEDF0 = D_800B3DF0;
L1_D_800AEE10 = D_800B3E10;
L1_D_800AEE14 = D_800B3E14;
L1_D_800AF620 = D_800B4620;
L1_D_800AF624 = D_800B4624;
L1_D_800AF6A4 = D_800B46A4;
L1_D_800AF6A5 = D_800B46A5;
L1_D_800AF6A8 = D_800B46A8;
L1_D_800AFEA8 = D_800B4EA8;
L1_D_800AFEAC = D_800B4EAC;
L1_D_800AFEB0 = D_800B4EB0;
L1_D_800AFEB5 = D_800B4EB5;
L1_D_800AFEB6 = D_800B4EB6;
L1_D_800AFEB7 = D_800B4EB7;
L1_D_800AFEB8 = D_800B4EB8;
L1_D_800AFEB9 = D_800B4EB9;
L1_D_800AFEBC = D_800B4EBC;
L1_D_800AFEC0 = D_800B4EC0;
L1_D_800AFEC8 = D_800B4EC8;
L1_D_800AFF2C = D_800B4F2C;
L1_D_800AFF48 = D_800B4F48;
L1_D_800AFF4C = D_800B4F4C;
L1_D_800AFF58 = D_800B4F58;
L1_D_800AFF5C = D_800B4F5C;
L1_D_800AFF60 = D_800B4F60;
L1_D_800AFF64 = D_800B4F64;
L1_D_800AFF68 = D_800B4F68;
L1_D_800AFF70 = D_800B4F70;
L1_D_800AFF78 = D_800B4F78;
L1_D_800AFF80 = D_800B4F80;
L1_D_800AFF84 = D_800B4F84;
L1_D_800AFF88 = D_800B4F88;
L1_D_800AFF8C = D_800B4F8C;
L1_D_800AFF94 = D_800B4F94;
L1_D_800AFF98 = D_800B4F98;
L1_D_800AFFA4 = D_800B4FA4;
L1_D_800AFFA8 = D_800B4FA8;
L1_D_800AFFAC = D_800B4FAC;
L1_D_800AFFB0 = D_800B4FB0;
L1_D_800AFFB4 = D_800B4FB4;
L1_D_800AFFC0 = D_800B4FC0;
L1_D_800AFFC4 = D_800B4FC4;
L1_D_800AFFC8 = D_800B4FC8;
L1_D_800AFFCC = D_800B4FCC;
L1_D_800B0014 = D_800B5014;
L1_D_800B0018 = D_800B5018;
L1_D_800B0064 = D_800B5064;
L1_D_800B0066 = D_800B5066;
L1_D_800B0068 = D_800B5068;
L1_D_800B0070 = D_800B5070;
L1_D_800B0084 = D_800B5084;
L1_D_800B008C = D_800B508C;
L1_D_800B0094 = D_800B5094;
L1_D_800B00A0 = D_800B50A0;
L1_D_800B0108 = D_800B5108;
L1_D_800B05AC = D_800B588C;
L1_D_800B05B0 = D_800B5890;
L1_D_800B077C = D_800B5A5C;
L1_D_800B0794 = D_800B5A74;
L1_D_800B07A4 = D_800B5A84;
L1_D_800B07A8 = D_800B5A88;
L1_D_800B07AC = D_800B5A8C;
L1_D_800B07B0 = D_800B5A90;
L1_D_800B07B4 = D_800B5A94;
L1_D_800B07B8 = D_800B5A98;
L1_D_800B07BC = D_800B5A9C;
L1_D_800B07C0 = D_800B5AA0;
L1_D_800B07C4 = D_800B5AA4;
L1_D_800B0804 = D_800B5AE4;
L1_D_800B0808 = D_800B5AE8;
L1_D_800B0848 = D_800B5B28;
L1_D_800B0868 = D_800B5B48;
L1_D_800B086C = D_800B5B4C;
L1_D_800B087C = D_800B5B5C;
L1_D_800B0A94 = D_800B5D74;
L1_D_800B0A98 = D_800B5D78;
L1_D_800B0AA0 = D_800B5D80;
L1_D_800B0AA4 = D_800B5D84;
L1_D_800B0AA8 = D_800B5D88;
L1_D_800B0AB4 = D_800B5D94;
L1_D_800B0AB8 = D_800B5D98;
L1_D_800B0AC0 = D_800B5DA0;
L1_D_800B0AC8 = D_800B5DA8;
L1_D_800B0ACC = D_800B5DAC;
L1_D_800B0AD0 = D_800B5DB0;
L1_D_800B0AD4 = D_800B5DB4;
L1_D_800B0ADC = D_800B5DBC;
L1_D_800B0AE0 = D_800B5DC0;
L1_D_800B0AE4 = D_800B5DC4;
L1_D_800B0AE8 = D_800B5DC8;
L1_D_800B0AEC = D_800B5DCC;
L1_D_800B0AFC = D_800B5DDC;
L1_D_800B0B10 = D_800B5DF0;
L1_D_800B0B14 = D_800B5DF4;
L1_D_800B0B54 = D_800B5E34;
L1_D_800B0B58 = D_800B5E38;
L1_D_800B0B64 = D_800B5E44;
L1_D_800B0B68 = D_800B5E48;
L1_D_800B0B6A = D_800B5E4A;
L1_D_800B0B6C = D_800B5E4C;
L1_D_800B0B70 = D_800B5E50;
L1_D_800B0B72 = D_800B5E52;
L1_D_800B0B78 = D_800B5E58;
L1_D_800B0B80 = D_800B5E60;
L1_D_800B0B84 = D_800B5E64;
L1_D_800B0B88 = D_800B5E68;
L1_D_800B0B8C = D_800B5E6C;
L1_D_800B0B9C = D_800B5E7C;
L1_D_800B0BA0 = D_800B5E80;
L1_D_800B0BB4 = D_800B5E94;
L1_D_800B0BB8 = D_800B5E98;
L1_D_800B0BBC = D_800B5E9C;
L1_D_800B0BC0 = D_800B5EA0;
L1_D_800B0C10 = D_800B5EF0;
L1_D_800B0C30 = D_800B5F10;
L1_D_800B0C38 = D_800B5F18;
L1_D_800B0C58 = D_800B5F38;
L1_D_800B0C5C = D_800B5F3C;
L1_D_800B0C60 = D_800B5F40;
L1_D_800B0C64 = D_800B5F44;
L1_D_800B0C68 = D_800B5F48;
L1_D_800B0C74 = D_800B5F54;
L1_D_800B0C84 = D_800B5F64;
L1_D_800B0C8C = D_800B5F6C;
L1_D_800B0C94 = D_800B5F74;
L1_D_800B0C98 = D_800B5F78;
L1_D_800B0C9C = D_800B5F7C;
L1_D_800B0CA0 = D_800B5F80;
L1_D_800B0CA4 = D_800B5F84;
L1_D_800B0CA8 = D_800B5F88;
L1_D_800B0CAC = D_800B5F8C;
L1_D_800B0CB0 = D_800B5F90;
L1_D_800B0CC4 = D_800B5FA4;
L1_D_800B0D50 = D_800B6030;
L1_D_800B0D94 = D_800B6074;
L1_D_800B0DA0 = D_800B6080;
L1_D_800B0DA4 = D_800B6084;
L1_D_800B0DA8 = D_800B6088;
L1_D_800B0DAC = D_800B608C;
L1_D_800B0DB0 = D_800B6090;
L1_D_800B0DB4 = D_800B6094;
L1_D_800B0DB8 = D_800B6098;
L1_D_800B0DBC = D_800B609C;
L1_D_800B0DC0 = D_800B60A0;
L1_D_800B0DC4 = D_800B60A4;
L1_D_800B0DC8 = D_800B60A8;
L1_D_800B0DCC = D_800B60AC;
L1_D_800B0DD4 = D_800B60B4;
L1_D_800B0DD8 = D_800B60B8;
L1_D_800B0DDC = D_800B60BC;
L1_D_800B0DE4 = D_800B60C4;
L1_D_800B0E34 = D_800B6114;
L1_D_800B0E36 = D_800B6116;
L1_D_800B0E40 = D_800B6120;
L1_D_800B0E48 = D_800B6128;
L1_D_800B0E54 = D_800B6134;
L1_D_800B0E58 = D_800B6138;
L1_D_800B0E5E = D_800B613E;
L1_D_800B0E5F = D_800B613F;
L1_D_800B0E8C = D_800B616C;
L1_D_800B0EA0 = D_800B6180;
L1_D_800B0EFC = D_800B61DC;
L1_D_800B8EFC = D_800BE1DC;
L1_D_800B8F24 = D_800BE204;
L1_D_800B8F28 = D_800BE208;
L1_D_800B8F68 = D_800BE248;
L1_D_800B8F88 = D_800BE268;
L1_D_800B8FB0 = D_800BE290;
L1_D_800B8FB4 = D_800BE294;
L1_D_800C1C54 = D_800C7ED4;
L1_D_800CA8F4 = D_800D1B14;
L1_D_800D28F4 = D_800D9B14;
L1_D_800D2AF4 = D_800D9D14;
L1_D_800D2AF8 = D_800D9D18;
L1_D_800D2AFC = D_800D9D1C;
L1_D_800D2BC4 = D_800D9DE4;
L1_D_800D2BE8 = D_800D9E08;
L1_D_800D2BEC = D_800D9E0C;
L1_D_800D2BF0 = D_800D9E10;
L1_D_800D2D30 = D_800D9F50;
L1_D_800D2E70 = D_800DA090;
L1_D_800D2E74 = D_800DA094;
L1_D_800D2E84 = D_800DA0A4;
L1_D_800D2E90 = D_800DA0B0;
L1_D_800D2F48 = D_800DA168;
L1_D_800D2F68 = D_800DA188;
L1_D_800D2F8C = D_800DA1AC;
L1_D_800D2F90 = D_800DA1B0;
L1_D_800D2F94 = D_800DA1B4;
L1_D_800D2FA4 = D_800DA1C4;
L1_D_800D2FAC = D_800DA1CC;
L1_D_800D2FB0 = D_800DA1D0;
L1_D_800D2FC0 = D_800DA1E0;
L1_D_800D2FC4 = D_800DA1E4;
L1_D_800D2FF4 = D_800DA214;
L1_D_800D305C = D_800DA27C;
L1_D_800D3068 = D_800DA288;
L1_D_800D308C = D_800DA2AC;
L1_D_800D30C0 = D_800DA2E0;
L1_D_800D30D4 = D_800DA2F4;
L1_D_800D30D8 = D_800DA2F8;
L1_D_800D31B8 = D_800DA3D8;
L1_D_800D31C0 = D_800DA3E0;
L1_D_800D31D0 = D_800DA3F0;
L1_D_800D3234 = D_800DA454;
L1_D_800D3238 = D_800DA458;
L1_D_800D3288 = D_800DA4A8;
L1_D_800D3FA8 = D_800DB1C8;
L1_D_800D3FAC = D_800DB1CC;
L1_D_800D3FB0 = D_800DB1D0;
L1_D_800D3FD4 = D_800DB1F4;
L1_D_800D3FD8 = D_800DB1F8;
L1_D_800D3FE0 = D_800DB200;
L1_D_800D3FE4 = D_800DB204;
L1_D_800D3FEC = D_800DB20C;
L1_D_800D3FF0 = D_800DB210;
L1_D_800D4050 = D_800DB270;
L1_D_800D4058 = D_800DB278;
L1_D_800D4068 = D_800DB288;
L1_D_800D406C = D_800DB28C;
L1_D_800D4070 = D_800DB290;
L1_D_800D4074 = D_800DB294;
L1_D_800D4080 = D_800DB2A0;
L1_D_800D40D8 = D_800DB2F8;
L1_D_800D40F8 = D_800DB318;
L1_D_800D40FC = D_800DB31C;
L1_D_800D4100 = D_800DB320;
L1_D_800D4104 = D_800DB324;
L1_D_800D4108 = D_800DB328;
L1_D_800D410C = D_800DB32C;
L1_D_800D4110 = D_800DB330;
L1_D_800D4114 = D_800DB334;
L1_D_800D4128 = D_800DB348;
L1_D_800D424C = D_800DB46C;
L1_D_800D4250 = D_800DB470;
L1_D_800D4260 = D_800DB480;
L1_D_800D4264 = D_800DB484;
L1_D_800D430C = D_800DB52C;
L1_D_800D4384 = D_800DB5A4;
L1_D_800D4385 = D_800DB5A5;
L1_D_800D4386 = D_800DB5A6;
L1_D_800D4387 = D_800DB5A7;
L1_D_800D4388 = D_800DB5A8;
L1_D_800D4389 = D_800DB5A9;
L1_D_800D438A = D_800DB5AA;
L1_D_800D438B = D_800DB5AB;
L1_D_800D438C = D_800DB5AC;
L1_D_800D438D = D_800DB5AD;
L1_D_800D438E = D_800DB5AE;
L1_D_800D438F = D_800DB5AF;
L1_D_800D4390 = D_800DB5B0;
L1_D_800D43A8 = D_800DB5C8;
L1_D_800D43AC = D_800DB5CC;
L1_D_800D43C0 = D_800DB5E0;
L1_D_800D43CC = D_800DB5EC;
L1_D_800D43D0 = D_800DB5F0;
L1_D_800D43E4 = D_800DB604;
L1_D_800D43F0 = D_800DB610;
L1_D_800D43F4 = D_800DB614;
L1_D_800D43F8 = D_800DB618;
L1_D_800D4400 = D_800DB620;
L1_D_800D4410 = D_800DB630;
L1_D_800D4424 = D_800DB644;
L1_D_800D4440 = D_800DB660;
L1_D_800D4444 = D_800DB664;
L1_D_800D4450 = D_800DB67C;
L1_D_800D4454 = D_800DB680;
L1_D_800D4458 = D_800DB684;
L1_D_800D445C = D_800DB688;
L1_D_800D4464 = D_800DB690;
L1_D_800D4468 = D_800DB694;
L1_D_800D4484 = D_800DB6B8;
L1_D_800D4564 = D_800DB798;
L1_D_800D45C4 = D_800DB7F8;
L1_D_800D45F4 = D_800DB828;
L1_D_800D46D8 = D_800DB90C;
L1_D_800D4958 = D_800DBB8C;
L1_D_800D4984 = D_800DBBB8;
L1_D_800D5DA4 = D_800DCFD8;
L1_D_800D5ED0 = D_800DD104;
L1_D_800D5ED8 = D_800DD10C;
L1_D_800D5EF0 = D_800DD124;
L1_D_800D5F40 = D_800DD174;
L1_D_800D74FC = D_800DE780;
L1_D_800D7550 = D_800DE7D4;
L1_D_800D7554 = D_800DE7D8;
L1_D_800D7588 = D_800DE80C;
L1_D_800D77B8 = D_800DEADC;
L1_D_800D7930 = D_800DEC54;
L1_D_800D7980 = D_800DECA4;
L1_D_800D79D4 = D_800DECF8;
L1_D_800D7A1C = D_800DED40;
L1_D_800D7A20 = D_800DED44;
L1_D_800D7AB8 = D_800DEDDC;
L1_D_800D7C24 = D_800DEF48;
L1_D_800D7CB4 = D_800DEFD8;
L1_D_800D7D08 = D_800DF11C;
L1_D_800D7DF8 = D_800DF20C;
L1_D_800D8138 = D_800DF54C;
L1_D_800D8154 = D_800DF568;
L1_D_800D861C = D_800DFA30;
L1_D_800D8620 = D_800DFA34;
L1_D_800D86C4 = D_800DFAD8;
L1_D_800D86C8 = D_800DFADC;
L1_D_800D86DC = D_800DFAF0;
L1_D_800D86E0 = D_800DFAF4;
L1_D_800D86E4 = D_800DFAF8;
L1_D_800D86E8 = D_800DFAFC;
L1_D_800D8BE8 = D_800DFFFC;
L1_D_800D8C7C = D_800E0090;
L1_D_800D8C90 = D_800E00A4;
L1_D_800D8C94 = D_800E00A8;
L1_D_800D8E74 = D_800E0288;
L1_D_800D8E8C = D_800E02A0;
L1_D_800D8EA4 = D_800E02B8;
L1_D_800D8EA8 = D_800E02BC;
L1_D_800D8EE8 = D_800E02FC;
L1_D_800D8FE8 = D_800E03FC;
L1_D_800D8FF8 = D_800E040C;
L1_D_800D90C0 = D_800E04D4;
L1_D_800D911C = D_800E0530;
L1_D_800D91E4 = D_800E05F8;
L1_D_800D91E7 = D_800E05FB;
L1_D_800D91E8 = D_800E05FC;
L1_D_800D91F0 = D_800E0604;
L1_D_800D91F8 = D_800E060C;
L1_D_800D91FC = D_800E0610;
L1_D_800D9200 = D_800E0614;
L1_D_800D9208 = D_800E061C;
L1_D_800D920C = D_800E0620;
L1_D_800D9210 = D_800E0624;
L1_D_800D9214 = D_800E0628;
L1_D_800D9218 = D_800E062C;
L1_D_800D9232 = D_800E0646;
L1_D_800D9268 = D_800E0680;
L1_D_800D9278 = D_800E0690;
L1_D_800DA270 = D_800E1688;
L1_D_800DA5C0 = D_800E19D8;
L1_D_800DB884 = D_800E3F5C;
L1_D_800DCB44 = D_800E715C;
L1_D_800DCB4C = D_800E7164;
L1_D_800DD7F4 = D_800E7E0C;
L1_D_800DD7F8 = D_800E7E10;
L1_D_800DD7FC = D_800E7E14;
L1_D_800DD800 = D_800E7E18;
L1_D_800DD804 = D_800E7E1C;
L1_D_800DD808 = D_800E7E20;
L1_D_800DD810 = D_800E7E28;
L1_D_800DD818 = D_800E7E30;
L1_D_800DD838 = D_800E7E50;
L1_D_800DD83C = D_800E7E54;
L1_D_800DDA40 = D_800E8058;
L1_D_800DDC44 = D_800E825C;
L1_D_800DDC48 = D_800E8260;
L1_D_800DDC4C = D_800E8264;
L1_D_800DDC50 = D_800E8268;
L1_D_800DDC54 = D_800E826C;
L1_D_800DDC58 = D_800E8270;
L1_D_800DDC5C = D_800E8274;
L1_D_800DDC60 = D_800E8278;
L1_D_800DDC64 = D_800E827C;
L1_D_800DDC68 = D_800E8280;
L1_D_800DDC6C = D_800E8284;
L1_D_800DDCC0 = D_800E82D8;
L1_D_800DDCC4 = D_800E82DC;
L1_D_800DDCC8 = D_800E82E0;
L1_D_800DDCCC = D_800E82E4;
L1_D_800DDD8C = D_800E83A4;
L1_D_800DDD90 = D_800E83A8;
L1_D_800DDD94 = D_800E83AC;
L1_D_800DDD98 = D_800E83B0;
L1_D_800DDDA0 = D_800E83B8;
L1_D_800DDDA4 = D_800E83BC;
L1_D_800DDDA8 = D_800E83C0;
L1_D_800DDDAC = D_800E83C4;
L1_D_800DDDB0 = D_800E83C8;
L1_D_800DDDB4 = D_800E83CC;
L1_D_800DDDB8 = D_800E83D0;
L1_D_800DDDBC = D_800E83D4;
L1_D_800DDDCC = D_800E83E4;
L1_D_800DDDDC = D_800E83F4;
L1_D_800DDDEC = D_800E8404;
L1_D_800DDE04 = D_800E841C;
L1_D_800DDE08 = D_800E8420;
L1_D_800DDE10 = D_800E8428;
L1_D_800DDE30 = D_800E8448;
L1_D_800DDE34 = D_800E844C;
L1_D_800DDEE0 = D_800E84F8;
L1_D_800DDEE4 = D_800E84FC;
L1_D_800DDEE8 = D_800E8500;
L1_D_800DDEEC = D_800E8504;
L1_D_800DDEF0 = D_800E8508;
L1_D_800DDF08 = D_800E8520;
L1_D_800DDF24 = D_800E853C;
L1_D_800DDFEC = D_800E8604;
L1_D_800DE000 = D_800E8618;
L1_D_800DE004 = D_800E861C;
L1_D_800DE018 = D_800E8630;
L1_D_800DE0C4 = D_800E86DC;
L1_D_800DE0C8 = D_800E86E0;
L1_D_800DE0D4 = D_800E86EC;
L1_D_800DE0D8 = D_800E86F0;
L1_D_800DE0DC = D_800E86F4;
L1_D_800DE0E0 = D_800E86F8;
L1_D_800DE0E4 = D_800E86FC;
L1_D_800DE0E8 = D_800E870C;
L1_D_800DE8E8 = D_800E8F0C;
L1_D_800DF0E8 = D_800E970C;
L1_D_800DF0EC = D_800E9710;
L1_D_800DF0F0 = D_800E9714;
L1_D_800DF0F8 = D_800E971C;
L1_D_800DF10C = D_800E9730;
L1_D_800DF12C = D_800E9750;
L1_D_800DF1F4 = D_800E9818;
L1_D_800DF200 = D_800E9824;
L1_D_800DF540 = D_800E9B64;
L1_D_800DF5B8 = D_800E9BDC;
L1_D_800DF684 = D_800E9CA8;
L1_D_800E02B4 = D_800EA8D8;
L1_D_800E23D4 = D_800ED308;
L1_D_800E23E8 = D_800ED30C;
L1_D_800E2438 = D_800ED4DC;
L1_D_800E2448 = D_800ED4EC;
L1_D_800E2DA8 = D_800EDE4C;
L1_D_800E2DBC = D_800EDE60;
L1_D_800E2DE0 = D_800EDE84;
L1_D_800E2DE4 = D_800EDE88;
L1_D_800E2DF4 = D_800EDE98;
L1_D_800E2E44 = D_800EDEE8;
L1_D_800E2E48 = D_800EDEEC;
L1_D_800E2E4C = D_800EDEF0;
L1_D_800E2F2C = D_800EDFD0;
L1_D_800E2F38 = D_800EDFDC;
L1_D_800E2F3C = D_800EDFE0;
L1_D_800E2F54 = D_800EDFF8;
L1_D_800E2F58 = D_800EDFFC;
L1_D_800E2F5C = D_800EE000;
L1_D_800F0F5C = D_800FC800;
L1_D_800F0F80 = D_800FC824;
L1_D_800F1180 = D_800FCB6C;
L1_D_800F11A0 = D_800FCB8C;
L1_D_800F11D0 = D_800FCBBC;
L1_D_800F11F0 = D_800FCBDC;
L1_D_800F128C = D_800FCC78;
L1_D_800F1294 = D_800FCC80;
L1_D_800F12D4 = D_800FCCC0;
L1_D_800F12EC = D_800FCCD8;
L1_D_800F12F4 = D_800FCCE0;
L1_D_800F1314 = D_800FCD00;
L1_D_800F1354 = D_800FCD40;
L1_D_800F136C = D_800FCD58;
L1_D_800F1374 = D_800FCD60;
L1_D_800F138C = D_800FCD78;
L1_D_800F1398 = D_800FCD84;
L1_D_800F13A8 = D_800FCD94;
L1_D_800F1DCC = D_800FD7B8;
L1_D_800F25D8 = D_800FDFC4;
L1_D_800F2FBC = D_800FE9A8;
L1_D_800F3848 = D_800FF234;
L1_D_800F3B48 = D_800FF534;
L1_D_800F3E98 = D_800FF884;
L1_D_800F40DC = D_800FFAC8;
L1_D_800F40E0 = D_800FFACC;
L1_D_800F40F8 = D_800FFAE4;
L1_D_800F40FC = D_800FFAE8;
L1_D_800F4114 = D_800FFB00;
L1_D_800F413C = D_800FFB28;
L1_D_800F415C = D_800FFB48;
L1_D_800F4264 = D_800FFC50;
L1_D_800F4268 = D_800FFC54;
L1_D_800F426C = D_800FFC58;
L1_D_800F4270 = D_800FFC5C;
L1_D_800F5A64 = D_80101450;
L1_D_800F5A65 = D_80101451;
L1_D_800F5A66 = D_80101452;
L1_D_800F5A68 = D_80101454;
L1_D_800F5A6C = D_80101458;
L1_D_800F6040 = D_80101A2C;
L1_D_800F6064 = D_80101A50;
L1_D_800F6068 = D_80101A54;
L1_D_800F606C = D_80101A58;
L1_D_800F6070 = D_80101A5C;
L1_D_800F7664 = D_80103050;
L1_D_800F7E64 = D_80103850;
L1_D_800F7EC4 = D_801038B0;
L1_D_800F7EC8 = D_801038B4;
L1_D_800F7EC9 = D_801038B5;
L1_D_800F7ECA = D_801038B6;
L1_D_800F7ECC = D_801038B8;
L1_D_800F7ECE = D_801038BA;
L1_D_800F7ED0 = D_801038BC;
L1_D_800F7ED2 = D_801038BE;
L1_D_800F7EE4 = D_801038D0;
L1_D_800F7EE8 = D_801038D4;
L1_D_800F7EEC = D_801038D8;
L1_D_800F7EF4 = D_801038E0;
L1_D_800F7EF8 = D_801038E4;
L1_D_800F7EFC = D_801038E8;
L1_D_800F7F00 = D_801038EC;
L1_D_800F7F04 = D_801038F0;
L1_D_800F7F08 = D_801038F4;
L1_D_800F7F10 = D_801038FC;
L1_D_800F7F1C = D_80103908;
L1_D_800F7F64 = D_80103950;
L1_D_800F7F68 = D_80103954;
L1_D_800F7F6C = D_80103958;
L1_D_800F7F70 = D_8010395C;
L1_D_800F7F74 = D_80103960;
L1_D_800F7F81 = D_8010396D;
L1_D_800F7F84 = D_80103970;
L1_D_800F7FCC = D_801039B8;
L1_D_800F8014 = D_80103A00;
L1_D_800F81F4 = D_80103BE0;
L1_D_800F81F8 = D_80103BE4;
L1_D_800F8204 = D_80103BF0;
L1_D_800F8208 = D_80103BF4;
L1_D_800F8214 = D_80103C00;
L1_D_800F8614 = D_80104000;
L1_D_800FC614 = D_80108000;
L1_D_800FC616 = D_80108002;
L1_D_800FC624 = D_80108010;
L1_D_800FC628 = D_80108014;
L1_D_800FC62C = D_80108018;
L1_D_800FC630 = D_8010801C;
L1_D_800FC640 = D_8010802C;
L1_D_800FC644 = D_80108030;
L1_D_800FC648 = D_80108034;
L1_D_800FC650 = D_8010803C;
L1_D_800FC654 = D_80108040;
L1_D_800FC658 = D_80108044;
L1_D_800FC65C = D_80108048;
L1_D_800FC660 = D_8010804C;
L1_D_800FC664 = D_80108050;
L1_D_800FC670 = D_8010805C;
L1_D_800FC67C = D_80108068;
L1_D_800FC6A0 = D_8010808C;
L1_D_800FC6B0 = D_8010809C;
L1_D_800FC6C0 = D_801080AC;
L1_D_800FC780 = D_8010816C;
L1_D_800FC784 = D_80108170;
L1_D_800FC788 = D_80108174;
L1_D_800FC790 = D_8010817C;
L1_D_800FC794 = D_80108180;
L1_D_800FCF94 = D_80108980;
L1_D_800FCF98 = D_80108984;
L1_D_800FCF9C = D_80108988;
L1_D_800FCFA0 = D_8010898C;
L1_D_800FCFA4 = D_80108990;
L1_D_800FCFA8 = D_80108994;
L1_D_800FCFAC = D_80108998;
L1_D_800FCFB0 = D_8010899C;
L1_D_800FCFB4 = D_801089A0;
L1_D_800FD038 = D_80108A24;
L1_D_800FD0B8 = D_80108AA4;
L1_D_800FD0F8 = D_80108AE4;
L1_D_800FD138 = D_80108B24;
L1_D_800FD178 = D_80108B64;
L1_D_800FD17C = D_80108B68;
L1_D_800FD190 = D_80108B7C;
L1_D_800FD191 = D_80108B7D;
L1_D_800FD195 = D_80108B81;
L1_D_800FD197 = D_80108B83;
L1_D_800FD19A = D_80108B86;
L1_D_800FD19B = D_80108B87;
L1_D_800FD19F = D_80108B8B;
L1_D_800FD1A1 = D_80108B8D;
L1_D_800FD1A2 = D_80108B8E;
L1_D_800FD1A4 = D_80108B90;
L1_D_800FD1A6 = D_80108B90 + 0x2;
L1_D_800FD1A8 = D_80108B94;
L1_D_800FD1AC = D_80108B98;
L1_D_800FD1BC = D_80108BA8;
L1_D_800FD1C0 = D_80108BAC;
L1_D_800FD1C4 = D_80108BB0;
L1_D_800FD1C8 = D_80108BB4;
L1_D_800FD208 = D_80108BF4;
L1_D_800FD248 = D_80108C34;
L1_D_800FD24C = D_80108C38;
L1_D_800FD254 = D_80108C40;
L1_D_800FD258 = D_80108C44;
L1_D_800FD25C = D_80108C48;
L1_D_800FD260 = D_80108C4C;
L1_D_800FD264 = D_80108C50;
L1_D_800FD266 = D_80108C52;
L1_D_800FD268 = D_80108C54;
L1_D_800FD26A = D_80108C56;
L1_D_800FD26C = D_80108C58;
L1_D_800FD3E4 = D_80108DD0;
L1_D_800FD3E8 = D_80108DD4;
L1_D_800FD400 = D_80108DEC;
L1_D_800FD440 = D_80108E2C;
L1_D_800FD442 = D_80108E2E;
L1_D_800FD444 = D_80108E30;
L1_D_800FD446 = D_80108E32;
L1_D_800FD448 = D_80108E34;
L1_D_800FD44A = D_80108E36;
L1_D_800FD44C = D_80108E38;
L1_D_800FD44E = D_80108E3A;
L1_D_800FD450 = D_80108E3C;
L1_D_800FD452 = D_80108E3E;
L1_D_800FD454 = D_80108E40;
L1_D_800FD456 = D_80108E42;
L1_D_800FD458 = D_80108E44;
L1_D_800FD45A = D_80108E46;
L1_D_800FD45D = D_80108E49;
L1_D_800FD45E = D_80108E4A;
L1_D_800FD460 = D_80108E4C;
L1_D_800FD462 = D_80108E4E;
L1_D_800FD464 = D_80108E50;
L1_D_800FD466 = D_80108E52;
L1_D_800FD46A = D_80108E56;
L1_D_800FD46C = D_80108E58;
L1_D_800FD46E = D_80108E5A;
L1_D_800FD470 = D_80108E5C;
L1_D_800FD472 = D_80108E5E;
L1_D_800FD476 = D_80108E62;
L1_D_800FD824 = D_80109210;
L1_D_800FD980 = D_8010936C;
L1_D_800FD984 = D_80109370;
L1_D_800FD988 = D_80109374;
L1_D_800FD98C = D_80109378;
L1_D_800FD990 = D_8010937C;
L1_D_800FD994 = D_80109380;
L1_D_800FD998 = D_80109384;
L1_D_800FD99C = D_80109388;
L1_D_800FD9A0 = D_8010938C;
L1_D_800FD9A4 = D_80109390;
L1_D_800FD9AC = D_80109398;
L1_D_800FD9C0 = D_801093AC;
L1_D_800FD9C8 = D_801093B4;
L1_D_800FD9D0 = D_801093BC;
L1_D_800FD9D8 = D_801093C4;
L1_D_800FD9DC = D_801093C8;
L1_D_800FD9E0 = D_801093CC;
L1_D_800FD9F4 = D_801093E0;
L1_D_800FDA04 = D_801093F0;
L1_D_800FDA08 = D_801093F4;
L1_D_800FDA0C = D_801093F8;
L1_D_800FDA24 = D_80109410;
L1_D_800FDB2C = D_80109518;
L1_DebugPage_ArtProfile = func_80041620;
func_80041918 = L1_DebugPage_Camera;
L1_DebugPage_ContourMask = func_80079078;
L1_DebugPage_FPWeapon = func_8007D6A4;
L1_DebugPage_Framerate = func_8004165C;
L1_DebugPage_Loadpoint = func_80031E70;
func_800416A8 = L1_DebugPage_ObjectCount;
L1_DebugPage_Profile = func_800415E4;
func_8002FE50 = L1_DebugScreen_DrawPage;
L1_DeliverEvent = func_80097E04;
func_80032D00 = L1_DevMenu_Draw;
func_80032AA8 = L1_DevMenu_HandleInput;
func_80032EC8 = L1_DevMenu_Init;
L1_DisableEvent = func_8009EDB0;
L1_EVENT_OBJ_11C = func_80089CD8;
L1_EVENT_OBJ_90 = func_80089C4C;
L1_EVENT_OBJ_CC = func_80089C88;
L1_EVENT_OBJ_F4 = func_80089CB0;
L1_EnableEvent = func_80082F38;
L1_FlushCache = func_8009F0C0;
L1_FntFlush = func_8008BDAC;
L1_FntLoad = func_8008BA54;
L1_FntOpen = func_8008BAF4;
L1_FntPrint = func_8008C0C8;
L1_GPU_cw = func_800927E8;
L1_GS_001_OBJ_1F8 = func_80088B24;
L1_GS_001_OBJ_74 = func_800889A0;
L1_GS_107_OBJ_4B8 = func_8007B244;
L1_GS_107_OBJ_51C = func_8007B2A8;
L1_GetClut = func_80085E64;
L1_GetTPage = func_80085EE4;
func_8002F848 = L1_Gfx_Init;
L1_GsClearOt = func_8008D234;
L1_GsDefDispBuff = func_8008E514;
L1_GsGetActiveBuff = func_80088E9C;
L1_GsGetHeadpUnit = func_80092520;
L1_GsGetLs = func_8007E3C4;
L1_GsGetLsUnit = func_80090C8C;
L1_GsGetLwUnit = func_80090F5C;
L1_GsGetTimInfo = func_800900B4;
L1_GsInit3D = func_8008E494;
L1_GsInitGraph = func_8008892C;
L1_GsInitGraph2 = func_80088ABC;
L1_GsInitVcount = func_80089D9C;
L1_GsLinkAnim = func_800921B4;
L1_GsLinkObject4 = func_80089DDC;
L1_GsMapCoordUnit = func_800917BC;
L1_GsMapModelingData = func_8008F9F4;
L1_GsMapUnit = func_8009183C;
L1_GsScanAnim = func_8009210C;
L1_GsScanUnit = func_80092368;
L1_GsSetAmbient = func_80092698;
L1_GsSetDrawBuffClip = func_8009715C;
L1_GsSetDrawBuffOffset = func_80088EAC;
L1_GsSetFlatLight = func_8007AD8C;
L1_GsSetRefView2 = func_8008907C;
L1_GsSortClear = func_80088D44;
L1_GsSortObject4 = func_8007F6E0;
L1_GsSortOt = func_8008B954;
L1_GsSortUnit = func_80090AB8;
L1_GsSwapDispBuff = func_8008D294;
L1_GsTMDdivF3NL = func_8008EB04;
L1_GsTMDdivG3NL = func_8008ECF4;
L1_GsTMDdivNF3 = func_8008E0A4;
L1_GsTMDdivNG3 = func_8008E294;
L1_GsTMDdivTF3L = func_8008EEF4;
L1_GsTMDdivTF3LFG = func_8008D344;
L1_GsTMDdivTF3NL = func_8008C914;
L1_GsTMDdivTG3NL = func_8008CBC4;
L1_GsTMDdivTNF3 = func_8008F4A4;
L1_GsTMDdivTNG3 = func_8008F754;
L1_GsTMDfastF3GL = func_8008CE14;
L1_GsTMDfastF3GLFG = func_8008E5D4;
L1_GsTMDfastF3GNL = func_8008DB74;
L1_GsTMDfastF3L = func_80080D4C;
L1_GsTMDfastF3LFG = func_80080E94;
L1_GsTMDfastF3NL = func_80080C0C;
L1_GsTMDfastG3GL = func_8008D034;
L1_GsTMDfastG3GLFG = func_8008E7F4;
L1_GsTMDfastG3GNL = func_8008DF34;
L1_GsTMDfastG3L = func_800807A8;
L1_GsTMDfastG3LFG = func_80080938;
L1_GsTMDfastG3NL = func_80080668;
L1_GsTMDfastNF3 = func_80080AD0;
L1_GsTMDfastNG3 = func_80080520;
L1_GsTMDfastTF3L = func_80080240;
L1_GsTMDfastTF3LFG = func_800803B0;
L1_GsTMDfastTF3NL = func_800800DC;
L1_GsTMDfastTG3L = func_8007F374;
L1_GsTMDfastTG3LFG = func_8007F528;
L1_GsTMDfastTG3NL = func_8007F218;
L1_GsTMDfastTNF3 = func_8007FF70;
L1_GsTMDfastTNG3 = func_8007F0A0;
L1_GsU_00000008 = func_8009D680;
L1_GsU_00000009 = func_8009D800;
L1_GsU_0000000c = func_8009CD40;
L1_GsU_0000000d = func_8009CF00;
L1_GsU_0000000f = func_8009D0D0;
L1_GsU_00000209 = func_8009D990;
L1_GsU_0000020d = func_8009D2B0;
L1_GsU_00200009 = func_8009DB30;
L1_GsU_0020000d = func_8009D4A0;
L1_GsU_01000000 = func_8009BDA0;
L1_GsU_0100000c = func_8009B900;
L1_GsU_0100000d = func_8009BB70;
L1_GsU_02000000 = func_8009B7C0;
L1_GsU_02000001 = func_8009B850;
L1_GsU_03000000 = D_8009BED0;
L1_GsU_03000001 = func_8009C610;
L1_GsU_03000010 = func_8009C7F0;
L1_GsU_03000011 = func_8009C9E0;
L1_Gssub_make_matrix = func_800904C4;
L1_HookEntryInt = func_80096E1C;
L1_INTR_DMA_OBJ_1CC = func_80096FF8;
L1_INTR_DMA_OBJ_278 = func_800970A4;
L1_INTR_DMA_OBJ_4C = func_80096E78;
L1_INTR_VB_OBJ_58 = func_80096D24;
L1_INTR_VB_OBJ_C4 = func_80096D90;
L1_INTR_VB_OBJ_F0 = func_80096DBC;
L1_ISO9660_OBJ_2D8 = func_800879F8;
L1_ISO9660_OBJ_2F8 = func_80087A18;
L1_ISO9660_OBJ_5BC = func_80087CDC;
L1_ISO9660_OBJ_660 = func_80087D80;
L1_ISO9660_OBJ_8FC = func_8008801C;
L1_InitGeom = func_8008B8CC;
L1_InitHeap3 = func_8008F994;
L1_LoadClut = func_8008FFD4;
L1_LoadClut2 = func_80090044;
L1_LoadTPage = func_800999D4;
func_800793BC = L1_Math_Abs;
func_800793F8 = L1_Math_Max;
func_800794AC = L1_Math_Max3;
func_80079444 = L1_Math_Min3;
L1_Menu_ResetState = func_800291D4;
L1_MulMatrix = func_8007EA24;
L1_MulMatrix2 = func_8007EB34;
L1_OpenEvent = func_8008305C;
L1_PADIF_OBJ_120 = func_800993D4;
L1_PADIF_OBJ_1CC = func_80099480;
L1_PADIF_OBJ_290 = func_80099544;
L1_PADIF_OBJ_48 = func_800992FC;
L1_PADPORTD_OBJ_160 = func_8008A22C;
L1_PADPORTD_OBJ_1C8 = func_8008A294;
L1_PADPORTD_OBJ_2BC = func_8008A388;
L1_PADPORTD_OBJ_2CC = func_8008A398;
L1_PADPORTD_OBJ_388 = func_8008A454;
L1_PADPORTD_OBJ_604 = func_8008A6D0;
L1_PADPORTD_OBJ_63C = func_8008A708;
L1_PADSEQD_OBJ_144 = func_80098258;
L1_PADSEQD_OBJ_34 = func_80098148;
L1_PADSEQD_OBJ_488 = func_8009859C;
L1_PATCHGTE_OBJ_DC = D_800999D0;
L1_PCcreat = func_80088E7C;
L1_PClseek = func_800880A0;
L1_PCopen = func_80087700;
L1_PCread = func_80086FC8;
L1_PadInitDirect = func_8008A0CC;
func_80045184 = L1_Pad_StickToSpeed;
func_8002F3DC = L1_Pad_Update;
func_80041FA4 = L1_PauseMenu_Open;
L1_PopMatrix = func_8007B460;
L1_PushMatrix = func_8007B3BC;
L1_ResetEntryInt = func_800970FC;
func_80042984 = L1_RestartPrompt_Open;
L1_ReturnFromException = func_800970EC;
L1_RotAverage3 = func_8009A514;
L1_RotAverageNclip3 = func_8009A484;
L1_RotAverageNclipColorCol3 = func_8009AE90;
L1_RotAverageNclipColorDpq3 = func_80099B24;
L1_RotAverageNclipColorDpq3_1 = func_80099F7C;
L1_RotMatrix = func_80091BEC;
L1_RotMatrixY = func_80090324;
L1_RotMatrixYXZ = func_80091E7C;
L1_RotMatrixYXZ_gte = func_800908B8;
L1_RotTrans = func_800927B8;
L1_ScaleMatrix = func_80092558;
L1_SetBackColor = func_8009DCD0;
L1_SetColorMatrix = func_8007B38C;
L1_SetDefDispEnv = func_8008EAC4;
L1_SetDefDrawEnv = func_8008E9F4;
L1_SetDrawMode = func_80085D64;
L1_SetDumpFnt = func_8008BA14;
L1_SetFarColor = func_8009E3D0;
L1_SetLightMatrix = func_80092778;
L1_SetLineF4 = func_80085D44;
L1_SetRotMatrix = func_80092728;
L1_SetTransMatrix = func_80092758;
L1_SpuClearReverbWorkArea = func_80097E34;
L1_SpuFree = func_80098054;
L1_SpuGetVoiceEnvelope = func_8009E040;
L1_SpuInitMalloc = func_8009F0E0;
L1_SpuIsTransferCompleted = func_8009B050;
L1_SpuMalloc = func_8009B4F0;
L1_SpuRead = func_8009AFF0;
L1_SpuSetCommonAttr = func_800946B0;
L1_SpuSetKey = func_8009E090;
L1_SpuSetNoiseClock = func_8009E280;
L1_SpuSetTransferMode = func_8009AF60;
L1_SpuSetTransferStartAddr = func_8009AF90;
L1_SpuSetVoiceAttr = func_80097594;
L1_SpuStart = func_80095510;
L1_SquareRoot0 = func_8007B2FC;
L1_SquareRoot12 = func_800906C4;
L1_SsEnd = func_8008A01C;
L1_SsPitchFromNote = func_800935DC;
L1_SsSeqCalledTbyT = func_80097B94;
L1_SsSetSerialAttr = func_80085C54;
L1_SsSetSerialVol = func_80085AA8;
L1_SsSetTickMode = func_8008977C;
L1_SsUtAllKeyOff = func_8008961C;
L1_SsVabClose = func_80089F6C;
L1_SsVabOpenHead = func_8008FF34;
L1_SsVabTransBody = func_8008FCE4;
L1_SsVabTransCompleted = func_8008FDB4;
L1_SsVoKeyOn = func_80085700;
L1_SysDeqIntRP = func_800991D4;
L1_SysEnqIntRP = func_800991E4;
L1_TestEvent = func_8009F0D0;
L1_TransposeMatrix = func_80090594;
L1_VSYNC_OBJ_178 = func_8008824C;
L1_VS_VH2_OBJ_34 = func_8008FF68;
L1_VSync = func_800880D4;
func_800790E8 = L1_Vec_Dot;
func_80079164 = L1_Vec_ProjectXZ;
func_8007920C = L1_Vec_Scale;
L1_WaitEvent = func_8009EDA0;
L1__SN_read = func_80095618;
L1__SN_write = func_800971FC;
L1__SpuInit = func_80095428;
L1__SpuSetAnyVoice = func_8009F140;
L1__SsGetSeqData = func_8009F740;
L1__SsInit = func_800927F8;
L1__SsReadDeltaValue = func_800A0280;
L1__SsSeqGetEof = func_8009F4FC;
L1__SsSeqPlay = func_8009F400;
L1__SsSndCrescendo = func_8009E660;
L1__SsSndNextSep = func_800A0180;
L1__SsSndPause = func_8009EA90;
L1__SsSndPlay = func_8009E630;
L1__SsSndReplay = func_8009EB30;
L1__SsSndTempo = func_8009E870;
L1__SsVmAlloc = func_80094400;
L1__SsVmDoAllocate = func_80092DE8;
L1__SsVmFlush = func_80092958;
L1__SsVmInit = func_8009DCF0;
L1__SsVmKeyOffNow = func_80093BD8;
L1__SsVmKeyOnNow = func_80093708;
L1__SsVmSelectToneAndVag = func_8009E2D0;
L1__SsVmVSetUp = func_80092898;
L1__dirFailAuto = func_800984BC;
L1__gp = D_800AF8DC;
L1__padInitDirSeq = func_80098114;
L1__patch_gte = func_800998F4;
L1__spu_gcSPU = func_8009EDC0;
L1_bzero = func_800985D4;
L1_calloc3 = func_8008FA64;
L1_chkRC2wait = func_80099214;
L1_exit = func_80085E84;
L1_free3 = func_8008FB94;
PROVIDE(L1_func_800274F4 = func_80027690);
PROVIDE(func_80027690 = L1_func_800274F4);
func_8002850C = L1_func_80028370;
PROVIDE(L1_func_8002847C = func_80028618);
PROVIDE(func_80028618 = L1_func_8002847C);
func_80028814 = L1_func_80028678;
L1_func_800286EC = func_80028888;
func_800288C8 = L1_func_8002872C;
func_800289AC = L1_func_80028810;
func_800289F4 = L1_func_80028858;
func_80028AF4 = L1_func_80028958;
L1_func_800289C0 = func_80028B5C;
func_80028CF4 = L1_func_80028B58;
func_80028DA4 = L1_func_80028C08;
func_80029200 = L1_func_80029064;
PROVIDE(L1_func_800291B0 = func_8002934C);
PROVIDE(func_8002934C = L1_func_800291B0);
func_80029650 = L1_func_800294B4;
func_800296A0 = L1_func_80029504;
L1_func_8002967C = func_80029818;
func_80029820 = L1_func_80029684;
func_80029A04 = L1_func_80029868;
L1_func_800299CC = func_80029B68;
PROVIDE(L1_func_80029A34 = func_80029BD0);
PROVIDE(func_80029BD0 = L1_func_80029A34);
func_8002A564 = L1_func_8002A3C8;
func_8002A7B8 = L1_func_8002A61C;
func_8002A8BC = L1_func_8002A720;
func_8002A9F0 = L1_func_8002A854;
func_8002AC30 = L1_func_8002AA94;
L1_func_8002AAC4 = func_8002AC60;
func_8002AC98 = L1_func_8002AAFC;
func_8002AE2C = L1_func_8002AC90;
L1_func_8002ADF0 = func_8002AF8C;
func_8002AFD0 = L1_func_8002AE34;
L1_func_8002AF08 = func_8002B0A4;
func_8002B194 = L1_func_8002AFF8;
L1_func_8002B064 = func_8002B200;
func_8002B23C = L1_func_8002B0A0;
func_8002B318 = L1_func_8002B17C;
PROVIDE(L1_func_8002B29C = func_8002B438);
PROVIDE(func_8002B438 = L1_func_8002B29C);
func_8002B838 = L1_func_8002B69C;
L1_func_8002BB34 = func_8002BCD0;
func_8002BD04 = L1_func_8002BB68;
func_8002BDB4 = L1_func_8002BC18;
func_8002BFC0 = L1_func_8002BE24;
func_8002C0D0 = L1_func_8002BF34;
func_8002C304 = L1_func_8002C168;
L1_func_8002C2D8 = func_8002C474;
func_8002C62C = L1_func_8002C490;
L1_func_8002C664 = func_8002C800;
func_8002C858 = L1_func_8002C6BC;
L1_func_8002C83C = func_8002C9D8;
L1_func_8002C844 = func_8002C9E0;
func_8002D28C = L1_func_8002D0F0;
func_8002D370 = L1_func_8002D1D4;
func_8002D680 = L1_func_8002D4E4;
func_8002D7A0 = L1_func_8002D604;
func_8002D8A4 = L1_func_8002D708;
func_8002DF08 = L1_func_8002DD6C;
L1_func_8002E0E8 = func_8002E284;
func_8002E34C = L1_func_8002E1B0;
func_8002E4B4 = L1_func_8002E318;
L1_func_8002E3A0 = func_8002E53C;
L1_func_8002E410 = func_8002E5AC;
L1_func_8002E430 = func_8002E5CC;
L1_func_8002E48C = func_8002E628;
L1_func_8002E4B4 = func_8002E650;
L1_func_8002E4D4 = func_8002E670;
func_8002E678 = L1_func_8002E4DC;
L1_func_8002E534 = func_8002E6D0;
L1_func_8002E5C4 = func_8002E760;
PROVIDE(L1_func_8002E798 = func_8002E93C);
PROVIDE(func_8002E93C = L1_func_8002E798);
L1_func_8002F0A4 = func_8002F248;
L1_func_8002F114 = func_8002F2B8;
func_8002F708 = L1_func_8002F564;
func_8002F7C8 = L1_func_8002F624;
L1_func_8002F7CC = func_8002F970;
PROVIDE(L1_func_8002FFD8 = func_80030180);
PROVIDE(func_80030180 = L1_func_8002FFD8);
func_800302C0 = L1_func_80030118;
L1_func_800302AC = func_80030454;
L1_func_80030304 = func_800304AC;
L1_func_80030324 = func_800304CC;
func_800304DC = L1_func_80030334;
func_8003055C = L1_func_800303B4;
PROVIDE(L1_func_8003052C = func_800306D4);
PROVIDE(func_800306D4 = L1_func_8003052C);
L1_func_800305B4 = func_8003075C;
L1_func_80030610 = func_800307B8;
func_80030818 = L1_func_80030670;
L1_func_800306A8 = func_80030850;
L1_func_800306F0 = func_80030898;
func_80030940 = L1_func_80030798;
L1_func_80030868 = func_80030A10;
PROVIDE(L1_func_80030994 = func_80030B3C);
PROVIDE(func_80030B3C = L1_func_80030994);
func_80030CAC = L1_func_80030B04;
func_80030EB0 = L1_func_80030D08;
func_80030F48 = L1_func_80030DA0;
L1_func_80030EB0 = func_80031058;
func_800310C8 = L1_func_80030F20;
func_80031150 = L1_func_80030FA8;
func_8003125C = L1_func_800310B4;
L1_func_80031678 = func_80031820;
L1_func_80031F18 = func_800320C0;
func_8003221C = L1_func_80032074;
func_80032398 = L1_func_800321F0;
func_80032638 = L1_func_8003246C;
L1_func_800324C0 = func_8003268C;
func_8003269C = L1_func_800324D0;
L1_func_80032648 = func_80032814;
func_800328F0 = L1_func_80032724;
func_80032934 = L1_func_80032768;
L1_func_80032880 = func_80032A4C;
func_80033018 = L1_func_80032E4C;
PROVIDE(L1_func_80032EFC = func_800330C8);
PROVIDE(func_800330C8 = L1_func_80032EFC);
func_8003325C = L1_func_80033090;
func_80033470 = L1_func_800332A4;
func_8003359C = L1_func_80033348;
func_80033628 = L1_func_800333D4;
func_80033674 = L1_func_800334F4;
L1_func_80033F38 = func_8003466C;
func_80035100 = L1_func_80034998;
func_80035160 = L1_func_800349F8;
func_80035798 = L1_func_80035030;
L1_func_800350F0 = func_80035858;
PROVIDE(L1_func_800352B8 = func_80035A20);
PROVIDE(func_80035A20 = L1_func_800352B8);
func_800360CC = L1_func_80035964;
func_80036154 = L1_func_800359EC;
func_80036324 = L1_func_80035BBC;
func_80036550 = L1_func_80035DE8;
func_8003666C = L1_func_80035F04;
func_80036924 = L1_func_800361BC;
func_80036A90 = L1_func_80036328;
func_80036D1C = L1_func_800365B4;
func_80036DD8 = L1_func_80036670;
L1_func_800368A8 = func_80037010;
L1_func_80036938 = func_800370A0;
func_80037560 = L1_func_80036E10;
L1_func_800373FC = func_80037B4C;
func_80037EC8 = L1_func_80037768;
func_80037F54 = L1_func_800377F4;
func_8003805C = L1_func_800378FC;
func_80038184 = L1_func_80037A24;
func_8003822C = L1_func_80037ACC;
L1_func_80037B6C = func_800382CC;
func_800387E8 = L1_func_800380DC;
PROVIDE(L1_func_800381CC = func_800388D8);
PROVIDE(func_800388D8 = L1_func_800381CC);
func_80038B10 = L1_func_80038404;
func_80038E10 = L1_func_8003872C;
func_80039288 = L1_func_80038984;
func_80039584 = L1_func_80038C04;
func_8003960C = L1_func_80038C8C;
L1_func_800390F8 = func_80039A78;
PROVIDE(L1_func_800391B0 = func_80039B30);
PROVIDE(func_80039B30 = L1_func_800391B0);
L1_func_800393AC = func_80039D2C;
func_80039D64 = L1_func_800393E4;
L1_func_80039520 = func_80039EA0;
L1_func_800395E8 = func_80039F68;
func_8003A128 = L1_func_800397A8;
PROVIDE(L1_func_8003982C = func_8003A1AC);
PROVIDE(func_8003A1AC = L1_func_8003982C);
func_8003A3B4 = L1_func_80039A34;
PROVIDE(L1_func_80039A9C = func_8003A41C);
PROVIDE(func_8003A41C = L1_func_80039A9C);
PROVIDE(L1_func_8003A51C = func_8003AE9C);
PROVIDE(func_8003AE9C = L1_func_8003A51C);
PROVIDE(L1_func_8003A68C = func_8003B00C);
PROVIDE(func_8003B00C = L1_func_8003A68C);
L1_func_8003A71C = func_8003B09C;
func_8003B218 = L1_func_8003A898;
func_8003B394 = L1_func_8003AA14;
PROVIDE(L1_func_8003AC1C = func_8003B59C);
PROVIDE(func_8003B59C = L1_func_8003AC1C);
func_8003BE74 = L1_func_8003B4F4;
PROVIDE(L1_func_8003B53C = func_8003BEBC);
PROVIDE(func_8003BEBC = L1_func_8003B53C);
L1_func_8003B750 = func_8003C0D0;
PROVIDE(L1_func_8003B808 = func_8003C188);
PROVIDE(func_8003C188 = L1_func_8003B808);
func_8003C2C0 = L1_func_8003B940;
func_8003C618 = L1_func_8003BC98;
func_8003C7E8 = L1_func_8003BE68;
func_8003C938 = L1_func_8003BFB8;
L1_func_8003C1BC = func_8003CB3C;
func_8003D098 = L1_func_8003C6B0;
func_8003D0CC = L1_func_8003C6E4;
func_8003D274 = L1_func_8003C88C;
func_8003D28C = L1_func_8003C8A4;
func_8003D3AC = L1_func_8003C9C4;
L1_func_8003CA4C = func_8003D434;
func_8003D4A4 = L1_func_8003CABC;
PROVIDE(L1_func_8003CC8C = func_8003D674);
PROVIDE(func_8003D674 = L1_func_8003CC8C);
PROVIDE(L1_func_8003D76C = func_8003E154);
PROVIDE(func_8003E154 = L1_func_8003D76C);
func_8003E840 = L1_func_8003DE58;
func_8003EB40 = L1_func_8003E158;
func_8003EE7C = L1_func_8003E494;
PROVIDE(L1_func_8003E5A0 = func_8003EF88);
PROVIDE(func_8003EF88 = L1_func_8003E5A0);
func_8003F40C = L1_func_8003EA24;
func_8003F4E8 = L1_func_8003EB00;
PROVIDE(L1_func_8003EC44 = func_8003F62C);
PROVIDE(func_8003F62C = L1_func_8003EC44);
func_80040150 = L1_func_8003F768;
func_80040648 = L1_func_8003FC60;
func_800406CC = L1_func_8003FCE4;
func_80040984 = L1_func_8003FF9C;
PROVIDE(L1_func_8004009C = func_80040A84);
PROVIDE(func_80040A84 = L1_func_8004009C);
func_800410C8 = L1_func_800406E0;
PROVIDE(L1_func_80040778 = func_80041160);
PROVIDE(func_80041160 = L1_func_80040778);
func_80041360 = L1_func_80040978;
func_80041490 = L1_func_80040AA8;
L1_func_8004105C = func_80041A44;
func_80041BA4 = L1_func_800411BC;
L1_func_8004133C = func_80041D24;
L1_func_800414AC = func_80041E94;
L1_func_80041578 = func_80041F60;
L1_func_800417C4 = func_800421AC;
L1_func_800419CC = func_80042478;
func_800424E4 = L1_func_80041A38;
L1_func_80041BA0 = func_8004264C;
func_800426D4 = L1_func_80041C28;
L1_func_80041CF0 = func_8004279C;
func_80042868 = L1_func_80041DBC;
func_80042924 = L1_func_80041E78;
L1_func_80042020 = func_80042ACC;
func_80042C38 = L1_func_8004218C;
L1_func_800425E4 = func_80043090;
func_80043CAC = L1_func_80043200;
L1_func_800433A8 = func_80043E54;
L1_func_80043EE0 = func_8004498C;
func_8004532C = L1_func_800448F4;
L1_func_80044B3C = func_8004555C;
L1_func_80044BAC = func_800455CC;
L1_func_80044BBC = func_800455DC;
PROVIDE(L1_func_80044BCC = func_800458B4);
PROVIDE(func_800458B4 = L1_func_80044BCC);
func_80045D6C = L1_func_80045084;
func_80045ED4 = L1_func_8004514C;
func_800460CC = L1_func_80045344;
PROVIDE(L1_func_80045A28 = func_80046F1C);
PROVIDE(func_80046F1C = L1_func_80045A28);
func_80048838 = L1_func_80047318;
PROVIDE(L1_func_800474AC = func_800489CC);
PROVIDE(func_800489CC = L1_func_800474AC);
func_80048ADC = L1_func_800475BC;
L1_func_800477C0 = func_80048CE0;
L1_func_8004782C = func_80048D4C;
L1_func_8004783C = func_80048D5C;
func_80048F2C = L1_func_80047A04;
func_80049078 = L1_func_80047B50;
func_800492E4 = L1_func_80047DBC;
L1_func_80047ECC = func_800493F4;
func_800497F0 = L1_func_800483D8;
func_80049834 = L1_func_8004841C;
PROVIDE(L1_func_80048794 = func_80049BAC);
PROVIDE(func_80049BAC = L1_func_80048794);
func_80049F64 = L1_func_80048B4C;
func_8004A1FC = L1_func_80048DE4;
func_8004A278 = L1_func_80048E60;
L1_func_80048FE8 = func_8004A400;
L1_func_8004900C = func_8004A424;
func_8004A7D8 = L1_func_800493C0;
func_8004A888 = L1_func_80049470;
func_8004AB54 = L1_func_8004973C;
func_8004ACFC = L1_func_800498E4;
func_8004AEA0 = L1_func_80049A88;
L1_func_80049B7C = func_8004AF94;
func_8004AF9C = L1_func_80049B84;
L1_func_8004A29C = func_8004B6B4;
L1_func_8004A304 = func_8004B71C;
L1_func_8004A338 = func_8004B750;
L1_func_8004A380 = func_8004B798;
L1_func_8004A398 = func_8004B7B0;
L1_func_8004A81C = func_8004BBEC;
L1_func_8004A85C = func_8004BC2C;
L1_func_8004A8A8 = func_8004BC78;
func_8004BCB4 = L1_func_8004A8E4;
PROVIDE(L1_func_8004A9E4 = func_8004BDB4);
PROVIDE(func_8004BDB4 = L1_func_8004A9E4);
func_8004C2DC = L1_func_8004AF0C;
L1_func_8004B028 = func_8004C3F8;
L1_func_8004B04C = func_8004C41C;
L1_func_8004B05C = func_8004C42C;
L1_func_8004B06C = func_8004C43C;
L1_func_8004B084 = func_8004C454;
func_8004C480 = L1_func_8004B0B0;
func_8004C564 = L1_func_8004B194;
L1_func_8004B270 = func_8004C640;
L1_func_8004B334 = func_8004DC0C;
func_8004DC94 = L1_func_8004B3BC;
func_8004DE64 = L1_func_8004B58C;
func_8004E2D4 = L1_func_8004B9FC;
func_8004E3D8 = L1_func_8004BB00;
func_8004E548 = L1_func_8004BC70;
func_8004E680 = L1_func_8004BDA8;
L1_func_8004BE84 = func_8004E844;
L1_func_8004BF70 = func_8004E930;
func_8004EBC0 = L1_func_8004C0C0;
PROVIDE(L1_func_8004C368 = func_8004EE68);
PROVIDE(func_8004EE68 = L1_func_8004C368);
func_8004EF98 = L1_func_8004C498;
L1_func_8004C50C = func_8004F00C;
func_8004F058 = L1_func_8004C558;
L1_func_8004C5C8 = func_8004F0C8;
L1_func_8004C698 = func_8004F198;
L1_func_8004C768 = func_8004F268;
L1_func_8004C824 = func_8004F324;
func_8004F32C = L1_func_8004C82C;
func_8004F444 = L1_func_8004C944;
func_8004F55C = L1_func_8004CA5C;
func_8004F62C = L1_func_8004CB2C;
func_8004F788 = L1_func_8004CBF4;
func_8004F86C = L1_func_8004CCD8;
func_8004F8A8 = L1_func_8004CD14;
func_8004F934 = L1_func_8004CDA0;
L1_func_8004CE38 = func_8004F9CC;
func_8004FA08 = L1_func_8004CE74;
func_8004FA94 = L1_func_8004CF00;
PROVIDE(L1_func_8004D048 = func_8004FBDC);
PROVIDE(func_8004FBDC = L1_func_8004D048);
func_8004FDA8 = L1_func_8004D214;
func_8004FE64 = L1_func_8004D2D0;
L1_func_8004D5A8 = func_8005013C;
func_800502C0 = L1_func_8004D72C;
func_80050304 = L1_func_8004D770;
func_800503D8 = L1_func_8004D844;
func_80050420 = L1_func_8004D88C;
func_8005050C = L1_func_8004D978;
func_800505F4 = L1_func_8004DA60;
func_80050760 = L1_func_8004DBCC;
func_80050930 = L1_func_8004DD9C;
func_80050B8C = L1_func_8004DFF8;
func_80050C10 = L1_func_8004E07C;
func_80050E98 = L1_func_8004E304;
func_80050EBC = L1_func_8004E328;
L1_func_8004E37C = func_80050F10;
PROVIDE(L1_func_8004E5D8 = func_80051068);
PROVIDE(func_80051068 = L1_func_8004E5D8);
L1_func_8004E78C = func_8005121C;
func_80051224 = L1_func_8004E794;
func_8005132C = L1_func_8004E89C;
func_800513FC = L1_func_8004E96C;
func_8005143C = L1_func_8004E9AC;
L1_func_8004EA68 = func_800514F8;
func_80051548 = L1_func_8004EAB8;
func_800515B0 = L1_func_8004EB20;
func_80051700 = L1_func_8004EC70;
func_800519D4 = L1_func_8004EF44;
L1_func_8004F134 = func_80051BC4;
func_80051BD8 = L1_func_8004F148;
func_80051DD8 = L1_func_8004F348;
L1_func_8004F3D8 = func_80051E68;
PROVIDE(L1_func_8004F3E8 = func_80051E78);
PROVIDE(func_80051E78 = L1_func_8004F3E8);
PROVIDE(L1_func_8004F880 = func_80052310);
PROVIDE(func_80052310 = L1_func_8004F880);
PROVIDE(L1_func_8004FD3C = func_800527CC);
PROVIDE(func_800527CC = L1_func_8004FD3C);
func_80052C10 = L1_func_80050180;
func_80052E1C = L1_func_8005038C;
PROVIDE(L1_func_800503D8 = func_80052E68);
PROVIDE(func_80052E68 = L1_func_800503D8);
func_800533F0 = L1_func_80050960;
func_8005342C = L1_func_8005099C;
func_80053474 = L1_func_800509E4;
func_800534A0 = L1_func_80050A10;
PROVIDE(L1_func_80050A70 = func_80053500);
PROVIDE(func_80053500 = L1_func_80050A70);
func_800541B8 = L1_func_80051728;
func_80054D80 = L1_func_800523E4;
func_80054FCC = L1_func_80052630;
func_800551A4 = L1_func_80052808;
func_800554C8 = L1_func_80052B2C;
L1_func_80052BEC = func_80055588;
func_800557EC = L1_func_80053004;
func_80055868 = L1_func_80053080;
func_80055E20 = L1_func_80053684;
L1_func_800536F0 = func_80055E8C;
L1_func_80053790 = func_80055F2C;
func_80055FA0 = L1_func_80053804;
func_80056118 = L1_func_8005397C;
func_800561C8 = L1_func_80053A2C;
func_80056218 = L1_func_80053A7C;
func_80056300 = L1_func_80053B64;
L1_func_80053BD0 = func_8005636C;
func_8005637C = L1_func_80053BE0;
L1_func_80053DAC = func_80056548;
func_80056580 = L1_func_80053DE4;
func_80056674 = L1_func_80053ED8;
func_80056834 = L1_func_80054098;
func_80056868 = L1_func_800540CC;
func_800568B4 = L1_func_80054118;
func_80056908 = L1_func_8005416C;
func_80056A04 = L1_func_80054268;
func_80056AA8 = L1_func_8005430C;
func_80056B58 = L1_func_800543BC;
L1_func_80054414 = func_80056BB0;
func_80056DE0 = L1_func_80054604;
func_80056E78 = L1_func_8005469C;
func_80056FA0 = L1_func_800547C4;
func_80057018 = L1_func_8005483C;
func_80057140 = L1_func_80054964;
func_800572A4 = L1_func_80054AC8;
func_800573D4 = L1_func_80054BF8;
func_80057580 = L1_func_80054DA4;
func_80057614 = L1_func_80054E38;
func_80057710 = L1_func_80054F34;
func_800577B8 = L1_func_80054FDC;
func_8005783C = L1_func_80055060;
func_80057948 = L1_func_8005516C;
func_800579E0 = L1_func_80055204;
func_80057A78 = L1_func_8005529C;
func_80057AD8 = L1_func_800552FC;
func_80057B38 = L1_func_8005535C;
func_80057B9C = L1_func_800553C0;
func_80057CEC = L1_func_80055510;
func_80057D74 = L1_func_80055598;
func_80057E4C = L1_func_80055670;
func_80057FA4 = L1_func_800557C8;
PROVIDE(L1_func_800557F4 = func_80057FD0);
PROVIDE(func_80057FD0 = L1_func_800557F4);
func_80057FF0 = L1_func_80055814;
PROVIDE(L1_func_80055878 = func_80058054);
PROVIDE(func_80058054 = L1_func_80055878);
PROVIDE(L1_func_80055BA8 = func_80058384);
PROVIDE(func_80058384 = L1_func_80055BA8);
func_80058600 = L1_func_80055E24;
func_80058734 = L1_func_80055F58;
func_80058830 = L1_func_80056054;
func_800588EC = L1_func_80056110;
PROVIDE(L1_func_80056154 = func_80058930);
PROVIDE(func_80058930 = L1_func_80056154);
func_80058B34 = L1_func_80056358;
func_80058B98 = L1_func_800563BC;
func_80058C20 = L1_func_80056444;
func_80058C88 = L1_func_800564AC;
func_80058D14 = L1_func_80056538;
func_80058D4C = L1_func_80056570;
func_80058DB8 = L1_func_800565DC;
func_80058DF0 = L1_func_80056614;
func_80058ED4 = L1_func_800566F8;
func_80059018 = L1_func_8005683C;
func_80059070 = L1_func_80056894;
func_800594F8 = L1_func_80056D1C;
func_8005976C = L1_func_80056F90;
func_80059850 = L1_func_80057074;
func_800598D4 = L1_func_800570F8;
func_80059970 = L1_func_80057194;
func_80059994 = L1_func_800571B8;
PROVIDE(L1_func_800572F4 = func_80059AD0);
PROVIDE(func_80059AD0 = L1_func_800572F4);
func_80059B80 = L1_func_800573A4;
func_80059BEC = L1_func_80057410;
func_80059C18 = L1_func_8005743C;
func_80059C58 = L1_func_8005747C;
func_80059DD8 = L1_func_800575FC;
L1_func_80057648 = func_80059E24;
PROVIDE(L1_func_80057750 = func_80059F2C);
PROVIDE(func_80059F2C = L1_func_80057750);
func_8005A28C = L1_func_80057AB0;
L1_func_80057AD8 = func_8005A2B4;
func_8005A308 = L1_func_80057B2C;
L1_func_80057B94 = func_8005A370;
L1_func_80057BFC = func_8005A3D8;
L1_func_80058694 = func_8005AE70;
func_8005B038 = L1_func_8005885C;
L1_func_80058A58 = func_8005B234;
L1_func_80058B10 = func_8005B2EC;
func_8005B348 = L1_func_80058B6C;
L1_func_80058D00 = func_8005B4DC;
func_8005B538 = L1_func_80058D5C;
func_8005B5D8 = L1_func_80058DFC;
PROVIDE(L1_func_80058F28 = func_8005B704);
PROVIDE(func_8005B704 = L1_func_80058F28);
func_8005BE10 = L1_func_80059634;
func_8005C3F0 = L1_func_80059C14;
PROVIDE(L1_func_80059E4C = func_8005C628);
PROVIDE(func_8005C628 = L1_func_80059E4C);
func_8005D548 = L1_func_8005AD6C;
L1_func_8005ADB0 = func_8005D58C;
PROVIDE(L1_func_8005ADD4 = func_8005D5B0);
PROVIDE(func_8005D5B0 = L1_func_8005ADD4);
PROVIDE(L1_func_8005AEF8 = func_8005D6D4);
PROVIDE(func_8005D6D4 = L1_func_8005AEF8);
func_8005DCE4 = L1_func_8005B508;
func_8005DD60 = L1_func_8005B584;
func_8005DD88 = L1_func_8005B5AC;
func_8005DEA8 = L1_func_8005B6CC;
func_8005DF48 = L1_func_8005B76C;
func_8005DF98 = L1_func_8005B7BC;
func_8005E198 = L1_func_8005B96C;
func_8005E25C = L1_func_8005BA30;
func_8005E314 = L1_func_8005BAE8;
func_8005E4AC = L1_func_8005BC80;
func_8005E71C = L1_func_8005BEF0;
func_8005E938 = L1_func_8005C10C;
PROVIDE(L1_func_8005C214 = func_8005EA40);
PROVIDE(func_8005EA40 = L1_func_8005C214);
func_8005EB68 = L1_func_8005C33C;
L1_func_8005C864 = func_8005F090;
L1_func_8005C894 = func_8005F0C0;
func_8005F0F0 = L1_func_8005C8C4;
func_8005F24C = L1_func_8005CA20;
L1_func_8005CB38 = func_8005F364;
func_8005F554 = L1_func_8005CED0;
PROVIDE(L1_func_8005CFC8 = func_8005F64C);
PROVIDE(func_8005F64C = L1_func_8005CFC8);
func_8005F934 = L1_func_8005D2B0;
L1_func_8005D58C = func_8005FC10;
func_8005FC48 = L1_func_8005D5C4;
func_8005FCB4 = L1_func_8005D630;
func_8005FDE4 = L1_func_8005D760;
L1_func_8005DA90 = func_80060114;
PROVIDE(L1_func_8005DB7C = func_80060200);
PROVIDE(func_80060200 = L1_func_8005DB7C);
func_800602C4 = L1_func_8005DC40;
L1_func_8005DF40 = func_800605C4;
func_80060600 = L1_func_8005DF7C;
func_800606A4 = L1_func_8005E020;
func_800608AC = L1_func_8005E228;
PROVIDE(L1_func_8005E424 = func_80060AA8);
PROVIDE(func_80060AA8 = L1_func_8005E424);
func_80061160 = L1_func_8005EADC;
func_800611F0 = L1_func_8005EB6C;
func_80061450 = L1_func_8005EC84;
L1_func_8005EE6C = func_800615C4;
L1_func_8005F3B0 = func_80061B50;
func_80062088 = L1_func_8005F93C;
func_800621F4 = L1_func_8005FAA8;
func_800626EC = L1_func_8005FF60;
L1_func_80060094 = func_80062820;
func_80062BC8 = L1_func_8006043C;
func_80062DC0 = L1_func_800604B0;
L1_func_8006060C = func_80062F1C;
func_80062F24 = L1_func_80060614;
func_800630A8 = L1_func_80060798;
func_800631F4 = L1_func_800608E4;
func_800633D0 = L1_func_80060AC0;
L1_func_80060E28 = func_80063734;
L1_func_80061018 = func_800638D8;
PROVIDE(L1_func_80061068 = func_8006396C);
PROVIDE(func_8006396C = L1_func_80061068);
func_80063ECC = L1_func_800615C8;
L1_func_80061700 = func_80064004;
func_8006400C = L1_func_80061708;
L1_func_80061DC0 = func_8006463C;
func_80064710 = L1_func_80061EC4;
func_80064B38 = L1_func_80062300;
L1_func_80062394 = func_80064BCC;
L1_func_80062784 = func_80064FBC;
func_800653A0 = L1_func_80062B68;
func_80065770 = L1_func_80062F38;
PROVIDE(L1_func_80062FAC = func_800657E4);
PROVIDE(func_800657E4 = L1_func_80062FAC);
func_80065A68 = L1_func_800632AC;
func_80065B6C = L1_func_800633B0;
func_80065C7C = L1_func_800634C0;
func_80065E74 = L1_func_800636B8;
func_80065F6C = L1_func_800637B0;
L1_func_80063858 = func_80066014;
L1_func_80063ADC = func_80066298;
func_800662DC = L1_func_80063B20;
func_80066468 = L1_func_80063CAC;
func_800664FC = L1_func_80063D40;
L1_func_80063ED4 = func_80066690;
L1_func_80063EF8 = func_800666B4;
func_800666F0 = L1_func_80063F34;
func_80066740 = L1_func_80063F84;
func_800668E8 = L1_func_8006412C;
func_80066938 = L1_func_8006417C;
func_800669D8 = L1_func_8006439C;
func_80066B18 = L1_func_800644DC;
func_80066C58 = L1_func_8006461C;
func_80066C9C = L1_func_80064660;
func_80066E88 = L1_func_8006484C;
func_8006704C = L1_func_80064A10;
func_80067264 = L1_func_80064C28;
L1_func_80064E40 = func_8006747C;
func_800676F0 = L1_func_80065510;
L1_func_80065588 = func_80067768;
func_80067798 = L1_func_800655B8;
func_800677F4 = L1_func_80065614;
L1_func_800658B4 = func_80067A94;
func_80067B08 = L1_func_80065928;
PROVIDE(L1_func_80065A20 = func_80067C00);
PROVIDE(func_80067C00 = L1_func_80065A20);
func_80068278 = L1_func_80066098;
func_80068488 = L1_func_800662A8;
func_80068698 = L1_func_800664B8;
func_800688E4 = L1_func_80066704;
L1_func_8006692C = func_80068B0C;
L1_func_80066968 = func_80068B48;
func_80068B84 = L1_func_800669A4;
L1_func_80066A60 = func_80068C40;
L1_func_80066B14 = func_800692CC;
L1_func_80067F18 = func_8006AF28;
func_8006C090 = L1_func_800689F0;
L1_func_80069318 = func_8006CC54;
L1_func_80069328 = func_8006CC64;
L1_func_800693DC = func_8006CD3C;
func_8006CDF8 = L1_func_80069478;
L1_func_800698B8 = func_8006D1B0;
L1_func_8006B198 = func_8006F428;
L1_func_8006B1DC = func_8006F46C;
L1_func_8006B230 = func_8006F4C0;
func_8006F504 = L1_func_8006B274;
PROVIDE(L1_func_8006B2C4 = func_8006F554);
PROVIDE(func_8006F554 = L1_func_8006B2C4);
func_80070724 = L1_func_8006C494;
func_80070B84 = L1_func_8006C8F4;
PROVIDE(L1_func_8006CB88 = func_80070E18);
PROVIDE(func_80070E18 = L1_func_8006CB88);
PROVIDE(L1_func_8006CEA4 = func_80071134);
PROVIDE(func_80071134 = L1_func_8006CEA4);
func_80071650 = L1_func_8006D3C0;
PROVIDE(L1_func_8006D470 = func_80071700);
PROVIDE(func_80071700 = L1_func_8006D470);
func_80071FB0 = L1_func_8006DD20;
PROVIDE(L1_func_8006E054 = func_800722E4);
PROVIDE(func_800722E4 = L1_func_8006E054);
func_800728B0 = L1_func_8006E620;
func_80072C70 = L1_func_8006E9E0;
func_80072F4C = L1_func_8006ECBC;
func_80073138 = L1_func_8006EEA8;
func_800732C4 = L1_func_8006F034;
PROVIDE(L1_func_8006F168 = func_800733F8);
PROVIDE(func_800733F8 = L1_func_8006F168);
func_8007393C = L1_func_8006F6AC;
PROVIDE(L1_func_8006F784 = func_80073A14);
PROVIDE(func_80073A14 = L1_func_8006F784);
func_80073C34 = L1_func_8006F9A4;
func_80073CE4 = L1_func_8006FA54;
func_80073D94 = L1_func_8006FB04;
func_80074164 = L1_func_8006FED4;
func_80074300 = L1_func_80070070;
func_8007455C = L1_func_800702CC;
func_80074838 = L1_func_800705A8;
func_80074980 = L1_func_800706F0;
func_800758C8 = L1_func_80071638;
PROVIDE(L1_func_80072190 = func_80076420);
PROVIDE(func_80076420 = L1_func_80072190);
func_8007669C = L1_func_8007240C;
PROVIDE(L1_func_800726D0 = func_80076960);
PROVIDE(func_80076960 = L1_func_800726D0);
func_80076FD8 = L1_func_80072D48;
func_800770B8 = L1_func_80072E28;
PROVIDE(L1_func_8007369C = func_8007792C);
PROVIDE(func_8007792C = L1_func_8007369C);
func_80078678 = L1_func_800743E8;
PROVIDE(L1_func_800746D0 = func_80078960);
PROVIDE(func_80078960 = L1_func_800746D0);
func_80079278 = L1_func_80074FE8;
func_80079550 = L1_func_800752C0;
PROVIDE(L1_func_800752E8 = func_80079578);
PROVIDE(func_80079578 = L1_func_800752E8);
L1_func_800753A4 = func_80079634;
L1_func_800753F0 = func_80079680;
func_800796EC = L1_func_8007545C;
func_8007984C = L1_func_800755BC;
func_8007990C = L1_func_8007567C;
func_80079A50 = L1_func_800757C0;
L1_func_800758C0 = func_80079B50;
func_80079B80 = L1_func_800758F0;
func_80079BB0 = L1_func_80075920;
func_80079FD8 = L1_func_80075D48;
func_8007A12C = L1_func_80075E9C;
func_8007A1B0 = L1_func_80075F20;
L1_func_80075FA0 = func_8007A230;
L1_func_80075FE4 = func_8007A274;
func_8007A2A4 = L1_func_80076014;
L1_func_800760B4 = func_8007A344;
func_8007A394 = L1_func_80076104;
func_8007A414 = L1_func_80076184;
L1_func_80076A8C = func_8007A888;
L1_func_80077764 = func_8007B50C;
L1_func_800779FC = func_8007B7A4;
L1_func_80077CCC = func_8007BA74;
L1_func_80077D50 = func_8007BAF8;
L1_func_80077FC4 = func_8007BD6C;
L1_func_800781B4 = func_8007BF5C;
L1_func_80078534 = func_8007C2DC;
L1_func_800785A8 = func_8007C350;
L1_func_800787FC = func_8007C5A4;
L1_func_80078840 = func_8007C5E8;
L1_func_800788E0 = func_8007C688;
L1_func_800792B8 = func_8007D2F4;
L1_func_800794A0 = func_8007D658;
L1_func_800794D4 = func_8007D68C;
L1_func_80079588 = func_8007D740;
L1_func_800797A8 = func_8007D960;
L1_func_8007980C = func_8007D9B0;
L1_func_800798A8 = func_8007DA20;
L1_func_800798D4 = func_8007DA4C;
L1_func_80079B94 = func_8007DD0C;
L1_func_80079C04 = func_8007DD7C;
L1_func_80079C54 = func_8007DDCC;
L1_func_80079DB8 = func_8007DF48;
L1_func_80079E10 = func_8007DFA0;
L1_func_80079F84 = func_8007E114;
L1_func_8007A040 = func_8007E208;
L1_func_8007A17C = func_8007E344;
L1_func_8007A1B0 = func_8007E378;
L1_func_8007A4E4 = func_8007E694;
L1_func_8007A554 = func_8007E704;
L1_func_8007A580 = func_8007E730;
L1_func_8007A614 = func_8007E7C4;
L1_func_8007A694 = func_8007E844;
L1_func_8007AA94 = func_8007EC44;
L1_func_8007AC7C = func_8007EE2C;
L1_func_8007CE30 = func_80080FE0;
L1_func_8007D184 = func_80081334;
L1_func_8007D1E8 = func_80081398;
L1_func_8007D260 = func_80081410;
L1_func_8007D2B4 = func_80081464;
L1_func_8007D914 = func_80081AC4;
L1_func_8007DA88 = func_80081C38;
L1_func_8007DE50 = func_80082000;
L1_func_8007E610 = func_800827C0;
L1_func_8007E6A4 = func_80082854;
L1_func_8007EB7C = func_80082D2C;
L1_func_8007EC78 = func_80082E28;
L1_func_8007ED98 = func_80082F48;
L1_func_8007EE34 = func_80082FE4;
L1_func_8007EE64 = func_80083014;
L1_func_8007EEBC = func_8008306C;
L1_func_8007EECC = func_8008307C;
L1_func_8007F040 = func_800831F0;
L1_func_8007F0D8 = func_80083288;
L1_func_8007F140 = func_800832F0;
L1_func_8007F25C = func_8008340C;
L1_func_8007F2EC = func_8008349C;
L1_func_8007F34C = func_800834FC;
L1_func_8007F414 = func_800835C4;
L1_func_8007F4C0 = func_80083670;
L1_func_8007F530 = func_800836E0;
L1_func_8007F5F0 = func_800837A0;
L1_func_8007FAE8 = func_80083C98;
L1_func_8007FCE0 = func_80083E90;
L1_func_8007FF50 = func_80084100;
L1_func_8007FF70 = func_80084120;
L1_func_80080008 = func_800841B8;
L1_func_800800A0 = func_80084250;
L1_func_800800BC = func_8008426C;
L1_func_8008013C = func_800842EC;
L1_func_80080154 = func_80084304;
L1_func_80080234 = func_800843E4;
L1_func_80080464 = func_80084614;
L1_func_800806A0 = func_80084850;
L1_func_80080920 = func_80084AD0;
L1_func_80080944 = func_80084AF4;
L1_func_80080958 = func_80084B08;
L1_func_80080998 = func_80084B48;
L1_func_800809E0 = func_80084B90;
L1_func_80080A10 = func_80084BC0;
L1_func_80080A34 = func_80084BE4;
L1_func_80080CE4 = func_80084E94;
L1_func_80080F44 = func_800850F4;
L1_func_80081094 = func_80085244;
L1_func_800811D0 = func_80085380;
L1_func_80081204 = func_800853B4;
L1_func_80081348 = func_800854F8;
L1_func_800813E8 = func_80085598;
L1_func_80081410 = func_800855C0;
L1_func_80081448 = func_800855F8;
L1_func_80081458 = func_80085608;
L1_func_800814CC = func_8008567C;
L1_func_800815A0 = func_80085750;
L1_func_80081A08 = func_80085BB8;
L1_func_80081B74 = func_80085D24;
L1_func_80081C54 = func_80085E04;
L1_func_80081C84 = func_80085E34;
L1_func_80081CE4 = func_80085E94;
L1_func_80081D14 = func_80085EC4;
L1_func_80082638 = func_800867E8;
L1_func_800828AC = func_80086A5C;
L1_func_8008297C = func_80086B2C;
L1_func_80082B64 = func_80086D14;
L1_func_80082D00 = func_80086EB0;
L1_func_80082E04 = func_80086FB4;
L1_func_80082ED8 = func_80087088;
L1_func_80082EE8 = func_80087098;
L1_func_80082EF8 = func_800870A8;
L1_func_80082F04 = func_800870B4;
L1_func_80082F24 = func_800870D4;
L1_func_80082F44 = func_800870F4;
L1_func_80082F64 = func_80087114;
L1_func_80082F78 = func_80087128;
L1_func_80082F8C = func_8008713C;
L1_func_800830C8 = func_80087278;
L1_func_800831FC = func_800873AC;
L1_func_80083348 = func_800874F8;
L1_func_80083368 = func_80087518;
L1_func_80083388 = func_80087538;
L1_func_800833AC = func_8008755C;
L1_func_800833CC = func_8008757C;
L1_func_800834D0 = func_80087680;
L1_func_80083F14 = func_800880C4;
L1_func_80084134 = func_800882E4;
L1_func_80084164 = func_80088314;
L1_func_80084194 = func_80088344;
L1_func_800841C4 = func_80088374;
L1_func_800841F8 = func_800883A8;
L1_func_80084228 = func_800883D8;
L1_func_80084238 = func_800883E8;
L1_func_80084250 = func_80088400;
L1_func_80084328 = func_800884D8;
L1_func_800844F8 = func_800886A8;
L1_func_80084640 = func_800887F0;
L1_func_800846E0 = func_80088890;
L1_func_80084758 = func_80088908;
L1_func_80084E0C = func_80088FBC;
L1_func_800855BC = func_8008976C;
L1_func_8008571C = func_800898CC;
L1_func_8008596C = func_80089B1C;
L1_func_800859B8 = func_80089B68;
L1_func_80085B5C = func_80089D0C;
L1_func_80085BD0 = func_80089D80;
L1_func_800865BC = func_8008A76C;
L1_func_80086688 = func_8008A838;
L1_func_80086780 = func_8008A930;
L1_func_80086854 = func_8008AA04;
L1_func_8008688C = func_8008AA3C;
L1_func_800868D4 = func_8008AA84;
L1_func_80086928 = func_8008AAD8;
L1_func_80086A40 = func_8008ABF0;
L1_func_80086A6C = func_8008AC1C;
L1_func_80086AD4 = func_8008AC84;
L1_func_80086C64 = func_8008AE14;
L1_func_80086D30 = func_8008AEE0;
L1_func_80086D74 = func_8008AF24;
L1_func_800870A8 = func_8008B258;
L1_func_80087198 = func_8008B348;
L1_func_800873A8 = func_8008B558;
L1_func_80087620 = func_8008B7D0;
L1_func_800876B0 = func_8008B860;
L1_func_800876E4 = func_8008B894;
L1_func_80088C44 = func_8008CDF4;
L1_func_8008A404 = func_8008E5B4;
L1_func_8008A904 = func_8008EAB4;
L1_func_8008C5A4 = func_80090764;
L1_func_8008C5C4 = func_80090784;
L1_func_8008C5D8 = func_80090798;
L1_func_8008C638 = func_800907F8;
L1_func_8008CCB8 = func_80090BE8;
L1_func_8008D2EC = func_8009121C;
L1_func_8008DAAC = func_800919DC;
L1_func_8008DB68 = func_80091A98;
L1_func_8008DBDC = func_80091B0C;
L1_func_8008E03C = func_800921FC;
L1_func_8008E378 = func_80092538;
L1_func_8008FAE8 = func_80093C98;
L1_func_80090004 = func_800941B4;
L1_func_80090164 = func_80094314;
L1_func_80090880 = func_80094A30;
L1_func_80090B00 = func_80094CB0;
L1_func_80090CC0 = func_80094E70;
L1_func_80090D7C = func_80094F2C;
L1_func_80090FFC = func_800951AC;
L1_func_80091080 = func_80095230;
L1_func_800910C4 = func_80095274;
L1_func_80091168 = func_80095318;
L1_func_800911C0 = func_80095370;
L1_func_800911E8 = func_80095398;
L1_func_80091210 = func_800953C0;
L1_func_80091450 = func_80095600;
L1_func_80091480 = func_80095630;
L1_func_800919DC = func_80095B8C;
L1_func_80091C5C = func_80095E0C;
L1_func_80091F24 = func_800960D4;
L1_func_80092330 = func_800964E0;
L1_func_80092404 = func_800965B4;
L1_func_800924F4 = func_800966A4;
L1_func_800926D4 = func_80096884;
L1_func_8009283C = func_800969EC;
L1_func_8009293C = func_80096AEC;
L1_func_80092A34 = func_80096BE4;
L1_func_80092F24 = func_800970D4;
L1_func_80092F5C = func_8009710C;
L1_func_8009302C = func_800971DC;
L1_func_80093C64 = func_80097E14;
L1_func_80093E24 = func_80097FD4;
L1_func_80093F24 = func_800980D4;
L1_func_80093F4C = func_800980FC;
L1_func_80094434 = func_800985E4;
L1_func_80094440 = func_800985F0;
L1_func_800944C4 = func_80098674;
L1_func_80094734 = func_800988E4;
L1_func_8009476C = func_8009891C;
L1_func_80094840 = func_800989F0;
L1_func_800948E8 = func_80098A98;
L1_func_80094CE0 = func_80098E90;
L1_func_80094D48 = func_80098EF8;
L1_func_80094D64 = func_80098F14;
L1_func_80094E2C = func_80098FDC;
L1_func_80094EC4 = func_80099074;
L1_func_80094F18 = func_800990C8;
L1_func_80094F78 = func_80099128;
L1_func_80094F98 = func_80099148;
L1_func_80094FAC = func_8009915C;
L1_func_80094FCC = func_8009917C;
L1_func_80094FEC = func_8009919C;
L1_func_8009500C = func_800991BC;
L1_func_80095104 = func_800992B4;
L1_func_800957F0 = func_800999A0;
L1_func_80095914 = func_80099AC4;
L1_func_80095934 = func_80099AE4;
L1_func_80095954 = func_80099B04;
L1_func_80095A44 = func_80099BF4;
L1_func_80095A64 = func_80099C14;
L1_func_80095D7C = func_80099F2C;
L1_func_80095ECC = func_8009A07C;
L1_func_80096270 = func_8009A420;
L1_func_800963C4 = func_8009A574;
L1_func_80096738 = func_8009A8E8;
L1_func_800967BC = func_8009A96C;
L1_func_80096BC0 = func_8009AD70;
L1_func_80096C54 = func_8009AE04;
L1_func_80096C9C = func_8009AE4C;
L1_func_80096F50 = func_8009B100;
L1_func_80099EB0 = func_8009E060;
L1_func_8009A0A0 = func_8009E250;
L1_func_8009A1F0 = func_8009E3A0;
L1_func_8009A3B0 = func_8009E560;
L1_func_8009A9E0 = func_8009EB90;
L1_func_8009AB60 = func_8009ED10;
L1_func_8009B940 = func_8009FAF0;
L1_func_8009BEAC = func_800A005C;
L1_func_8009BF10 = func_800A00C0;
L1_func_8009BFC0 = func_800A0170;
L1_func_800AACFC = func_800AFCFC;
L1_func_800AAEF8 = func_800AFEF8;
L1_gPsi = D_800B4F9C;
L1_g_Args = D_800B4F7C;
L1_g_CamPosX = D_800B502C;
L1_g_CamPosY = D_800B5030;
L1_g_CamRotX = D_800B4FF4;
L1_g_CamTargetX = D_800B4FE8;
L1_g_Camera = D_800B4FE4;
L1_g_CheatCodeProgress = D_800B5DF8;
L1_g_CheatCodes = D_800A0E6C;
L1_g_CutScene = D_800A0EAC;
L1_g_DebugPageNames = D_800A1000;
L1_g_DebugTextX = D_800A11C8;
L1_g_DebugTextY = D_800A11CA;
L1_g_DevMenu = D_800DA244;
L1_g_FrameCap = D_800B5D7C;
L1_g_FrameRate = D_800A0F5C;
L1_g_GodMode = D_800A0EEA;
L1_g_Invincible = D_800A0C38;
L1_g_MenuUpdateFunc = D_800DB63C;
L1_g_PadAxes = D_800B613C;
L1_g_PadAxesPrev = D_800B6140;
L1_g_PadHeld = D_800B6124;
L1_g_PadPressed = D_800B612C;
L1_g_PadPrev = D_800B6130;
L1_g_Player = D_800B5DE0;
L1_g_Projection = D_800B5090;
L1_g_Weapons = D_800B50A4;
L1_gteMIMefunc = func_80090644;
L1_gte_rotate_z_matrix = func_80097214;
L1_jtbl_800A6F68 = jtbl_800ABD00;
L1_jtbl_800A7168 = jtbl_800ABF00;
L1_jtbl_800A74B0 = jtbl_800AC248;
L1_jtbl_800A7764 = jtbl_800AC4FC;
L1_jtbl_800A7ED8 = jtbl_800ACCAC;
L1_jtbl_800A8028 = jtbl_800ACDFC;
L1_jtbl_800A8088 = jtbl_800ACE5C;
L1_jtbl_800A859C = jtbl_800AD370;
L1_jtbl_800A8AC0 = jtbl_800AD8F0;
L1_jtbl_800A8B20 = jtbl_800AD950;
L1_jtbl_800A8BE8 = jtbl_800ADA18;
L1_jtbl_800A98E4 = jtbl_800AE8A8;
L1_jtbl_800A9AEC = jtbl_800AEAE8;
L1_jtbl_800A9DF8 = jtbl_800AEDF4;
L1_jtbl_800AA190 = jtbl_800AF18C;
L1_jtbl_800AA1F0 = jtbl_800AF1EC;
L1_jtbl_800AA270 = jtbl_800AF26C;
L1_jtbl_800AA2A8 = jtbl_800AF2A4;
L1_jtbl_800AA330 = jtbl_800AF32C;
L1_jtbl_800AA540 = jtbl_800AF53C;
L1_jtbl_800AA560 = jtbl_800AF55C;
L1_jtbl_800AA780 = jtbl_800AF77C;
L1_jtbl_800AA860 = jtbl_800AF85C;
L1_jtbl_800AA880 = jtbl_800AF87C;
L1_malloc3 = func_8008FAE4;
L1_memchr = func_8008FDA4;
L1_memcpy = func_80090634;
L1_memmove = func_80095588;
L1_memset = func_80090624;
L1_note2pitch = func_80093528;
L1_note2pitch2 = func_80093574;
L1_printf = func_8008304C;
L1_rand = func_80085C44;
L1_ratan2 = func_800901A4;
L1_rcos = func_8009E3F0;
L1_rsin = func_8009E490;
L1_setRC2wait = func_800991F4;
L1_setjmp = func_80096E0C;
L1_sin_1 = func_8009E4CC;
L1_sprintf = func_80085F24;
L1_start = func_8002C9A4;
L1_startIntrDMA = func_80096E2C;
L1_startIntrVSync = func_80096CCC;
L1_strcat = func_80088090;
L1_strcmp = func_8008FDE4;
L1_strcpy = func_80085E54;
L1_strlen = func_80085E24;
L1_strncmp = func_80096CBC;
L1_strncpy = func_800927A8;
L1_strstr = func_8008FF24;
L1_strtok = func_8008FDF4;
L1_strtol = func_8008FF14;
L1_toupper = func_80085D14;
L1_vmNoiseOff = func_80094670;
L1_vmNoiseOn = func_80092FB8;
L2_D_800A03C0 = D_800A0338;
L2_D_800A0425 = D_800A039D;
L2_D_800A0426 = D_800A039E;
L2_D_800A0438 = D_800A03B0;
L2_D_800A0C92 = D_800A0C0A;
L2_D_800A0CC0 = D_800A0C38;
L2_D_800A0CC4 = D_800A0C3C;
L2_D_800A0CD4 = D_800A0C4C;
L2_D_800A0CDC = D_800A0C54;
L2_D_800A0CF7 = D_800A0C6F;
L2_D_800A0CFC = D_800A0C74;
L2_D_800A0EF4 = D_800A0E6C;
L2_D_800A0F34 = D_800A0EAC;
L2_D_800A0F68 = D_800A0EE0;
L2_D_800A0F88 = D_800A0F00;
L2_D_800A0F8C = D_800A0F04;
L2_D_800A0FAB = D_800A0F23;
L2_D_800A0FD0 = D_800A0F48;
L2_D_800A0FE0 = D_800A0F58;
L2_D_800A101F = D_800A0F97;
L2_D_800A106C = D_800A0FE4;
L2_D_800A1070 = D_800A0FE8;
L2_D_800A1078 = D_800A0FF0;
L2_D_800A11E8 = D_800A1154;
L2_D_800A11F0 = D_800A115C;
L2_D_800A11FE = D_800A116A;
L2_D_800A1200 = D_800A116C;
L2_D_800A1204 = D_800A1170;
L2_D_800A1230 = D_800A119C;
L2_D_800A123C = D_800A11A8;
L2_D_800A1240 = D_800A11AC;
L2_D_800A1242 = D_800A11AE;
L2_D_800A1248 = D_800A11B4;
L2_D_800A124C = D_800A11B8;
L2_D_800A1250 = D_800A11BC;
L2_D_800A1254 = D_800A11C0;
L2_D_800A1258 = D_800A11C4;
L2_D_800A125A = D_800A11C6;
L2_D_800A125C = D_800A11C8;
L2_D_800A125E = D_800A11CA;
L2_D_800A14A4 = D_800A141C;
L2_D_800A14A8 = D_800A1420;
L2_D_800A14AC = D_800A145C;
L2_D_800A14DC = D_800A14A4;
L2_D_800A14E4 = D_800A1468;
L2_D_800A14E8 = D_800A146C;
L2_D_800A14FC = D_800A14A0;
L2_D_800A1504 = D_800A14A8;
L2_D_800A1508 = D_800A14AC;
L2_D_800A1514 = D_800A156C;
L2_D_800A1518 = D_800A14C8;
L2_D_800A151C = D_800A14CC;
L2_D_800A1524 = D_800A14C4;
L2_D_800A1568 = D_800A14B0;
L2_D_800A156C = D_800A14E0;
L2_D_800A1580 = D_800A1524;
L2_D_800A1588 = D_800A1544;
L2_D_800A15F0 = D_800A1558;
L2_D_800A15F8 = D_800A149C;
L2_D_800A1604 = D_800A155C;
L2_D_800A1618 = D_800A1594;
L2_D_800A1634 = D_800A159C;
L2_D_800A167C = D_800A15E4;
L2_D_800A1680 = D_800A15E8;
L2_D_800A19A0 = D_800A1770;
L2_D_800A1A1C = D_800A17EC;
L2_D_800A3E74 = D_800A369C;
L2_D_800A3E8C = D_800A36B4;
L2_D_800A40AC = D_800A386C;
L2_D_800AC49C = D_800ABC58;
L2_D_800AC6FC = D_800ABEB8;
L2_D_800ACABC = D_800AC278;
L2_D_800ACAEC = D_800AC2A8;
L2_D_800ADA08 = D_800AD19C;
L2_D_800ADA50 = D_800AD1E4;
L2_D_800ADA58 = D_800AD1EC;
L2_D_800ADC24 = D_800AD3B8;
L2_D_800AE308 = D_800ADAA8;
L2_D_800AE5A4 = D_800ADD64;
L2_D_800AE968 = D_800AE128;
L2_D_800AF064 = D_800AE64C;
L2_D_800AF140 = D_800AE728;
L2_D_800AF160 = D_800AE748;
L2_D_800AF188 = D_800AE770;
L2_D_800B0F58 = D_800B0540;
L2_D_800B1018 = D_800B0600;
L2_D_800B102C = D_800B0614;
L2_D_800B1DC4 = D_800B138C;
L2_D_800B1F2C = D_800B14D8;
L2_D_800B1F30 = D_800B14DC;
L2_D_800B1FA0 = D_800B154C;
L2_D_800B4E3C = D_800B3DA8;
L2_D_800B56B4 = D_800B4620;
L2_D_800B5738 = D_800B46A4;
L2_D_800B5739 = D_800B46A5;
L2_D_800B5F3C = D_800B4EA8;
L2_D_800B5F49 = D_800B4EB5;
L2_D_800B5F4A = D_800B4EB6;
L2_D_800B5F4B = D_800B4EB7;
L2_D_800B5F50 = D_800B4EBC;
L2_D_800B5FB4 = D_800B4F20;
L2_D_800B6010 = D_800B4F7C;
L2_D_800B6030 = D_800B4F9C;
L2_D_800B603C = D_800B4FA8;
L2_D_800B605C = D_800B4FC8;
L2_D_800B6060 = D_800B4FCC;
L2_D_800B6064 = D_800B4FD0;
L2_D_800B60C0 = D_800B502C;
L2_D_800B6104 = D_800B5070;
L2_D_800B6138 = D_800B50A4;
L2_D_800B6A94 = D_800B5890;
L2_D_800B6C78 = D_800B5A74;
L2_D_800B6C8C = D_800B5A88;
L2_D_800B6C94 = D_800B5A90;
L2_D_800B6CA8 = D_800B5AA4;
L2_D_800B6D4C = D_800B5B48;
L2_D_800B6FC4 = D_800B5DC0;
L2_D_800B6FE0 = D_800B5DDC;
L2_D_800B6FE4 = D_800B5DE0;
L2_D_800B6FFC = D_800B5DF8;
L2_D_800B70F4 = D_800B5EF0;
L2_D_800B7140 = D_800B5F3C;
L2_D_800B7160 = D_800B5F5C;
L2_D_800B7170 = D_800B5F6C;
L2_D_800B7284 = D_800B6080;
L2_D_800B7288 = D_800B6084;
L2_D_800B72A4 = D_800B60A0;
L2_D_800B72B4 = D_800B60B0;
L2_D_800B72B8 = D_800B60B4;
L2_D_800B72BC = D_800B60B8;
L2_D_800B72C0 = D_800B60BC;
L2_D_800B72C8 = D_800B60C4;
L2_D_800B7318 = D_800B6114;
L2_D_800B7324 = D_800B6120;
L2_D_800B7328 = D_800B6124;
L2_D_800B7330 = D_800B612C;
L2_D_800B7334 = D_800B6130;
L2_D_800B7338 = D_800B6134;
L2_D_800B733C = D_800B6138;
L2_D_800B7340 = D_800B613C;
L2_D_800B7344 = D_800B6140;
L2_D_800BF408 = D_800BE204;
L2_D_800BF46C = D_800BE268;
L2_D_800C625C = D_800C7ED4;
L2_D_800CD020 = D_800D1B14;
L2_D_800D5318 = D_800D9E0C;
L2_D_800D55A0 = D_800DA094;
L2_D_800D55A4 = D_800DA098;
L2_D_800D55A8 = D_800DA09C;
L2_D_800D55AC = D_800DA0A0;
L2_D_800D56BC = D_800DA1B0;
L2_D_800D56D0 = D_800DA1C4;
L2_D_800D56D4 = D_800DA1C8;
L2_D_800D56D8 = D_800DA1CC;
L2_D_800D56EC = D_800DA1E0;
L2_D_800D58E0 = D_800DA3D4;
L2_D_800D6978 = D_800DB46C;
L2_D_800D6B48 = D_800DB63C;
L2_D_800D6BB8 = D_800DB694;
L2_D_800D6D20 = D_800DB7F8;
L2_D_800D70B4 = D_800DBB8C;
L2_D_800D8500 = D_800DCFD8;
L2_D_800D869C = D_800DD174;
L2_D_800D9F14 = D_800DEADC;
L2_D_800DA12C = D_800DECF4;
L2_D_800DA410 = D_800DEFD8;
L2_D_800DA414 = D_800DEFDC;
L2_D_800DA894 = D_800DF54C;
L2_D_800DA8AC = D_800DF564;
L2_D_800DAE20 = D_800DFAD8;
L2_D_800DAE24 = D_800DFADC;
L2_D_800DB814 = D_800E040C;
L2_D_800DBA48 = D_800E05F8;
L2_D_800DBA6C = D_800E061C;
L2_D_800DBA70 = D_800E0620;
L2_D_800DBA98 = D_800E0648;
L2_D_800DBAD8 = D_800E0680;
L2_D_800DCAE0 = D_800E1688;
L2_D_800E0068 = D_800E825C;
L2_D_800E006C = D_800E8260;
L2_D_800E0070 = D_800E8264;
L2_D_800E0074 = D_800E8268;
L2_D_800E0078 = D_800E826C;
L2_D_800E007C = D_800E8270;
L2_D_800E0080 = D_800E8274;
L2_D_800E0084 = D_800E8278;
L2_D_800E0088 = D_800E827C;
L2_D_800E008C = D_800E8280;
L2_D_800E00E4 = D_800E82D8;
L2_D_800E00E8 = D_800E82DC;
L2_D_800E00EC = D_800E82E0;
L2_D_800E01B0 = D_800E83A4;
L2_D_800E01B4 = D_800E83A8;
L2_D_800E01B8 = D_800E83AC;
L2_D_800E01BC = D_800E83B0;
L2_D_800E01C4 = D_800E83B8;
L2_D_800E01C8 = D_800E83BC;
L2_D_800E01D0 = D_800E83C4;
L2_D_800E01D4 = D_800E83C8;
L2_D_800E01D8 = D_800E83CC;
L2_D_800E01DC = D_800E83D0;
L2_D_800E0228 = D_800E841C;
L2_D_800E022C = D_800E8420;
L2_D_800E0304 = D_800E84F8;
L2_D_800E0308 = D_800E84FC;
L2_D_800E030C = D_800E8500;
L2_D_800E0310 = D_800E8504;
L2_D_800E032C = D_800E8520;
L2_D_800E0410 = D_800E8604;
L2_D_800E04FC = D_800E86F0;
L2_D_800E0500 = D_800E86F4;
L2_D_800E0504 = D_800E86F8;
L2_D_800E0D10 = D_800E8F0C;
L2_D_800E1510 = D_800E970C;
L2_D_800E1514 = D_800E9710;
L2_D_800E680C = D_800EDFFC;
L2_D_800E6810 = D_800EE000;
L2_D_800F4010 = D_800FC800;
L2_D_800F430C = D_800FCA90;
L2_D_800F4458 = D_800FCBDC;
L2_D_800F44DC = D_800FCC60;
L2_func_8002680C = func_8002680C;
L2_func_80026B00 = func_80026B00;
L2_func_80026F5C = func_80026F30;
L2_func_80027274 = func_80027248;
func_800274F4 = L2_func_80027520;
func_80028888 = L2_func_800288B4;
L2_func_800288F4 = func_800288C8;
L2_func_800289D8 = func_800289AC;
func_800291D4 = L2_func_80029200;
L2_func_80029A30 = func_80029A04;
func_8002AC60 = L2_func_8002AC8C;
func_8002AF8C = L2_func_8002AFB8;
func_8002B0A4 = L2_func_8002B0D0;
func_8002B200 = L2_func_8002B22C;
L2_func_8002B464 = func_8002B438;
func_8002BCD0 = L2_func_8002BCFC;
L2_func_8002BDE0 = func_8002BDB4;
func_8002BF80 = L2_func_8002BFAC;
L2_func_8002C330 = func_8002C304;
func_8002C800 = L2_func_8002C82C;
L2_func_8002CA04 = func_8002C9D8;
L2_func_8002D39C = func_8002D370;
L2_func_8002D6AC = func_8002D680;
func_8002E284 = L2_func_8002E24C;
func_8002E2DC = L2_func_8002E2A4;
func_8002E334 = L2_func_8002E2FC;
func_8002E53C = L2_func_8002E508;
L2_func_8002E578 = func_8002E5AC;
func_8002E5CC = L2_func_8002E598;
func_8002E628 = L2_func_8002E5F4;
L2_func_8002E61C = func_8002E650;
L2_func_8002E63C = func_8002E670;
func_8002E6D0 = L2_func_8002E69C;
func_8002F248 = L2_func_8002F214;
func_8002F360 = L2_func_8002F32C;
func_8002F398 = L2_func_8002F364;
func_8002F618 = L2_func_8002F5E4;
L2_func_8002F68C = func_8002F6C0;
func_8002F6E0 = L2_func_8002F6AC;
L2_func_8002F814 = func_8002F848;
func_8002FFAC = L2_func_8002FF60;
func_800304AC = L2_func_80030454;
L2_func_80030474 = func_800304CC;
func_800304FC = L2_func_800304A4;
L2_func_80030704 = func_8003075C;
L2_func_800307C0 = func_80030818;
L2_func_800307F8 = func_80030850;
L2_func_80031F34 = func_80031F3C;
L2_func_800320B8 = func_800320C0;
L2_func_800320C8 = func_800320D0;
L2_func_800321C4 = func_800321CC;
func_800322F8 = L2_func_800322F0;
func_800324F0 = L2_func_800324E8;
L2_func_8003251C = func_80032524;
L2_func_80032684 = func_8003268C;
L2_func_80033254 = func_8003325C;
L2_func_80033568 = func_80033570;
L2_func_80035C7C = func_80035A20;
L2_func_800368C8 = func_8003666C;
L2_func_8003838C = func_80038184;
func_800391F0 = L2_func_800393F8;
func_80039258 = L2_func_800398F0;
func_800395C4 = L2_func_80039C5C;
L2_func_80039CA4 = func_8003960C;
func_80039A78 = L2_func_8003A110;
func_80039D2C = L2_func_8003A3C4;
L2_func_8003A3FC = func_80039D64;
L2_func_8003A600 = func_80039F68;
L2_func_8003AA8C = func_8003A41C;
L2_func_8003D7CC = func_8003D274;
L2_func_80041918 = func_800415E4;
L2_func_80041954 = func_80041620;
func_80041D24 = L2_func_80042058;
func_80041E94 = L2_func_800421C8;
L2_func_800426E8 = func_800423B4;
func_80042478 = L2_func_800427AC;
L2_func_80042A08 = func_800426D4;
func_80043540 = L2_func_80043874;
L2_func_80043908 = func_800435D4;
L2_func_80043AFC = func_800437C8;
func_800438E0 = L2_func_80043C14;
L2_func_80043C4C = func_80043918;
L2_func_80043E58 = func_80043B24;
func_800452F0 = L2_func_80045624;
L2_func_80045848 = func_80045514;
L2_func_80045890 = func_8004555C;
func_80045594 = L2_func_800458C8;
L2_func_80045900 = func_800455CC;
L2_func_80045910 = func_800455DC;
func_80045E1C = L2_func_80045E88;
L2_func_80046098 = func_800460CC;
func_8004670C = L2_func_800466D8;
L2_func_800481FC = func_800489CC;
func_80048CE0 = L2_func_80048510;
L2_func_8004857C = func_80048D4C;
func_80048D5C = L2_func_8004858C;
L2_func_80048B04 = func_800492DC;
L2_func_800497E4 = func_80049F64;
func_8004A400 = L2_func_80049C80;
L2_func_8004A814 = func_8004AF94;
func_8004B6B4 = L2_func_8004AF34;
func_8004B6F8 = L2_func_8004AF78;
func_8004B71C = L2_func_8004AF9C;
func_8004B750 = L2_func_8004AFD0;
func_8004B788 = L2_func_8004B008;
func_8004B798 = L2_func_8004B018;
func_8004BBEC = L2_func_8004B46C;
func_8004BC2C = L2_func_8004B4AC;
func_8004BC78 = L2_func_8004B4F8;
func_8004C3F8 = L2_func_8004BC78;
L2_func_8004BC9C = func_8004C41C;
func_8004C42C = L2_func_8004BCAC;
func_8004C43C = L2_func_8004BCBC;
func_8004C454 = L2_func_8004BCD4;
func_8004C640 = L2_func_8004BEC0;
func_8004DC0C = L2_func_8004D48C;
L2_func_8004DC58 = func_8004E3D8;
func_8004E844 = L2_func_8004E0C4;
func_8004E930 = L2_func_8004E1B0;
func_8004F00C = L2_func_8004E88C;
L2_func_8004EBA4 = func_8004F324;
func_8004F9CC = L2_func_8004F24C;
L2_func_8004F288 = func_8004FA08;
L2_func_8004F314 = func_8004FA94;
L2_func_800501B0 = func_80050930;
L2_func_80050A9C = func_8005121C;
L2_func_80050AA4 = func_80051224;
func_800514F8 = L2_func_80050D78;
func_80051BC4 = L2_func_80051444;
L2_func_800516E8 = func_80051E68;
L2_func_80054E34 = func_80055588;
L2_func_80054E54 = func_800555A8;
func_800558DC = L2_func_80055188;
func_80055DEC = L2_func_80055698;
func_80055E8C = L2_func_80055738;
func_800561F4 = L2_func_80055938;
func_800562DC = L2_func_80055A20;
L2_func_80055AB0 = func_8005636C;
func_80056548 = L2_func_80055C8C;
func_800568E8 = L2_func_800560EC;
func_80058CDC = L2_func_80058570;
L2_func_8005966C = func_80059DD8;
L2_func_800596B8 = func_80059E24;
func_80059F08 = L2_func_8005979C;
func_8005A200 = L2_func_80059A94;
func_8005A2B4 = L2_func_80059B48;
func_8005A370 = L2_func_80059C04;
func_8005A3D8 = L2_func_80059C6C;
L2_func_80059EF0 = func_8005A65C;
L2_func_8005AE6C = func_8005D548;
func_8005D58C = L2_func_8005AEB0;
L2_func_8005B608 = func_8005DCE4;
L2_func_8005BA6C = func_8005E198;
L2_func_8005C964 = func_8005F090;
L2_func_8005C994 = func_8005F0C0;
func_8005FC10 = L2_func_8005D5CC;
L2_func_8005D604 = func_8005FC48;
L2_func_8005D670 = func_8005FCB4;
L2_func_8005D6D4 = func_8005FD18;
func_80060114 = L2_func_8005DAD0;
func_800605C4 = L2_func_8005DF80;
L2_func_8005ECF4 = func_80061480;
L2_func_8005EDC8 = func_80061554;
L2_func_8005EF48 = func_80061724;
L2_func_8005F374 = func_80061B50;
L2_func_8005F74C = func_80061F28;
L2_func_8005FFF4 = func_80062820;
func_80062B9C = L2_func_80060370;
L2_func_80060594 = func_80062DC0;
L2_func_8006066C = func_80062E98;
L2_func_800606F0 = func_80062F1C;
L2_func_800606F8 = func_80062F24;
L2_func_8006087C = func_800630A8;
func_80063718 = L2_func_80060EC4;
L2_func_800617E4 = func_80064004;
L2_func_800617EC = func_8006400C;
L2_func_800619B8 = func_800641D8;
func_80064210 = L2_func_800619F0;
L2_func_80061A24 = func_80064244;
L2_func_80061CE8 = func_80064508;
func_8006463C = L2_func_80061E1C;
L2_func_800622F4 = func_80064B38;
L2_func_800637D0 = func_80066014;
func_80066298 = L2_func_80063A54;
L2_func_80063A98 = func_800662DC;
func_80066690 = L2_func_80063E4C;
L2_func_80063EFC = func_80066740;
func_80067768 = L2_func_80064F24;
L2_func_80064FB0 = func_800677F4;
func_80067A94 = L2_func_80065250;
L2_func_800660A0 = func_800688E4;
L2_func_800662C8 = func_80068B0C;
L2_func_80066304 = func_80068B48;
func_80068C40 = L2_func_800663FC;
func_8006C114 = L2_func_80069A48;
func_8006CC54 = L2_func_80069DD8;
L2_func_80069DE8 = func_8006CC64;
L2_func_80069EBC = func_8006CD3C;
L2_func_8006B2F0 = func_8006D214;
L2_func_8006BF24 = func_8006D1B0;
L2_func_8006D7A0 = func_8006D9E8;
L2_func_8006D93C = func_8006C550;
L2_func_8006D994 = func_8006C5A8;
L2_func_8006DA70 = func_8006C68C;
func_8006C6E4 = L2_func_8006DAC8;
L2_func_8006DBB0 = func_8006C7CC;
L2_func_8006DC08 = func_8006C824;
L2_func_8006DCF0 = func_8006C908;
L2_func_8006DD48 = func_8006C960;
L2_func_8006DE2C = func_8006CA48;
L2_func_8006DE84 = func_8006CAA0;
L2_func_8006E8F4 = func_8006F3FC;
L2_func_8006E97C = func_8006F46C;
L2_func_8006E9D0 = func_8006F4C0;
L2_func_80072648 = func_80073138;
L2_func_800727D4 = func_800732C4;
func_80079078 = L2_func_80078588;
func_800790C8 = L2_func_800785D8;
func_80079634 = L2_func_80078B44;
func_80079680 = L2_func_80078B90;
func_80079B30 = L2_func_80079040;
L2_func_80079060 = func_80079B50;
func_80079B5C = L2_func_8007906C;
func_8007A19C = L2_func_800796AC;
func_8007A230 = L2_func_80079740;
func_8007A274 = L2_func_80079784;
func_8007A344 = L2_func_80079854;
func_8007A678 = L2_func_80079B2C;
L2_func_8007A190 = func_8007A888;
func_8007A998 = L2_func_8007A2A0;
L2_func_8007A4D4 = func_8007ABCC;
func_8007AD70 = L2_func_8007A678;
L2_func_8007D6E0 = func_8007D740;
L2_func_8007E33C = func_8007E344;
L2_func_8007E370 = func_8007E378;
L2_func_8007F098 = func_8007F0A0;
L2_func_8007F210 = func_8007F218;
L2_func_8007F36C = func_8007F374;
L2_func_8007F520 = func_8007F528;
L2_func_8007FF68 = func_8007FF70;
L2_func_800800D4 = func_800800DC;
L2_func_80080238 = func_80080240;
L2_func_800803A8 = func_800803B0;
L2_func_80080518 = func_80080520;
L2_func_80080660 = func_80080668;
L2_func_800807A0 = func_800807A8;
L2_func_80080930 = func_80080938;
L2_func_80080AC8 = func_80080AD0;
L2_func_80080C04 = func_80080C0C;
L2_func_80080D44 = func_80080D4C;
L2_func_80080E8C = func_80080E94;
L2_func_80081390 = func_80081398;
L2_func_80083044 = func_8008304C;
L2_func_80083064 = func_8008306C;
L2_func_80083074 = func_8008307C;
L2_func_80083280 = func_80083288;
L2_func_80083494 = func_8008349C;
L2_func_800855E0 = func_800855E8;
L2_func_800855F0 = func_800855F8;
L2_func_80085600 = func_80085608;
L2_func_80085C3C = func_80085C44;
L2_func_80085D5C = func_80085D64;
L2_func_80085E4C = func_80085E54;
L2_func_80085E7C = func_80085E84;
L2_func_80085E8C = func_80085E94;
L2_func_80085EDC = func_80085EE4;
L2_func_80085F1C = func_80085F24;
L2_func_80086EA8 = func_80086EB0;
L2_func_80086FAC = func_80086FB4;
L2_func_800870CC = func_800870D4;
L2_func_80087120 = func_80087128;
L2_func_80087134 = func_8008713C;
L2_func_800873A4 = func_800873AC;
L2_func_80087574 = func_8008757C;
L2_func_80089774 = func_8008977C;
L2_func_80089AF4 = func_80089AFC;
L2_func_80089BB4 = func_80089BBC;
L2_func_80089D04 = func_80089D0C;
L2_func_80089D64 = func_80089D6C;
L2_func_80089D94 = func_80089D9C;
L2_func_8008A0C4 = func_8008A0CC;
L2_func_8008A724 = func_8008A72C;
L2_func_8008AAD0 = func_8008AAD8;
L2_func_8008C0C0 = func_8008C0C8;
L2_func_8008C48C = func_8008C494;
L2_func_8008C6CC = func_8008C6D4;
L2_func_8008C90C = func_8008C914;
L2_func_8008CBBC = func_8008CBC4;
L2_func_8008CE0C = func_8008CE14;
L2_func_8008D02C = func_8008D034;
L2_func_8008D33C = func_8008D344;
L2_func_8008D66C = func_8008D674;
L2_func_8008D92C = func_8008D934;
L2_func_8008DB6C = func_8008DB74;
L2_func_8008DCEC = func_8008DCF4;
L2_func_8008DF2C = func_8008DF34;
L2_func_8008E09C = func_8008E0A4;
L2_func_8008E28C = func_8008E294;
L2_func_8008E5CC = func_8008E5D4;
L2_func_8008E7EC = func_8008E7F4;
L2_func_8008EAFC = func_8008EB04;
L2_func_8008ECEC = func_8008ECF4;
L2_func_8008EEEC = func_8008EEF4;
L2_func_8008F21C = func_8008F224;
L2_func_8008F49C = func_8008F4A4;
L2_func_8008F74C = func_8008F754;
L2_func_8008FA5C = func_8008FA64;
L2_func_8008FADC = func_8008FAE4;
L2_func_800912A4 = func_8009121C;
D_1F8003D4 = 0x1F8003D4;
D_1F8003D8 = 0x1F8003D8;
D_1F8003DC = 0x1F8003DC;
L1_D_800AB540_b = L1_D_800AB540;
L1_D_800AB540_c = L1_D_800AB540;
L1_D_8009CE24 = L1_D_8009CE20 + 4;
