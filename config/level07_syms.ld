/* Generated by tools/port_level.py: LEVEL01 names (L1_ prefix) bound to level07's symbols. */
L1_AddPrim = func_8008E6DC;
L1_ApplyBonusCheats = func_8002DF94;
L1_ApplyMatrix = func_800913BC;
L1_ApplyMatrixLV = func_8007F6AC;
L1_ApplyMatrixSV = func_800934B0;
L1_Args_GetFlag115 = func_8002E13C;
L1_CALLOC3_OBJ_54 = func_800908A0;
func_800507A4 = L1_Camera_ResetZoom;
func_8002C240 = L1_CdBin_Disable;
func_8002C284 = L1_CdBin_Enable;
func_8002C3A0 = L1_CdBin_SetLevel;
L1_CdInit = func_8008A9A4;
L1_CdSearchFile = func_80088508;
L1_ChangeClearPAD = func_80097BD4;
L1_ChangeClearRCnt = func_80097BE4;
func_8002DC0C = L1_Cheat_CheckCodes;
L1_Cheat_DoAction = func_8002D980;
L1_Cheat_ResetCodes = func_8002E0E4;
L1_CloseEvent = func_800863D0;
L1_D_80082604 = func_8008759C;
L1_D_80095808 = D_8009A7A0;
L1_D_8009C180 = D_800A1118;
L1_D_8009C184 = D_800A111C;
L1_D_8009C1EC = D_800A1184;
L1_D_8009C1ED = D_800A1185;
L1_D_8009C1EE = D_800A1186;
L1_D_8009C1F0 = D_800A1188;
L1_D_8009C1F4 = D_800A118C;
L1_D_8009C1F8 = D_800A1190;
L1_D_8009C200 = D_800A1198;
L1_D_8009C204 = D_800A119C;
L1_D_8009C208 = D_800A11A0;
L1_D_8009C20A = D_800A11A2;
L1_D_8009C20C = D_800A11A4;
L1_D_8009CA56 = D_800A19EE;
L1_D_8009CA58 = D_800A19F0;
L1_D_8009CA59 = D_800A19F1;
L1_D_8009CA5A = D_800A19F2;
L1_D_8009CA5C = D_800A19F4;
L1_D_8009CA5E = D_800A19F6;
L1_D_8009CA60 = D_800A19F8;
L1_D_8009CA64 = D_800A19FC;
L1_D_8009CA68 = D_800A1A00;
L1_D_8009CA70 = D_800A1A08;
L1_D_8009CA74 = D_800A1A0C;
L1_D_8009CA78 = D_800A1A10;
L1_D_8009CA7C = D_800A1A14;
L1_D_8009CA80 = D_800A1A18;
L1_D_8009CA84 = D_800A1A1C;
L1_D_8009CA8C = D_800A1A24;
L1_D_8009CA90 = D_800A1A28;
L1_D_8009CA94 = D_800A1A2C;
L1_D_8009CA98 = D_800A1A30;
L1_D_8009CA9C = D_800A1A34;
L1_D_8009CAA0 = D_800A1A38;
L1_D_8009CAA4 = D_800A1A3C;
L1_D_8009CAA8 = D_800A1A40;
L1_D_8009CAAC = D_800A1A44;
L1_D_8009CABD = D_800A1A55;
L1_D_8009CABE = D_800A1A56;
L1_D_8009CABF = D_800A1A57;
L1_D_8009CAC0 = D_800A1A58;
L1_D_8009CAC4 = D_800A1A5C;
L1_D_8009CACC = D_800A1A64;
L1_D_8009CAD0 = D_800A1A68;
L1_D_8009CD00 = D_800A1C98;
L1_D_8009CD30 = D_800A1CCC;
L1_D_8009CD3C = D_800A1CD8;
L1_D_8009CD4C = D_800A1CE8;
L1_D_8009CD50 = D_800A1CEC;
L1_D_8009CD54 = D_800A1CF0;
L1_D_8009CD58 = D_800A1CF4;
L1_D_8009CD5C = D_800A1CF8;
L1_D_8009CD5E = D_800A1CFA;
L1_D_8009CD60 = D_800A1CFC;
L1_D_8009CD62 = D_800A1CFE;
L1_D_8009CD6C = D_800A1D08;
L1_D_8009CD6E = D_800A1D0A;
L1_D_8009CD78 = D_800A1D14;
L1_D_8009CD80 = D_800A1D1C;
L1_D_8009CD88 = D_800A1D24;
L1_D_8009CD8C = D_800A1D28;
L1_D_8009CD98 = D_800A1D34;
L1_D_8009CDA0 = D_800A1D3C;
L1_D_8009CDA2 = D_800A1D3E;
L1_D_8009CDA8 = D_800A1D44;
L1_D_8009CDD0 = D_800A1D6C;
L1_D_8009CDDC = D_800A1D78;
L1_D_8009CDE4 = D_800A1D80;
L1_D_8009CDE5 = D_800A1D81;
L1_D_8009CDE6 = D_800A1D82;
L1_D_8009CDE7 = D_800A1D83;
L1_D_8009CDE8 = D_800A1D84;
L1_D_8009CDEC = D_800A1D88;
L1_D_8009CDF0 = D_800A1D8C;
L1_D_8009CE20 = D_800A1DBC;
L1_D_8009CE38 = D_800A1DD4;
L1_D_8009CEB0 = D_800A1E4C;
L1_D_8009CEE0 = D_800A1E7C;
L1_D_8009CF10 = D_800A1EAC;
L1_D_8009CF14 = D_800A1EB0;
L1_D_8009CF2C = D_800A1EC8;
L1_D_8009CF30 = D_800A1ECC;
L1_D_8009CF34 = D_800A1ED0;
L1_D_8009CF48 = D_800A1EE4;
L1_D_8009CF4C = D_800A1EE8;
L1_D_8009CF50 = D_800A1EEC;
L1_D_8009CF54 = D_800A1EF0;
L1_D_8009CF68 = D_800A1F00;
L1_D_8009CF6C = D_800A1F04;
L1_D_8009CF70 = D_800A1F08;
L1_D_8009CF74 = D_800A1F0C;
L1_D_8009CF7C = D_800A1F14;
L1_D_8009CF80 = D_800A1F18;
L1_D_8009CF8C = D_800A1F24;
L1_D_8009CF90 = D_800A1F28;
L1_D_8009CF94 = D_800A1F2C;
L1_D_8009CF98 = D_800A1F30;
L1_D_8009CF9C = D_800A1F34;
L1_D_8009CFA8 = D_800A1F40;
L1_D_8009CFB0 = D_800A1F48;
L1_D_8009CFB4 = D_800A1F4C;
L1_D_8009CFBB = D_800A1F53;
L1_D_8009CFBE = D_800A1F56;
L1_D_8009CFC0 = D_800A1F58;
L1_D_8009CFC4 = D_800A1F5C;
L1_D_8009CFC8 = D_800A1F60;
L1_D_8009CFCC = D_800A1F64;
L1_D_8009CFE4 = D_800A1F7C;
L1_D_8009CFE8 = D_800A1F80;
L1_D_8009CFEC = D_800A1F84;
L1_D_8009CFF0 = D_800A1F88;
L1_D_8009CFFC = D_800A1F94;
L1_D_8009D000 = D_800A1F98;
L1_D_8009D002 = D_800A1F9A;
L1_D_8009D00E = D_800A1FA6;
L1_D_8009D010 = D_800A1FA8;
L1_D_8009D014 = D_800A1FAC;
L1_D_8009D018 = D_800A1FB0;
L1_D_8009D01A = D_800A1FB2;
L1_D_8009D020 = D_800A1FB8;
L1_D_8009D038 = D_800A1FD0;
L1_D_8009D040 = D_800A1FD8;
L1_D_8009D084 = D_800A201C;
L1_D_8009D088 = D_800A2020;
L1_D_8009D09C = D_800A2034;
L1_D_8009D0FC = D_800A2094;
L1_D_8009D104 = D_800A209C;
L1_D_8009D106 = D_800A209E;
L1_D_8009D108 = D_800A20A0;
L1_D_8009D10A = D_800A20A2;
L1_D_8009D10C = D_800A20A4;
L1_D_8009D124 = D_800A20BC;
L1_D_8009D130 = D_800A20C8;
L1_D_8009D26C = D_800A2204;
L1_D_8009D270 = D_800A2208;
L1_D_8009D274 = D_800A220C;
L1_D_8009D280 = D_800A2218;
L1_D_8009D2A8 = D_800A2240;
L1_D_8009D2AC = D_800A2244;
L1_D_8009D2B0 = D_800A2248;
L1_D_8009D31C = D_800A23A0;
L1_D_8009D320 = D_800A2274;
L1_D_8009D35C = D_800A23D8;
L1_D_8009D368 = D_800A23E4;
L1_D_8009D36C = D_800A23E8;
L1_D_8009D374 = D_800A23F0;
L1_D_8009D384 = D_800A2400;
L1_D_8009D394 = D_800A2410;
L1_D_8009D3A4 = D_800A2420;
L1_D_8009D3A8 = D_800A2424;
L1_D_8009D3AC = D_800A2428;
L1_D_8009D3B0 = D_800A242C;
L1_D_8009D3BC = D_800A2438;
L1_D_8009D3F0 = D_800A246C;
L1_D_8009D3F4 = D_800A2470;
L1_D_8009D3F8 = D_800A2474;
L1_D_8009D3FC = D_800A2478;
L1_D_8009D444 = D_800A24C0;
L1_D_8009D5A8 = D_800A2790;
L1_D_8009D5AC = D_800A2794;
L1_D_8009D5F8 = D_800A27F8;
L1_D_8009D5FC = D_800A27FC;
L1_D_8009D660 = D_800A2860;
L1_D_8009D7A4 = D_800A29A4;
L1_D_8009D7A8 = D_800A29A8;
L1_D_8009D8B8 = D_800A2AB8;
L1_D_8009D8D4 = D_800A2AD4;
L1_D_8009D8E4 = D_800A2ADC;
L1_D_8009D8E8 = D_800A2AE0;
L1_D_8009D8F0 = D_800A2AE8;
L1_D_8009D8F4 = D_800A2AEC;
L1_D_8009D8F8 = D_800A2AF0;
L1_D_8009D8FC = D_800A2AF4;
L1_D_8009D900 = D_800A2AF8;
L1_D_8009D904 = D_800A2AFC;
L1_D_8009D90C = D_800A2B04;
L1_D_8009D910 = D_800A2B08;
L1_D_8009D914 = D_800A2B0C;
L1_D_8009D918 = D_800A2B10;
L1_D_8009D91C = D_800A2B14;
L1_D_8009D920 = D_800A2B18;
L1_D_8009D924 = D_800A2B1C;
L1_D_8009D928 = D_800A2B20;
L1_D_8009DB50 = D_800A2D34;
L1_D_8009E480 = D_800A473C;
L1_D_8009E490 = D_800A4768;
L1_D_8009E908 = D_800A4AE0;
L1_D_8009E9A8 = D_800A4C20;
L1_D_8009E9B4 = D_800A4C2C;
L1_D_8009E9B8 = D_800A4C30;
L1_D_8009E9BC = D_800A4C34;
L1_D_8009E9C0 = D_800A4C38;
L1_D_8009E9D8 = D_800A4C50;
L1_D_8009EB5C = D_800A4F60;
L1_D_8009EB7C = D_800A4F80;
L1_D_8009EB88 = D_800A4F8C;
L1_D_8009EB8C = D_800A4F90;
L1_D_8009EE0C = D_800A5210;
L1_D_8009EE3D = D_800A5241;
L1_D_8009EE8C = D_800A5290;
L1_D_8009EEC4 = D_800A52C8;
L1_D_8009EEC8 = D_800A52CC;
L1_D_8009EED0 = D_800A52D4;
L1_D_8009EED4 = D_800A52D8;
L1_D_8009EED8 = D_800A52DC;
L1_D_8009EEF0 = D_800A52F8;
L1_D_8009EEF4 = D_800A52FC;
L1_D_8009EEF8 = D_800A5300;
L1_D_8009EF1C = D_800A5324;
L1_D_8009EF94 = D_800A539C;
L1_D_8009EF98 = D_800A53A0;
L1_D_8009EF9C = D_800A53A4;
L1_D_8009EFA0 = D_800A53A8;
L1_D_8009EFA4 = D_800A53AC;
L1_D_8009EFA8 = D_800A53B0;
L1_D_8009EFC8 = D_800A53D0;
L1_D_8009F008 = D_800A5410;
L1_D_8009F00C = D_800A5414;
L1_D_8009F010 = D_800A5418;
L1_D_8009F012 = D_800A541A;
L1_D_8009F013 = D_800A541B;
L1_D_8009F014 = D_800A541C;
L1_D_8009F016 = D_800A541E;
L1_D_8009F018 = D_800A5420;
L1_D_8009F01C = D_800A5424;
L1_D_8009F07C = D_800A5484;
L1_D_8009F084 = D_800A548C;
L1_D_8009F090 = D_800A5498;
L1_D_8009F09C = D_800A54A4;
L1_D_8009F0BC = D_800A54C4;
L1_D_8009F0D0 = D_800A54D8;
L1_D_8009F0E4 = D_800A54EC;
L1_D_8009F0E6 = D_800A54EE;
L1_D_8009F10C = D_800A5514;
L1_D_8009F114 = D_800A551C;
L1_D_8009F118 = D_800A5520;
L1_D_8009F11C = D_800A5524;
L1_D_8009F120 = D_800A5528;
L1_D_8009F124 = D_800A552C;
L1_D_8009F128 = D_800A5530;
L1_D_8009F12C = D_800A5534;
L1_D_8009F130 = D_800A5538;
L1_D_8009F134 = D_800A553C;
L1_D_8009F138 = D_800A5540;
L1_D_8009F13C = D_800A5544;
L1_D_8009F140 = D_800A5548;
L1_D_8009F144 = D_800A554C;
L1_D_8009F148 = D_800A5550;
L1_D_8009F14C = D_800A5554;
L1_D_8009F150 = D_800A5558;
L1_D_8009F160 = D_800A5568;
L1_D_8009F170 = D_800A5578;
L1_D_8009F178 = D_800A5580;
L1_D_8009F17C = D_800A5584;
L1_D_8009F18C = D_800A5594;
L1_D_8009F190 = D_800A5598;
L1_D_8009F194 = D_800A559C;
L1_D_8009F198 = D_800A55A0;
L1_D_8009F1B0 = D_800A55B8;
L1_D_8009F230 = D_800A5638;
L1_D_8009F234 = D_800A563C;
L1_D_8009F248 = D_800A5650;
L1_D_8009F24C = D_800A5654;
L1_D_8009F250 = D_800A5658;
L1_D_8009F254 = D_800A565C;
L1_D_8009F2B8 = D_800A56C0;
L1_D_8009F2BA = D_800A56C2;
L1_D_8009F2BC = D_800A56C4;
L1_D_8009F2E8 = D_800A56F0;
L1_D_8009F2F4 = D_800A56FC;
L1_D_800A0340 = D_800A6748;
L1_D_800A0344 = D_800A674C;
L1_D_800A0348 = D_800A6750;
L1_D_800A034C = D_800A6754;
L1_D_800A0350 = D_800A6758;
L1_D_800A0370 = D_800A6778;
L1_D_800A4370 = D_800AA778;
L1_D_800A4374 = D_800AA77C;
L1_D_800A4378 = D_800AA780;
L1_D_800A437C = D_800AA784;
L1_D_800A4380 = D_800AA788;
L1_D_800A4382 = D_800AA78A;
L1_D_800A4384 = D_800AA78C;
L1_D_800A4390 = D_800AA798;
L1_D_800A4394 = D_800AA79C;
L1_D_800A43B0 = D_800AA7B8;
L1_D_800A43C8 = D_800AA7D0;
L1_D_800A43CC = D_800AA7D4;
L1_D_800A43D0 = D_800AA7D8;
L1_D_800A43D4 = D_800AA7DC;
L1_D_800A43D8 = D_800AA7E0;
L1_D_800A43DC = D_800AA7E4;
L1_D_800A43E0 = D_800AA7E8;
L1_D_800A43E4 = D_800AA7EC;
L1_D_800A43E8 = D_800AA7F0;
L1_D_800A43EC = D_800AA7F4;
L1_D_800A43F0 = D_800AA7F8;
L1_D_800A43F4 = D_800AA7FC;
L1_D_800A43F8 = D_800AA800;
L1_D_800A43FC = D_800AA804;
L1_D_800A4400 = D_800AA808;
L1_D_800A4404 = D_800AA80C;
L1_D_800A4408 = D_800AA810;
L1_D_800A440C = D_800AA814;
L1_D_800A4410 = D_800AA818;
L1_D_800A4414 = D_800AA81C;
L1_D_800A4418 = D_800AA820;
L1_D_800A441C = D_800AA824;
L1_D_800A4420 = D_800AA828;
L1_D_800A4428 = D_800AA830;
L1_D_800A442C = D_800AA834;
L1_D_800A4430 = D_800AA838;
L1_D_800A4440 = D_800AA848;
L1_D_800A4450 = D_800AA858;
L1_D_800A4460 = D_800AA868;
L1_D_800A446C = D_800AA874;
L1_D_800A4470 = D_800AA878;
L1_D_800A4474 = D_800AA87C;
L1_D_800A4478 = D_800AA880;
L1_D_800A447C = D_800AA884;
L1_D_800A45D0 = D_800AA9D8;
L1_D_800A45D4 = D_800AA9DC;
L1_D_800A45D8 = D_800AA9E0;
L1_D_800A4EA0 = D_800AB2A8;
L1_D_800A4FD8 = D_800AB3E0;
L1_D_800A4FDC = D_800AB3E4;
L1_D_800A4FF0 = D_800AB3F8;
L1_D_800A5000 = D_800AB408;
L1_D_800A5010 = D_800AB418;
L1_D_800A56A0 = D_800ABAA8;
L1_D_800A5834 = D_800ABC3C;
L1_D_800A59D0 = D_800ABDD8;
L1_D_800A59D4 = D_800ABDDC;
L1_D_800A59D8 = D_800ABDE0;
L1_D_800A59DC = D_800ABDE4;
L1_D_800A59E0 = D_800ABDE8;
L1_D_800A5B60 = D_800ABF68;
L1_D_800A5B6C = D_800ABF74;
L1_D_800A5B90 = D_800ABF98;
L1_D_800A5BA8 = D_800ABFB0;
L1_D_800A5CB0 = D_800AC0B8;
L1_D_800A5CB4 = D_800AC0BC;
L1_D_800A5CB8 = D_800AC0C0;
L1_D_800A5CBC = D_800AC0C4;
L1_D_800A5CC0 = D_800AC0C8;
L1_D_800A5CC8 = D_800AC0D0;
L1_D_800A5CCC = D_800AC0D4;
L1_D_800A5CD0 = D_800AC0D8;
L1_D_800A5CD4 = D_800AC0DC;
L1_D_800A5CD8 = D_800AC0E0;
L1_D_800A5CDC = D_800AC0E4;
L1_D_800A5CE0 = D_800AC0E8;
L1_D_800A5CE4 = D_800AC0EC;
L1_D_800A5CE8 = D_800AC0F0;
L1_D_800A5CEC = D_800AC0F4;
L1_D_800A5CF0 = D_800AC0F8;
L1_D_800A5D00 = D_800AC108;
L1_D_800A5D04 = D_800AC10C;
L1_D_800A5D08 = D_800AC110;
L1_D_800A5D18 = D_800AC120;
L1_D_800A5D1C = D_800AC124;
L1_D_800A5D20 = D_800AC128;
L1_D_800A5D24 = D_800AC12C;
L1_D_800A5D28 = D_800AC130;
L1_D_800A5D2C = D_800AC134;
L1_D_800A5D34 = D_800AC13C;
L1_D_800A5D44 = D_800AC14C;
L1_D_800A5D48 = D_800AC150;
L1_D_800A5D4C = D_800AC154;
L1_D_800A5D7A = D_800AC182;
L1_D_800A5D7C = D_800AC184;
L1_D_800A5D80 = D_800AC188;
L1_D_800A5D98 = D_800AC1A0;
L1_D_800A5D9C = D_800AC1A4;
L1_D_800A5DA0 = D_800AC1A8;
L1_D_800A5DA4 = D_800AC1AC;
L1_D_800A5DA8 = D_800AC1B0;
L1_D_800A5DAC = D_800AC1B4;
L1_D_800A5DB0 = D_800AC1B8;
L1_D_800A5DB4 = D_800AC1BC;
L1_D_800A5DB5 = D_800AC1BD;
L1_D_800A5DBC = D_800AC1C4;
L1_D_800A5E3C = D_800AC244;
L1_D_800A5E5C = D_800AC264;
L1_D_800A5EA0 = D_800AC2A8;
L1_D_800A5EDC = D_800AC2E4;
L1_D_800A5F5C = D_800AC364;
L1_D_800A5FDC = D_800AC3E4;
L1_D_800A605C = D_800AC464;
L1_D_800A6060 = D_800AC468;
L1_D_800A6064 = D_800AC46C;
L1_D_800A6068 = D_800AC470;
L1_D_800A606C = D_800AC474;
L1_D_800A6070 = D_800AC478;
L1_D_800A6074 = D_800AC47C;
L1_D_800A6075 = D_800AC47D;
L1_D_800A6078 = D_800AC480;
L1_D_800A6090 = D_800AC498;
L1_D_800A6094 = D_800AC49C;
L1_D_800A6098 = D_800AC4A0;
L1_D_800A609C = D_800AC4A4;
L1_D_800A60A0 = D_800AC4A8;
L1_D_800A60B0 = D_800AC4B8;
L1_D_800A60D0 = D_800AC4D8;
L1_D_800A60D4 = D_800AC4DC;
L1_D_800A60E0 = D_800AC4E8;
L1_D_800A60E4 = D_800AC4EC;
L1_D_800A6104 = D_800AC50C;
L1_D_800A6110 = D_800AC518;
L1_D_800A6114 = D_800AC51C;
L1_D_800A6118 = D_800AC520;
L1_D_800A611C = D_800AC524;
L1_D_800A6120 = D_800AC528;
L1_D_800A6140 = D_800AC548;
L1_D_800A6170 = D_800AC578;
L1_D_800A6174 = D_800AC57C;
L1_D_800A6178 = D_800AC580;
L1_D_800A6180 = D_800AC588;
L1_D_800A6198 = D_800AC5A0;
L1_D_800A62A0 = D_800AC6A8;
L1_D_800A66A0 = D_800ACAA8;
L1_D_800A6EB0 = D_800AD2B8;
L1_D_800A6ED0 = D_800AD2D8;
L1_D_800A6EF8 = D_800AD300;
L1_D_800A6F00 = D_800AD308;
L1_D_800A6F1C = D_800AD324;
L1_D_800A6F34 = D_800AD33C;
L1_D_800A6F4C = D_800AD354;
L1_D_800A7048 = D_800AD450;
L1_D_800A7060 = D_800AD468;
L1_D_800A70A0 = D_800AD4A8;
L1_D_800A70C8 = D_800AD4D0;
L1_D_800A70D4 = D_800AD4DC;
L1_D_800A70F8 = D_800AD500;
L1_D_800A7190 = D_800AD598;
L1_D_800A71EC = D_800AD5F4;
L1_D_800A71F0 = D_800AD5F8;
L1_D_800A71F4 = D_800AD5FC;
L1_D_800A71F8 = D_800AD600;
L1_D_800A7214 = D_800AD61C;
L1_D_800A7260 = D_800AD668;
L1_D_800A7290 = D_800AD698;
L1_D_800A72E8 = D_800AD6F0;
L1_D_800A7300 = D_800AD708;
L1_D_800A7310 = D_800AD718;
L1_D_800A7320 = D_800AD728;
L1_D_800A7324 = D_800AD72C;
L1_D_800A7330 = D_800AD738;
L1_D_800A7344 = D_800AD74C;
L1_D_800A735C = D_800AD764;
L1_D_800A73BC = D_800AD7C4;
L1_D_800A73D8 = D_800AD7E0;
L1_D_800A7418 = D_800AD820;
L1_D_800A7424 = D_800AD82C;
L1_D_800A7474 = D_800AD87C;
L1_D_800A747C = D_800AD884;
L1_D_800A7498 = D_800AD8A0;
L1_D_800A74D4 = D_800AD8DC;
L1_D_800A74E0 = D_800AD8E8;
L1_D_800A7510 = D_800AD918;
L1_D_800A75D0 = D_800AD9D8;
L1_D_800A7678 = D_800ADA80;
L1_D_800A76A0 = D_800ADAA8;
L1_D_800A76E4 = D_800ADAEC;
L1_D_800A76F8 = D_800ADB00;
L1_D_800A770C = D_800ADB14;
L1_D_800A7714 = D_800ADB1C;
L1_D_800A7728 = D_800ADB30;
L1_D_800A773C = D_800ADB44;
L1_D_800A7750 = D_800ADB58;
L1_D_800A775C = D_800ADB64;
L1_D_800A7778 = D_800ADB80;
L1_D_800A7784 = D_800ADB8C;
L1_D_800A77B4 = D_800ADBBC;
L1_D_800A77CC = D_800ADBD4;
L1_D_800A79F0 = D_800ADDF8;
L1_D_800A7A0C = D_800ADE14;
L1_D_800A7A24 = D_800ADE2C;
L1_D_800A7A30 = D_800ADE38;
L1_D_800A7CF0 = D_800AE174;
L1_D_800A7D08 = D_800AE18C;
L1_D_800A7D20 = D_800AE1A4;
L1_D_800A7D44 = D_800AE1C8;
L1_D_800A7D64 = D_800AE1E8;
L1_D_800A7D74 = D_800AE20C;
L1_D_800A7D90 = D_800AE228;
L1_D_800A7DC0 = D_800AE258;
L1_D_800A7DE8 = D_800AE280;
L1_D_800A7DF4 = D_800AE28C;
L1_D_800A7E14 = D_800AE2AC;
L1_D_800A7E34 = D_800AE2CC;
L1_D_800A7E50 = D_800AE2E8;
L1_D_800A7E74 = D_800AE30C;
L1_D_800A7E90 = D_800AE328;
L1_D_800A7EC4 = D_800AE35C;
L1_D_800A7EFC = D_800AE394;
L1_D_800A7F1C = D_800AE3B4;
L1_D_800A7F2C = D_800AE3C4;
L1_D_800A7F5C = D_800AE3F4;
L1_D_800A7FF8 = D_800AE490;
L1_D_800A8000 = D_800AE498;
L1_D_800A80A4 = D_800AE53C;
L1_D_800A80B0 = D_800AE548;
L1_D_800A80BC = D_800AE554;
L1_D_800A80C8 = D_800AE560;
L1_D_800A811C = D_800AE5B4;
L1_D_800A81F8 = D_800AE690;
L1_D_800A8210 = D_800AE6A8;
L1_D_800A8224 = D_800AE6BC;
L1_D_800A8238 = D_800AE6D0;
L1_D_800A824C = D_800AE6E4;
L1_D_800A8260 = D_800AE6F8;
L1_D_800A8274 = D_800AE70C;
L1_D_800A8280 = D_800AE718;
L1_D_800A828C = D_800AE724;
L1_D_800A82B4 = D_800AE74C;
L1_D_800A82DC = D_800AE774;
L1_D_800A8304 = D_800AE79C;
L1_D_800A8308 = D_800AE7A0;
L1_D_800A8310 = D_800AE7A8;
L1_D_800A8318 = D_800AE7B0;
L1_D_800A8320 = D_800AE7B8;
L1_D_800A832C = D_800AE7C4;
L1_D_800A8340 = D_800AE7D8;
L1_D_800A8370 = D_800AE808;
L1_D_800A8390 = D_800AE828;
L1_D_800A83B0 = D_800AE848;
L1_D_800A83BC = D_800AE854;
L1_D_800A83C8 = D_800AE860;
L1_D_800A83D4 = D_800AE86C;
L1_D_800A83E0 = D_800AE878;
L1_D_800A83E8 = D_800AE880;
L1_D_800A83F0 = D_800AE888;
L1_D_800A8400 = D_800AE898;
L1_D_800A8410 = D_800AE8A8;
L1_D_800A8418 = D_800AE8B0;
L1_D_800A8420 = D_800AE8B8;
L1_D_800A842C = D_800AE8C4;
L1_D_800A8444 = D_800AE8DC;
L1_D_800A844C = D_800AE8E4;
L1_D_800A8458 = D_800AE8F0;
L1_D_800A8460 = D_800AE8F8;
L1_D_800A8464 = D_800AE8FC;
L1_D_800A8468 = D_800AE900;
L1_D_800A8478 = D_800AE910;
L1_D_800A8484 = D_800AE91C;
L1_D_800A8490 = D_800AE928;
L1_D_800A849C = D_800AE934;
L1_D_800A84A8 = D_800AE940;
L1_D_800A84B4 = D_800AE94C;
L1_D_800A84B8 = D_800AE950;
L1_D_800A84D0 = D_800AE968;
L1_D_800A84D8 = D_800AE970;
L1_D_800A84E4 = D_800AE97C;
L1_D_800A84F0 = D_800AE988;
L1_D_800A84FC = D_800AE994;
L1_D_800A850C = D_800AE9A4;
L1_D_800A851C = D_800AE9B4;
L1_D_800A8528 = D_800AE9C0;
L1_D_800A8534 = D_800AE9CC;
L1_D_800A8544 = D_800AE9DC;
L1_D_800A857C = D_800AEA14;
L1_D_800A85C4 = D_800AEA6C;
L1_D_800A85D4 = D_800AEA7C;
L1_D_800A85F8 = D_800AEAA0;
L1_D_800A86C0 = D_800AEB98;
L1_D_800A86CC = D_800AEBA4;
L1_D_800A8764 = D_800AEC30;
L1_D_800A87EC = D_800AECB8;
L1_D_800A87F8 = D_800AECC4;
L1_D_800A8808 = D_800AECD4;
L1_D_800A880C = D_800AECD8;
L1_D_800A8820 = D_800AECEC;
L1_D_800A8858 = D_800AED24;
L1_D_800A887C = D_800AED48;
L1_D_800A8884 = D_800AED50;
L1_D_800A8894 = D_800AED60;
L1_D_800A88A4 = D_800AED70;
L1_D_800A88D0 = D_800AED9C;
L1_D_800A89A4 = D_800AEEA0;
L1_D_800A89F0 = D_800AEEEC;
L1_D_800A8A2C = D_800AEF28;
L1_D_800A8AA8 = D_800AEFA4;
L1_D_800A8C08 = D_800AF104;
L1_D_800A8C28 = D_800AF124;
L1_D_800A8C48 = D_800AF144;
L1_D_800A8D14 = D_800AF210;
L1_D_800A8D44 = D_800AF230;
L1_D_800A8D58 = D_800AF244;
L1_D_800A8F94 = D_800AF438;
L1_D_800A8FAC = D_800AF450;
L1_D_800A9318 = D_800AF7BC;
L1_D_800A932C = D_800AF7D0;
L1_D_800A9354 = D_800AF7F8;
L1_D_800A9390 = D_800AF834;
L1_D_800A9488 = D_800AF8F0;
L1_D_800A9498 = D_800AF900;
L1_D_800A9794 = D_800AFE98;
L1_D_800A97BC = D_800AFEC0;
L1_D_800A98C8 = D_800B0018;
L1_D_800A99D0 = D_800B016C;
L1_D_800A99EC = D_800B0188;
L1_D_800A9A08 = D_800B01A4;
L1_D_800A9A60 = D_800B01FC;
L1_D_800A9A84 = D_800B0220;
L1_D_800A9AA8 = D_800B0244;
L1_D_800A9B6C = D_800B0308;
L1_D_800A9B78 = D_800B0314;
L1_D_800A9BE8 = D_800B0384;
L1_D_800A9C08 = D_800B03A4;
L1_D_800A9C78 = D_800B0414;
L1_D_800A9C8C = D_800B0428;
L1_D_800A9CA0 = D_800B043C;
L1_D_800A9CAC = D_800B0448;
L1_D_800A9CC0 = D_800B045C;
L1_D_800A9CC4 = D_800B0460;
L1_D_800A9CDC = D_800B0478;
L1_D_800A9D00 = D_800B049C;
L1_D_800A9D18 = D_800B04B4;
L1_D_800A9D30 = D_800B04CC;
L1_D_800A9D44 = D_800B04E0;
L1_D_800A9D78 = D_800B0514;
L1_D_800A9D90 = D_800B052C;
L1_D_800A9EB0 = D_800B064C;
L1_D_800A9EC8 = D_800B0664;
L1_D_800A9EE0 = D_800B067C;
L1_D_800A9F10 = D_800B06AC;
L1_D_800A9F2C = D_800B06C8;
L1_D_800A9F44 = D_800B06E0;
L1_D_800A9F60 = D_800B06FC;
L1_D_800A9F80 = D_800B071C;
L1_D_800A9F8C = D_800B0728;
L1_D_800A9F9C = D_800B0738;
L1_D_800A9FC8 = D_800B0764;
L1_D_800A9FD0 = D_800B076C;
L1_D_800AA000 = D_800B079C;
L1_D_800AA024 = D_800B07C0;
L1_D_800AA044 = D_800B07E0;
L1_D_800AA058 = D_800B07F4;
L1_D_800AA07C = D_800B0818;
L1_D_800AA09C = D_800B0838;
L1_D_800AA0B8 = D_800B0854;
L1_D_800AA0BC = D_800B0858;
L1_D_800AA0BE = D_800B085A;
L1_D_800AA0C0 = D_800B085C;
L1_D_800AA0DC = D_800B0878;
L1_D_800AA110 = D_800B08AC;
L1_D_800AA154 = D_800B08F0;
L1_D_800AA170 = D_800B090C;
L1_D_800AA1B0 = D_800B094C;
L1_D_800AA1D0 = D_800B096C;
L1_D_800AA3C0 = D_800B0B5C;
L1_D_800AA3E8 = D_800B0B84;
L1_D_800AA410 = D_800B0BAC;
L1_D_800AA438 = D_800B0BD4;
L1_D_800AA444 = D_800B0BE0;
L1_D_800AA46C = D_800B0C08;
L1_D_800AA494 = D_800B0C30;
L1_D_800AA4C0 = D_800B0C5C;
L1_D_800AA4F0 = D_800B0C8C;
L1_D_800AA518 = D_800B0CB4;
L1_D_800AA580 = D_800B0D1C;
L1_D_800AA590 = D_800B0D2C;
L1_D_800AA5A0 = D_800B0D3C;
L1_D_800AA5B4 = D_800B0D50;
L1_D_800AA70C = D_800B0EA8;
L1_D_800AA71C = D_800B0EB8;
L1_D_800AA738 = D_800B0ED4;
L1_D_800AA744 = D_800B0EE0;
L1_D_800AA760 = D_800B0EFC;
L1_D_800AA774 = D_800B0F10;
L1_D_800AA794 = D_800B0F30;
L1_D_800AA79C = D_800B0F38;
L1_D_800AA7A8 = D_800B0F44;
L1_D_800AA7B0 = D_800B0F4C;
L1_D_800AA7C0 = D_800B0F5C;
L1_D_800AA800 = D_800B0F9C;
L1_D_800AA80C = D_800B0FA8;
L1_D_800AA818 = D_800B0FB4;
L1_D_800AA830 = D_800B0FCC;
L1_D_800AA84C = D_800B0FE8;
L1_D_800AA8A0 = D_800B103C;
L1_D_800AA8C8 = D_800B1064;
L1_D_800AA8E0 = D_800B107C;
L1_D_800AA8E8 = D_800B1084;
L1_D_800AA8F0 = D_800B108C;
L1_D_800AB540 = D_800B1CE0;
L1_D_800AB5E0 = D_800B1D80;
L1_D_800AB5E4 = D_800B1D84;
L1_D_800AB5E8 = D_800B1D88;
L1_D_800AB5EC = D_800B1D8C;
L1_D_800AB5F0 = D_800B1D90;
L1_D_800AB5F4 = D_800B1D94;
L1_D_800AB5F8 = D_800B1D98;
L1_D_800AB5FC = D_800B1D9C;
L1_D_800AB600 = D_800B1DA0;
L1_D_800AB604 = D_800B1DA4;
L1_D_800AB608 = D_800B1DA8;
L1_D_800AB60C = D_800B1DAC;
L1_D_800AB610 = D_800B1DB0;
L1_D_800AB614 = D_800B1DB4;
L1_D_800AB618 = D_800B1DB8;
L1_D_800AB744 = D_800B1EE4;
L1_D_800AB754 = D_800B1EF4;
L1_D_800AC284 = D_800B2A24;
L1_D_800AC384 = D_800B2B24;
L1_D_800AC38C = D_800B2B2C;
L1_D_800AC4C8 = D_800B2C68;
L1_D_800AC4D0 = D_800B2C70;
L1_D_800AC4D8 = D_800B2C78;
L1_D_800AC4DC = D_800B2C7C;
L1_D_800AC4E0 = D_800B2C80;
L1_D_800AC4E4 = D_800B2C84;
L1_D_800AC4E8 = D_800B2C88;
L1_D_800AC4EC = D_800B2C8C;
L1_D_800AC54C = D_800B2CEC;
L1_D_800AC550 = D_800B2CF0;
L1_D_800AE940 = D_800B50E0;
L1_D_800AE9B8 = D_800B5158;
L1_D_800AE9C0 = D_800B5160;
L1_D_800AEB1A = D_800B52BA;
L1_D_800AEC38 = D_800B53D8;
L1_D_800AEDA0 = D_800B5540;
L1_D_800AEDA4 = D_800B5544;
L1_D_800AEDA8 = D_800B5548;
L1_D_800AEDAC = D_800B554C;
L1_D_800AEDB0 = D_800B5550;
L1_D_800AEDB4 = D_800B5554;
L1_D_800AEDB8 = D_800B5558;
L1_D_800AEDBC = D_800B555C;
L1_D_800AEDD4 = D_800B5574;
L1_D_800AEDD8 = D_800B5578;
L1_D_800AEDDC = D_800B557C;
L1_D_800AEDE0 = D_800B5580;
L1_D_800AEDE4 = D_800B5584;
L1_D_800AEDE8 = D_800B5588;
L1_D_800AEDEC = D_800B558C;
L1_D_800AEDF0 = D_800B5590;
L1_D_800AEE10 = D_800B55B0;
L1_D_800AEE14 = D_800B55B4;
L1_D_800AF620 = D_800B5DC0;
L1_D_800AF624 = D_800B5DC4;
L1_D_800AF6A4 = D_800B5E44;
L1_D_800AF6A5 = D_800B5E45;
L1_D_800AF6A8 = D_800B5E48;
L1_D_800AFEA8 = D_800B6648;
L1_D_800AFEAC = D_800B664C;
L1_D_800AFEB0 = D_800B6650;
L1_D_800AFEB5 = D_800B6655;
L1_D_800AFEB6 = D_800B6656;
L1_D_800AFEB7 = D_800B6657;
L1_D_800AFEB8 = D_800B6658;
L1_D_800AFEB9 = D_800B6659;
L1_D_800AFEBC = D_800B665C;
L1_D_800AFEC0 = D_800B6660;
L1_D_800AFEC8 = D_800B6668;
L1_D_800AFF2C = D_800B66CC;
L1_D_800AFF48 = D_800B66E8;
L1_D_800AFF4C = D_800B66EC;
L1_D_800AFF58 = D_800B66F8;
L1_D_800AFF64 = D_800B6704;
L1_D_800AFF68 = D_800B6708;
L1_D_800AFF70 = D_800B6710;
L1_D_800AFF78 = D_800B6718;
L1_D_800AFF80 = D_800B6720;
L1_D_800AFF84 = D_800B6724;
L1_D_800AFF88 = D_800B6728;
L1_D_800AFF8C = D_800B672C;
L1_D_800AFF94 = D_800B6734;
L1_D_800AFF98 = D_800B6738;
L1_D_800AFFA4 = D_800B6744;
L1_D_800AFFA8 = D_800B6748;
L1_D_800AFFAC = D_800B674C;
L1_D_800AFFB0 = D_800B6750;
L1_D_800AFFB4 = D_800B6754;
L1_D_800AFFC0 = D_800B6760;
L1_D_800AFFC4 = D_800B6764;
L1_D_800AFFC8 = D_800B6768;
L1_D_800AFFCC = D_800B676C;
L1_D_800B0014 = D_800B67B4;
L1_D_800B0018 = D_800B67B8;
L1_D_800B0064 = D_800B6804;
L1_D_800B0066 = D_800B6806;
L1_D_800B0070 = D_800B6810;
L1_D_800B0084 = D_800B6824;
L1_D_800B008C = D_800B682C;
L1_D_800B0094 = D_800B6834;
L1_D_800B00A0 = D_800B6840;
L1_D_800B0108 = D_800B68A8;
L1_D_800B05AC = D_800B7254;
L1_D_800B05B0 = D_800B7258;
L1_D_800B077C = D_800B7424;
L1_D_800B0794 = D_800B743C;
L1_D_800B0798 = D_800B7440;
L1_D_800B07A4 = D_800B744C;
L1_D_800B07A8 = D_800B7450;
L1_D_800B07AC = D_800B7454;
L1_D_800B07B0 = D_800B7458;
L1_D_800B07B4 = D_800B745C;
L1_D_800B07B8 = D_800B7460;
L1_D_800B07BC = D_800B7464;
L1_D_800B07C0 = D_800B7468;
L1_D_800B07C4 = D_800B746C;
L1_D_800B0804 = D_800B74AC;
L1_D_800B0808 = D_800B74B0;
L1_D_800B0848 = D_800B74F0;
L1_D_800B0868 = D_800B7510;
L1_D_800B086C = D_800B7514;
L1_D_800B087C = D_800B7524;
L1_D_800B0A94 = D_800B773C;
L1_D_800B0A98 = D_800B7740;
L1_D_800B0AA0 = D_800B7748;
L1_D_800B0AA4 = D_800B774C;
L1_D_800B0AA8 = D_800B7750;
L1_D_800B0AB4 = D_800B775C;
L1_D_800B0AB8 = D_800B7760;
L1_D_800B0AC0 = D_800B7768;
L1_D_800B0AC8 = D_800B7770;
L1_D_800B0ACC = D_800B7774;
L1_D_800B0AD0 = D_800B7778;
L1_D_800B0AD4 = D_800B777C;
L1_D_800B0AE0 = D_800B7788;
L1_D_800B0AE4 = D_800B778C;
L1_D_800B0AE8 = D_800B7790;
L1_D_800B0AEC = D_800B7794;
L1_D_800B0AFC = D_800B77A4;
L1_D_800B0B10 = D_800B77B8;
L1_D_800B0B14 = D_800B77BC;
L1_D_800B0B58 = D_800B7800;
L1_D_800B0B64 = D_800B780C;
L1_D_800B0B68 = D_800B7810;
L1_D_800B0B6A = D_800B7812;
L1_D_800B0B6C = D_800B7814;
L1_D_800B0B70 = D_800B7818;
L1_D_800B0B72 = D_800B781A;
L1_D_800B0B78 = D_800B7820;
L1_D_800B0B80 = D_800B7828;
L1_D_800B0B84 = D_800B782C;
L1_D_800B0B88 = D_800B7830;
L1_D_800B0B8C = D_800B7834;
L1_D_800B0B9C = D_800B7844;
L1_D_800B0BA0 = D_800B7848;
L1_D_800B0BB4 = D_800B785C;
L1_D_800B0BB8 = D_800B7860;
L1_D_800B0BBC = D_800B7864;
L1_D_800B0BC0 = D_800B7868;
L1_D_800B0C10 = D_800B78B8;
L1_D_800B0C30 = D_800B78D8;
L1_D_800B0C38 = D_800B78E0;
L1_D_800B0C5C = D_800B7904;
L1_D_800B0C60 = D_800B7908;
L1_D_800B0C64 = D_800B790C;
L1_D_800B0C68 = D_800B7910;
L1_D_800B0C74 = D_800B791C;
L1_D_800B0C7C = D_800B7924;
L1_D_800B0C84 = D_800B792C;
L1_D_800B0C8C = D_800B7934;
L1_D_800B0C9C = D_800B7944;
L1_D_800B0CA0 = D_800B7948;
L1_D_800B0CA4 = D_800B794C;
L1_D_800B0CA8 = D_800B7950;
L1_D_800B0CB0 = D_800B7958;
L1_D_800B0CC4 = D_800B796C;
L1_D_800B0D50 = D_800B79F8;
L1_D_800B0D94 = D_800B7A3C;
L1_D_800B0DA0 = D_800B7A48;
L1_D_800B0DA4 = D_800B7A4C;
L1_D_800B0DA8 = D_800B7A50;
L1_D_800B0DAC = D_800B7A54;
L1_D_800B0DB0 = D_800B7A58;
L1_D_800B0DB4 = D_800B7A5C;
L1_D_800B0DB8 = D_800B7A60;
L1_D_800B0DBC = D_800B7A64;
L1_D_800B0DC0 = D_800B7A68;
L1_D_800B0DC4 = D_800B7A6C;
L1_D_800B0DC8 = D_800B7A70;
L1_D_800B0DCC = D_800B7A74;
L1_D_800B0DD4 = D_800B7A7C;
L1_D_800B0DDC = D_800B7A84;
L1_D_800B0DE4 = D_800B7A8C;
L1_D_800B0E34 = D_800B7ADC;
L1_D_800B0E36 = D_800B7ADE;
L1_D_800B0E40 = D_800B7AE8;
L1_D_800B0E48 = D_800B7AF0;
L1_D_800B0E54 = D_800B7AFC;
L1_D_800B0E58 = D_800B7B00;
L1_D_800B0E5E = D_800B7B06;
L1_D_800B0E5F = D_800B7B07;
L1_D_800B0E62 = D_800B7B0A;
L1_D_800B0E63 = D_800B7B0B;
L1_D_800B0E8C = D_800B7B34;
L1_D_800B0EA0 = D_800B7B48;
L1_D_800B0EFC = D_800B7BA4;
L1_D_800B8EFC = D_800BFBA4;
L1_D_800B8F24 = D_800BFBCC;
L1_D_800B8F28 = D_800BFBD0;
L1_D_800B8F68 = D_800BFC10;
L1_D_800B8F88 = D_800BFC30;
L1_D_800B8FB0 = D_800BFC58;
L1_D_800B8FB4 = D_800BFC5C;
L1_D_800C1C54 = D_800C88FC;
L1_D_800CA8F4 = D_800D159C;
L1_D_800D28F4 = D_800D959C;
L1_D_800D2AF8 = D_800D97A0;
L1_D_800D2AFC = D_800D97A4;
L1_D_800D2BC4 = D_800D986C;
L1_D_800D2BE8 = D_800D9890;
L1_D_800D2BEC = D_800D9894;
L1_D_800D2BF0 = D_800D9898;
L1_D_800D2D30 = D_800D99D8;
L1_D_800D2E70 = D_800D9B18;
L1_D_800D2E74 = D_800D9B1C;
L1_D_800D2E84 = D_800D9B2C;
L1_D_800D2E90 = D_800D9B38;
L1_D_800D2F48 = D_800D9BF0;
L1_D_800D2F68 = D_800D9C10;
L1_D_800D2F90 = D_800D9C38;
L1_D_800D2FA4 = D_800D9C4C;
L1_D_800D2FAC = D_800D9C54;
L1_D_800D2FB0 = D_800D9C58;
L1_D_800D2FC0 = D_800D9C68;
L1_D_800D2FC4 = D_800D9C6C;
L1_D_800D2FF4 = D_800D9C9C;
L1_D_800D305C = D_800D9D04;
L1_D_800D3068 = D_800D9D10;
L1_D_800D308C = D_800D9D34;
L1_D_800D30C0 = D_800D9D68;
L1_D_800D30D4 = D_800D9D7C;
L1_D_800D30D8 = D_800D9D80;
L1_D_800D31B8 = D_800D9E60;
L1_D_800D31C0 = D_800D9E68;
L1_D_800D31D0 = D_800D9E78;
L1_D_800D3238 = D_800D9EE0;
L1_D_800D3288 = D_800D9F30;
L1_D_800D3FA8 = D_800DAC50;
L1_D_800D3FAC = D_800DAC54;
L1_D_800D3FB0 = D_800DAC58;
L1_D_800D3FD4 = D_800DAC7C;
L1_D_800D3FD8 = D_800DAC80;
L1_D_800D3FE0 = D_800DAC88;
L1_D_800D3FE4 = D_800DAC8C;
L1_D_800D3FEC = D_800DAC94;
L1_D_800D3FF0 = D_800DAC98;
L1_D_800D4050 = D_800DACF8;
L1_D_800D4058 = D_800DAD00;
L1_D_800D4068 = D_800DAD10;
L1_D_800D406C = D_800DAD14;
L1_D_800D4070 = D_800DAD18;
L1_D_800D4074 = D_800DAD1C;
L1_D_800D4080 = D_800DAD28;
L1_D_800D40D8 = D_800DAD80;
L1_D_800D40F8 = D_800DADA0;
L1_D_800D40FC = D_800DADA4;
L1_D_800D4100 = D_800DADA8;
L1_D_800D4104 = D_800DADAC;
L1_D_800D4108 = D_800DADB0;
L1_D_800D410C = D_800DADB4;
L1_D_800D4110 = D_800DADB8;
L1_D_800D4114 = D_800DADBC;
L1_D_800D424C = D_800DAEF4;
L1_D_800D4250 = D_800DAEF8;
L1_D_800D4384 = D_800DB02C;
L1_D_800D4385 = D_800DB02D;
L1_D_800D4386 = D_800DB02E;
L1_D_800D4387 = D_800DB02F;
L1_D_800D4388 = D_800DB030;
L1_D_800D4389 = D_800DB031;
L1_D_800D438A = D_800DB032;
L1_D_800D438B = D_800DB033;
L1_D_800D438C = D_800DB034;
L1_D_800D438D = D_800DB035;
L1_D_800D438E = D_800DB036;
L1_D_800D438F = D_800DB037;
L1_D_800D4390 = D_800DB038;
L1_D_800D43A8 = D_800DB050;
L1_D_800D43AC = D_800DB054;
L1_D_800D43C0 = D_800DB068;
L1_D_800D43C4 = D_800DB06C;
L1_D_800D43CC = D_800DB074;
L1_D_800D43D0 = D_800DB078;
L1_D_800D43E4 = D_800DB08C;
L1_D_800D43F0 = D_800DB098;
L1_D_800D43F4 = D_800DB09C;
L1_D_800D43F8 = D_800DB0A0;
L1_D_800D4400 = D_800DB0A8;
L1_D_800D4404 = D_800DB0AC;
L1_D_800D440C = D_800DB0B4;
L1_D_800D4410 = D_800DB0B8;
L1_D_800D4414 = D_800DB0BC;
L1_D_800D4424 = D_800DB0CC;
L1_D_800D4440 = D_800DB0E8;
L1_D_800D4444 = D_800DB0EC;
L1_D_800D4450 = D_800DB104;
L1_D_800D4454 = D_800DB108;
L1_D_800D4458 = D_800DB10C;
L1_D_800D445C = D_800DB110;
L1_D_800D4464 = D_800DB118;
L1_D_800D4468 = D_800DB11C;
L1_D_800D446C = D_800DB120;
L1_D_800D4474 = D_800DB130;
L1_D_800D4484 = D_800DB14C;
L1_D_800D4564 = D_800DB22C;
L1_D_800D45C4 = D_800DB28C;
L1_D_800D45F4 = D_800DB2BC;
L1_D_800D46D8 = D_800DB3A0;
L1_D_800D4958 = D_800DB620;
L1_D_800D4984 = D_800DB64C;
L1_D_800D5DA4 = D_800DCA6C;
L1_D_800D5ED0 = D_800DCB98;
L1_D_800D5ED8 = D_800DCBA0;
L1_D_800D5EF0 = D_800DCBB8;
L1_D_800D5F40 = D_800DCC08;
L1_D_800D74FC = D_800DE1C4;
L1_D_800D7550 = D_800DE218;
L1_D_800D7554 = D_800DE21C;
L1_D_800D7588 = D_800DE250;
L1_D_800D77B8 = D_800DE480;
L1_D_800D7930 = D_800DE5F8;
L1_D_800D7980 = D_800DE648;
L1_D_800D79D4 = D_800DE69C;
L1_D_800D7A1C = D_800DE6E4;
L1_D_800D7A20 = D_800DE6E8;
L1_D_800D7AB8 = D_800DE780;
L1_D_800D7C24 = D_800DE8EC;
L1_D_800D7CB4 = D_800DE97C;
L1_D_800D7CB8 = D_800DE980;
L1_D_800D7D08 = D_800DE9D0;
L1_D_800D7DF8 = D_800DEAC0;
L1_D_800D7DFC = D_800DEAC4;
L1_D_800D7E9C = D_800DEB64;
L1_D_800D7EEC = D_800DEBB4;
L1_D_800D7FDC = D_800DECA4;
L1_D_800D8138 = D_800DEE00;
L1_D_800D8154 = D_800DEE1C;
L1_D_800D861C = D_800DF2E4;
L1_D_800D8620 = D_800DF2E8;
L1_D_800D86C4 = D_800DF38C;
L1_D_800D86C8 = D_800DF390;
L1_D_800D86DC = D_800DF3A4;
L1_D_800D86E0 = D_800DF3A8;
L1_D_800D86E4 = D_800DF3AC;
L1_D_800D86E8 = D_800DF3B0;
L1_D_800D8BE8 = D_800DF8B0;
L1_D_800D8C7C = D_800DF944;
L1_D_800D8C90 = D_800DF958;
L1_D_800D8C94 = D_800DF95C;
L1_D_800D8E74 = D_800DFB3C;
L1_D_800D8E8C = D_800DFB54;
L1_D_800D8EA4 = D_800DFB6C;
L1_D_800D8EA8 = D_800DFB70;
L1_D_800D8EE8 = D_800DFBB0;
L1_D_800D8FE8 = D_800DFCB0;
L1_D_800D8FF8 = D_800DFCC0;
L1_D_800D90C0 = D_800DFD88;
L1_D_800D911C = D_800DFDE4;
L1_D_800D91E4 = D_800DFEAC;
L1_D_800D91E7 = D_800DFEAF;
L1_D_800D91E8 = D_800DFEB0;
L1_D_800D91F0 = D_800DFEB8;
L1_D_800D91F8 = D_800DFEC0;
L1_D_800D91FC = D_800DFEC4;
L1_D_800D9200 = D_800DFEC8;
L1_D_800D9208 = D_800DFED0;
L1_D_800D920C = D_800DFED4;
L1_D_800D9210 = D_800DFED8;
L1_D_800D9214 = D_800DFEDC;
L1_D_800D9218 = D_800DFEE0;
L1_D_800D9232 = D_800DFEFA;
L1_D_800D9268 = D_800DFF3C;
L1_D_800D9278 = D_800DFF4C;
L1_D_800DA270 = D_800E0F44;
L1_D_800DA5C0 = D_800E1294;
L1_D_800DA5C4 = D_800E1298;
L1_D_800DB884 = D_800E2558;
L1_D_800DCB44 = D_800E63D8;
L1_D_800DCB4C = D_800E63E0;
L1_D_800DD7F4 = D_800E7088;
L1_D_800DDC44 = D_800E708C;
L1_D_800DDC48 = D_800E7090;
L1_D_800DDC4C = D_800E7094;
L1_D_800DDC50 = D_800E7098;
L1_D_800DDC54 = D_800E709C;
L1_D_800DDC58 = D_800E70A0;
L1_D_800DDC5C = D_800E70A4;
L1_D_800DDC60 = D_800E70A8;
L1_D_800DDC64 = D_800E70AC;
L1_D_800DDC68 = D_800E70B0;
L1_D_800DDC6C = D_800E70B4;
L1_D_800DDCC0 = D_800E7108;
L1_D_800DDCC4 = D_800E710C;
L1_D_800DDCC8 = D_800E7110;
L1_D_800DDCCC = D_800E7114;
L1_D_800DDD8C = D_800E71D4;
L1_D_800DDD90 = D_800E71D8;
L1_D_800DDD94 = D_800E71DC;
L1_D_800DDD98 = D_800E71E0;
L1_D_800DDDA0 = D_800E71E8;
L1_D_800DDDA4 = D_800E71EC;
L1_D_800DDDA8 = D_800E71F0;
L1_D_800DDDAC = D_800E71F4;
L1_D_800DDDB0 = D_800E71F8;
L1_D_800DDDB4 = D_800E71FC;
L1_D_800DDDB8 = D_800E7200;
L1_D_800DDDBC = D_800E7204;
L1_D_800DDDCC = D_800E7214;
L1_D_800DDDDC = D_800E7224;
L1_D_800DDDEC = D_800E7234;
L1_D_800DDE04 = D_800E724C;
L1_D_800DDE08 = D_800E7250;
L1_D_800DDE10 = D_800E7258;
L1_D_800DDE30 = D_800E7278;
L1_D_800DDE34 = D_800E727C;
L1_D_800DDEE0 = D_800E7328;
L1_D_800DDEE4 = D_800E732C;
L1_D_800DDEE8 = D_800E7330;
L1_D_800DDEEC = D_800E7334;
L1_D_800DDEF0 = D_800E7338;
L1_D_800DDF08 = D_800E7350;
L1_D_800DDF24 = D_800E736C;
L1_D_800DDFEC = D_800E7434;
L1_D_800DE000 = D_800E7448;
L1_D_800DE004 = D_800E744C;
L1_D_800DE018 = D_800E7460;
L1_D_800DE0C4 = D_800E750C;
L1_D_800DE0C8 = D_800E7510;
L1_D_800DE0D4 = D_800E751C;
L1_D_800DE0D8 = D_800E7520;
L1_D_800DE0DC = D_800E7524;
L1_D_800DE0E0 = D_800E7528;
L1_D_800DE0E4 = D_800E752C;
L1_D_800DE0E8 = D_800E7530;
L1_D_800DE8E8 = D_800E7D30;
L1_D_800DF0E8 = D_800E8530;
L1_D_800DF0EC = D_800E8534;
L1_D_800DF0F0 = D_800E8538;
L1_D_800DF0F8 = D_800E8540;
L1_D_800DF10C = D_800E8554;
L1_D_800DF12C = D_800E8574;
L1_D_800DF1F4 = D_800E863C;
L1_D_800DF200 = D_800E8648;
L1_D_800DF540 = D_800E8988;
L1_D_800DF5B8 = D_800E8A00;
L1_D_800DF684 = D_800E8ACC;
L1_D_800E02B4 = D_800E96FC;
L1_D_800E23D4 = D_800ED684;
L1_D_800E23E8 = D_800ED6A0;
L1_D_800E2438 = D_800ED954;
L1_D_800E2448 = D_800ED964;
L1_D_800E2DA8 = D_800EE2C4;
L1_D_800E2DBC = D_800EE2D8;
L1_D_800E2DE0 = D_800EE2FC;
L1_D_800E2DE4 = D_800EE300;
L1_D_800E2DF4 = D_800EE310;
L1_D_800E2E44 = D_800EE360;
L1_D_800E2E48 = D_800EE364;
L1_D_800E2E4C = D_800EE368;
L1_D_800E2F2C = D_800EE448;
L1_D_800E2F38 = D_800EE454;
L1_D_800E2F3C = D_800EE458;
L1_D_800E2F54 = D_800EE470;
L1_D_800E2F58 = D_800EE474;
L1_D_800E2F5C = D_800EE478;
L1_D_800F0F5C = D_800FB478;
L1_D_800F0F80 = D_800FB49C;
L1_D_800F1180 = D_800FB8BC;
L1_D_800F11A0 = D_800FB8DC;
L1_D_800F11D0 = D_800FB90C;
L1_D_800F11F0 = D_800FB92C;
L1_D_800F128C = D_800FB9C8;
L1_D_800F1294 = D_800FB9D0;
L1_D_800F12D4 = D_800FBA10;
L1_D_800F12EC = D_800FBA28;
L1_D_800F12F4 = D_800FBA30;
L1_D_800F1314 = D_800FBA50;
L1_D_800F1354 = D_800FBA90;
L1_D_800F136C = D_800FBAA8;
L1_D_800F1374 = D_800FBAB0;
L1_D_800F138C = D_800FBAC8;
L1_D_800F1398 = D_800FBAD4;
L1_D_800F13A8 = D_800FBAE4;
L1_D_800F1DCC = D_800FC508;
L1_D_800F25D8 = D_800FCD14;
L1_D_800F2FBC = D_800FD6F8;
L1_D_800F3848 = D_800FDF84;
L1_D_800F3B48 = D_800FE284;
L1_D_800F3E98 = D_800FE5D4;
L1_D_800F40DC = D_800FE818;
L1_D_800F40E0 = D_800FE81C;
L1_D_800F40F8 = D_800FE834;
L1_D_800F40FC = D_800FE838;
L1_D_800F4114 = D_800FE850;
L1_D_800F413C = D_800FE878;
L1_D_800F415C = D_800FE898;
L1_D_800F4264 = D_800FE9A0;
L1_D_800F4268 = D_800FE9A4;
L1_D_800F426C = D_800FE9A8;
L1_D_800F4270 = D_800FE9AC;
L1_D_800F5A64 = D_801001A0;
L1_D_800F5A65 = D_801001A1;
L1_D_800F5A66 = D_801001A2;
L1_D_800F5A68 = D_801001A4;
L1_D_800F5A6C = D_801001A8;
L1_D_800F6040 = D_8010077C;
L1_D_800F6064 = D_801007A0;
L1_D_800F6068 = D_801007A4;
L1_D_800F606C = D_801007A8;
L1_D_800F6070 = D_801007AC;
L1_D_800F7664 = D_80101DA0;
L1_D_800F7E64 = D_801025A0;
L1_D_800F7EC4 = D_80102600;
L1_D_800F7EC8 = D_80102604;
L1_D_800F7EC9 = D_80102605;
L1_D_800F7ECA = D_80102606;
L1_D_800F7ECC = D_80102608;
L1_D_800F7ECE = D_8010260A;
L1_D_800F7ED0 = D_8010260C;
L1_D_800F7ED2 = D_8010260E;
L1_D_800F7EE4 = D_80102620;
L1_D_800F7EE8 = D_80102624;
L1_D_800F7EEC = D_80102628;
L1_D_800F7EF4 = D_80102630;
L1_D_800F7EF8 = D_80102634;
L1_D_800F7EFC = D_80102638;
L1_D_800F7F00 = D_8010263C;
L1_D_800F7F04 = D_80102640;
L1_D_800F7F08 = D_80102644;
L1_D_800F7F10 = D_8010264C;
L1_D_800F7F1C = D_80102658;
L1_D_800F7F64 = D_801026A0;
L1_D_800F7F68 = D_801026A4;
L1_D_800F7F6C = D_801026A8;
L1_D_800F7F70 = D_801026AC;
L1_D_800F7F74 = D_801026B0;
L1_D_800F7F81 = D_801026BD;
L1_D_800F7F84 = D_801026C0;
L1_D_800F7FCC = D_80102708;
L1_D_800F8014 = D_80102750;
L1_D_800F81F4 = D_80102930;
L1_D_800F81F8 = D_80102934;
L1_D_800F8204 = D_80102940;
L1_D_800F8208 = D_80102944;
L1_D_800F8214 = D_80102950;
L1_D_800F8614 = D_80102D50;
L1_D_800FC614 = D_80106D50;
L1_D_800FC616 = D_80106D52;
L1_D_800FC624 = D_80106D60;
L1_D_800FC628 = D_80106D64;
L1_D_800FC62C = D_80106D68;
L1_D_800FC630 = D_80106D6C;
L1_D_800FC640 = D_80106D7C;
L1_D_800FC644 = D_80106D80;
L1_D_800FC648 = D_80106D84;
L1_D_800FC650 = D_80106D8C;
L1_D_800FC654 = D_80106D90;
L1_D_800FC658 = D_80106D94;
L1_D_800FC65C = D_80106D98;
L1_D_800FC660 = D_80106D9C;
L1_D_800FC664 = D_80106DA0;
L1_D_800FC670 = D_80106DAC;
L1_D_800FC67C = D_80106DB8;
L1_D_800FC6A0 = D_80106DDC;
L1_D_800FC6B0 = D_80106DEC;
L1_D_800FC6C0 = D_80106DFC;
L1_D_800FC780 = D_80106EBC;
L1_D_800FC784 = D_80106EC0;
L1_D_800FC788 = D_80106EC4;
L1_D_800FC790 = D_80106ECC;
L1_D_800FC794 = D_80106ED0;
L1_D_800FCF94 = D_801076D0;
L1_D_800FCF98 = D_801076D4;
L1_D_800FCF9C = D_801076D8;
L1_D_800FCFA0 = D_801076DC;
L1_D_800FCFA4 = D_801076E0;
L1_D_800FCFA8 = D_801076E4;
L1_D_800FCFAC = D_801076E8;
L1_D_800FCFB0 = D_801076EC;
L1_D_800FCFB4 = D_801076F0;
L1_D_800FD038 = D_80107774;
L1_D_800FD0B8 = D_801077F4;
L1_D_800FD0F8 = D_80107834;
L1_D_800FD138 = D_80107874;
L1_D_800FD178 = D_801078B4;
L1_D_800FD17C = D_801078B8;
L1_D_800FD190 = D_801078CC;
L1_D_800FD191 = D_801078CD;
L1_D_800FD195 = D_801078D1;
L1_D_800FD197 = D_801078D3;
L1_D_800FD19A = D_801078D6;
L1_D_800FD19B = D_801078D7;
L1_D_800FD19F = D_801078DB;
L1_D_800FD1A1 = D_801078DD;
L1_D_800FD1A2 = D_801078DE;
L1_D_800FD1A4 = D_801078E0;
L1_D_800FD1A6 = D_801078E0 + 0x2;
L1_D_800FD1A8 = D_801078E4;
L1_D_800FD1AC = D_801078E8;
L1_D_800FD1BC = D_801078F8;
L1_D_800FD1C0 = D_801078FC;
L1_D_800FD1C4 = D_80107900;
L1_D_800FD1C8 = D_80107904;
L1_D_800FD208 = D_80107944;
L1_D_800FD248 = D_80107984;
L1_D_800FD24C = D_80107988;
L1_D_800FD254 = D_80107990;
L1_D_800FD258 = D_80107994;
L1_D_800FD25C = D_80107998;
L1_D_800FD260 = D_8010799C;
L1_D_800FD264 = D_801079A0;
L1_D_800FD266 = D_801079A2;
L1_D_800FD268 = D_801079A4;
L1_D_800FD26A = D_801079A6;
L1_D_800FD26C = D_801079A8;
L1_D_800FD3E4 = D_80107B20;
L1_D_800FD3E8 = D_80107B24;
L1_D_800FD400 = D_80107B3C;
L1_D_800FD440 = D_80107B7C;
L1_D_800FD442 = D_80107B7E;
L1_D_800FD444 = D_80107B80;
L1_D_800FD446 = D_80107B82;
L1_D_800FD448 = D_80107B84;
L1_D_800FD44A = D_80107B86;
L1_D_800FD44C = D_80107B88;
L1_D_800FD44E = D_80107B8A;
L1_D_800FD450 = D_80107B8C;
L1_D_800FD452 = D_80107B8E;
L1_D_800FD454 = D_80107B90;
L1_D_800FD456 = D_80107B92;
L1_D_800FD458 = D_80107B94;
L1_D_800FD45A = D_80107B96;
L1_D_800FD45D = D_80107B99;
L1_D_800FD45E = D_80107B9A;
L1_D_800FD460 = D_80107B9C;
L1_D_800FD462 = D_80107B9E;
L1_D_800FD464 = D_80107BA0;
L1_D_800FD466 = D_80107BA2;
L1_D_800FD46A = D_80107BA6;
L1_D_800FD46C = D_80107BA8;
L1_D_800FD46E = D_80107BAA;
L1_D_800FD470 = D_80107BAC;
L1_D_800FD472 = D_80107BAE;
L1_D_800FD476 = D_80107BB2;
L1_D_800FD824 = D_80107F60;
L1_D_800FD980 = D_801080BC;
L1_D_800FD984 = D_801080C0;
L1_D_800FD988 = D_801080C4;
L1_D_800FD98C = D_801080C8;
L1_D_800FD990 = D_801080CC;
L1_D_800FD994 = D_801080D0;
L1_D_800FD998 = D_801080D4;
L1_D_800FD99C = D_801080D8;
L1_D_800FD9A0 = D_801080DC;
L1_D_800FD9A4 = D_801080E0;
L1_D_800FD9AC = D_801080E8;
L1_D_800FD9C0 = D_801080FC;
L1_D_800FD9C8 = D_80108104;
L1_D_800FD9D0 = D_8010810C;
L1_D_800FD9D8 = D_80108114;
L1_D_800FD9DC = D_80108118;
L1_D_800FD9E0 = D_8010811C;
L1_D_800FD9F4 = D_80108130;
L1_D_800FDA04 = D_80108140;
L1_D_800FDA08 = D_80108144;
L1_D_800FDA0C = D_80108148;
L1_D_800FDA24 = D_80108160;
L1_D_800FDB2C = D_80108268;
L1_DebugPage_ArtProfile = func_800419E8;
func_80041CE0 = L1_DebugPage_Camera;
L1_DebugPage_ContourMask = func_80079384;
L1_DebugPage_FPWeapon = func_8007E3A4;
L1_DebugPage_Framerate = func_80041A24;
L1_DebugPage_Loadpoint = func_80031D84;
func_80041A70 = L1_DebugPage_ObjectCount;
L1_DebugPage_Profile = func_800419AC;
func_8002FD14 = L1_DebugScreen_DrawPage;
L1_DeliverEvent = func_80098BEC;
func_80032C5C = L1_DevMenu_Draw;
func_80032A04 = L1_DevMenu_HandleInput;
func_80032E24 = L1_DevMenu_Init;
L1_DisableEvent = func_8009FB98;
L1_EVENT_OBJ_11C = func_8008AAC0;
L1_EVENT_OBJ_90 = func_8008AA34;
L1_EVENT_OBJ_CC = func_8008AA70;
L1_EVENT_OBJ_F4 = func_8008AA98;
L1_EnableEvent = func_80083D20;
L1_FlushCache = func_8009FEA8;
L1_FntFlush = func_8008CB94;
L1_FntLoad = func_8008C83C;
L1_FntOpen = func_8008C8DC;
L1_FntPrint = func_8008CEB0;
L1_GPU_cw = func_800935D0;
L1_GS_001_OBJ_1F8 = func_8008990C;
L1_GS_001_OBJ_74 = func_80089788;
L1_GS_107_OBJ_4B8 = func_8007BA90;
L1_GS_107_OBJ_51C = func_8007BAF4;
L1_GetClut = func_80086C4C;
L1_GetTPage = func_80086CCC;
func_8002F730 = L1_Gfx_Init;
L1_GsClearOt = func_8008E01C;
L1_GsDefDispBuff = func_8008F2FC;
L1_GsGetActiveBuff = func_80089C84;
L1_GsGetHeadpUnit = func_80093308;
L1_GsGetLs = func_8007F1AC;
L1_GsGetLsUnit = func_80091A74;
L1_GsGetLwUnit = func_80091D44;
L1_GsGetTimInfo = func_80090E9C;
L1_GsInit3D = func_8008F27C;
L1_GsInitGraph = func_80089714;
L1_GsInitGraph2 = func_800898A4;
L1_GsInitVcount = func_8008AB84;
L1_GsLinkAnim = func_80092F9C;
L1_GsLinkObject4 = func_8008ABC4;
L1_GsMapCoordUnit = func_800925A4;
L1_GsMapModelingData = func_800907DC;
L1_GsMapUnit = func_80092624;
L1_GsScanAnim = func_80092EF4;
L1_GsScanUnit = func_80093150;
L1_GsSetAmbient = func_80093480;
L1_GsSetDrawBuffClip = func_80097F44;
L1_GsSetDrawBuffOffset = func_80089C94;
L1_GsSetFlatLight = func_8007B5D8;
L1_GsSetRefView2 = func_80089E64;
L1_GsSortClear = func_80089B2C;
L1_GsSortObject4 = func_800804C8;
L1_GsSortOt = func_8008C73C;
L1_GsSortUnit = func_800918A0;
L1_GsSwapDispBuff = func_8008E07C;
L1_GsTMDdivF3NL = func_8008F8EC;
L1_GsTMDdivG3NL = func_8008FADC;
L1_GsTMDdivNF3 = func_8008EE8C;
L1_GsTMDdivNG3 = func_8008F07C;
L1_GsTMDdivTF3L = func_8008FCDC;
L1_GsTMDdivTF3LFG = func_8008E12C;
L1_GsTMDdivTF3NL = func_8008D6FC;
L1_GsTMDdivTG3NL = func_8008D9AC;
L1_GsTMDdivTNF3 = func_8009028C;
L1_GsTMDdivTNG3 = func_8009053C;
L1_GsTMDfastF3GL = func_8008DBFC;
L1_GsTMDfastF3GLFG = func_8008F3BC;
L1_GsTMDfastF3GNL = func_8008E95C;
L1_GsTMDfastF3L = func_80081B34;
L1_GsTMDfastF3LFG = func_80081C7C;
L1_GsTMDfastF3NL = func_800819F4;
L1_GsTMDfastG3GL = func_8008DE1C;
L1_GsTMDfastG3GLFG = func_8008F5DC;
L1_GsTMDfastG3GNL = func_8008ED1C;
L1_GsTMDfastG3L = func_80081590;
L1_GsTMDfastG3LFG = func_80081720;
L1_GsTMDfastG3NL = func_80081450;
L1_GsTMDfastNF3 = func_800818B8;
L1_GsTMDfastNG3 = func_80081308;
L1_GsTMDfastTF3L = func_80081028;
L1_GsTMDfastTF3LFG = func_80081198;
L1_GsTMDfastTF3NL = func_80080EC4;
L1_GsTMDfastTG3L = func_8008015C;
L1_GsTMDfastTG3LFG = func_80080310;
L1_GsTMDfastTG3NL = func_80080000;
L1_GsTMDfastTNF3 = func_80080D58;
L1_GsTMDfastTNG3 = func_8007FE88;
L1_GsU_00000008 = func_8009E468;
L1_GsU_00000009 = func_8009E5E8;
L1_GsU_0000000c = func_8009DB28;
L1_GsU_0000000d = func_8009DCE8;
L1_GsU_0000000f = func_8009DEB8;
L1_GsU_00000209 = func_8009E778;
L1_GsU_0000020d = func_8009E098;
L1_GsU_00200009 = func_8009E918;
L1_GsU_0020000d = func_8009E288;
L1_GsU_01000000 = func_8009CB88;
L1_GsU_0100000c = func_8009C6E8;
L1_GsU_0100000d = func_8009C958;
L1_GsU_02000000 = func_8009C5A8;
L1_GsU_02000001 = func_8009C638;
L1_GsU_03000000 = D_8009CCB8;
L1_GsU_03000001 = func_8009D3F8;
L1_GsU_03000010 = func_8009D5D8;
L1_GsU_03000011 = func_8009D7C8;
L1_Gssub_make_matrix = func_800912AC;
L1_HookEntryInt = func_80097C04;
L1_INTR_DMA_OBJ_1CC = func_80097DE0;
L1_INTR_DMA_OBJ_278 = func_80097E8C;
L1_INTR_DMA_OBJ_4C = func_80097C60;
L1_INTR_VB_OBJ_58 = func_80097B0C;
L1_INTR_VB_OBJ_C4 = func_80097B78;
L1_INTR_VB_OBJ_F0 = func_80097BA4;
L1_ISO9660_OBJ_2D8 = func_800887E0;
L1_ISO9660_OBJ_2F8 = func_80088800;
L1_ISO9660_OBJ_5BC = func_80088AC4;
L1_ISO9660_OBJ_660 = func_80088B68;
L1_ISO9660_OBJ_8FC = func_80088E04;
L1_InitGeom = func_8008C6B4;
L1_InitHeap3 = func_8009077C;
L1_LoadClut = func_80090DBC;
L1_LoadClut2 = func_80090E2C;
L1_LoadTPage = func_8009A7BC;
func_800796C8 = L1_Math_Abs;
func_80079704 = L1_Math_Max;
func_800797B8 = L1_Math_Max3;
func_80079750 = L1_Math_Min3;
L1_Menu_ResetState = func_80029038;
L1_MulMatrix = func_8007F80C;
L1_MulMatrix2 = func_8007F91C;
L1_OpenEvent = func_80083E44;
L1_PADIF_OBJ_120 = func_8009A1BC;
L1_PADIF_OBJ_1CC = func_8009A268;
L1_PADIF_OBJ_290 = func_8009A32C;
L1_PADIF_OBJ_48 = func_8009A0E4;
L1_PADPORTD_OBJ_160 = func_8008B014;
L1_PADPORTD_OBJ_1C8 = func_8008B07C;
L1_PADPORTD_OBJ_2BC = func_8008B170;
L1_PADPORTD_OBJ_2CC = func_8008B180;
L1_PADPORTD_OBJ_388 = func_8008B23C;
L1_PADPORTD_OBJ_604 = func_8008B4B8;
L1_PADPORTD_OBJ_63C = func_8008B4F0;
L1_PADSEQD_OBJ_144 = func_80099040;
L1_PADSEQD_OBJ_34 = func_80098F30;
L1_PADSEQD_OBJ_488 = func_80099384;
L1_PATCHGTE_OBJ_DC = D_8009A7B8;
L1_PCcreat = func_80089C64;
L1_PClseek = func_80088E88;
L1_PCopen = func_800884E8;
L1_PCread = func_80087DB0;
L1_PadInitDirect = func_8008AEB4;
func_8004554C = L1_Pad_StickToSpeed;
func_8002F2C4 = L1_Pad_Update;
func_8004236C = L1_PauseMenu_Open;
L1_PopMatrix = func_8007BCAC;
L1_PushMatrix = func_8007BC08;
L1_ResetEntryInt = func_80097EE4;
func_80042D4C = L1_RestartPrompt_Open;
L1_ReturnFromException = func_80097ED4;
L1_RotAverage3 = func_8009B2FC;
L1_RotAverageNclip3 = func_8009B26C;
L1_RotAverageNclipColorCol3 = func_8009BC78;
L1_RotAverageNclipColorDpq3 = func_8009A90C;
L1_RotAverageNclipColorDpq3_1 = func_8009AD64;
L1_RotMatrix = func_800929D4;
L1_RotMatrixY = func_8009110C;
L1_RotMatrixYXZ = func_80092C64;
L1_RotMatrixYXZ_gte = func_800916A0;
L1_RotTrans = func_800935A0;
L1_ScaleMatrix = func_80093340;
L1_SetBackColor = func_8009EAB8;
L1_SetColorMatrix = func_8007BBD8;
L1_SetDefDispEnv = func_8008F8AC;
L1_SetDefDrawEnv = func_8008F7DC;
L1_SetDrawMode = func_80086B4C;
L1_SetDumpFnt = func_8008C7FC;
L1_SetFarColor = func_8009F1B8;
L1_SetLightMatrix = func_80093560;
L1_SetLineF4 = func_80086B2C;
L1_SetRotMatrix = func_80093510;
L1_SetTransMatrix = func_80093540;
L1_SpuClearReverbWorkArea = func_80098C1C;
L1_SpuFree = func_80098E3C;
L1_SpuGetVoiceEnvelope = func_8009EE28;
L1_SpuInitMalloc = func_8009FEC8;
L1_SpuIsTransferCompleted = func_8009BE38;
L1_SpuMalloc = func_8009C2D8;
L1_SpuRead = func_8009BDD8;
L1_SpuSetCommonAttr = func_80095498;
L1_SpuSetKey = func_8009EE78;
L1_SpuSetNoiseClock = func_8009F068;
L1_SpuSetTransferMode = func_8009BD48;
L1_SpuSetTransferStartAddr = func_8009BD78;
L1_SpuSetVoiceAttr = func_8009837C;
L1_SpuStart = func_800962F8;
L1_SquareRoot0 = func_8007BB48;
L1_SquareRoot12 = func_800914AC;
L1_SsEnd = func_8008AE04;
L1_SsPitchFromNote = func_800943C4;
L1_SsSeqCalledTbyT = func_8009897C;
L1_SsSetSerialAttr = func_80086A3C;
L1_SsSetSerialVol = func_80086890;
L1_SsSetTickMode = func_8008A564;
L1_SsUtAllKeyOff = func_8008A404;
L1_SsVabClose = func_8008AD54;
L1_SsVabOpenHead = func_80090D1C;
L1_SsVabTransBody = func_80090ACC;
L1_SsVabTransCompleted = func_80090B9C;
L1_SsVoKeyOn = func_800864E8;
L1_SysDeqIntRP = func_80099FBC;
L1_SysEnqIntRP = func_80099FCC;
L1_TestEvent = func_8009FEB8;
L1_TransposeMatrix = func_8009137C;
L1_VSYNC_OBJ_178 = func_80089034;
L1_VS_VH2_OBJ_34 = func_80090D50;
L1_VSync = func_80088EBC;
func_800793F4 = L1_Vec_Dot;
func_80079470 = L1_Vec_ProjectXZ;
func_80079518 = L1_Vec_Scale;
L1_WaitEvent = func_8009FB88;
L1__SN_read = func_80096400;
L1__SN_write = func_80097FE4;
L1__SpuInit = func_80096210;
L1__SpuSetAnyVoice = func_8009FF28;
L1__SsGetSeqData = func_800A0528;
L1__SsInit = func_800935E0;
L1__SsReadDeltaValue = func_800A1068;
L1__SsSeqGetEof = func_800A02E4;
L1__SsSeqPlay = func_800A01E8;
L1__SsSndCrescendo = func_8009F448;
L1__SsSndNextSep = func_800A0F68;
L1__SsSndPause = func_8009F878;
L1__SsSndPlay = func_8009F418;
L1__SsSndReplay = func_8009F918;
L1__SsSndTempo = func_8009F658;
L1__SsVmAlloc = func_800951E8;
L1__SsVmDoAllocate = func_80093BD0;
L1__SsVmFlush = func_80093740;
L1__SsVmInit = func_8009EAD8;
L1__SsVmKeyOffNow = func_800949C0;
L1__SsVmKeyOnNow = func_800944F0;
L1__SsVmSelectToneAndVag = func_8009F0B8;
L1__SsVmVSetUp = func_80093680;
L1__dirFailAuto = func_800992A4;
L1__gp = D_800B107C;
L1__padInitDirSeq = func_80098EFC;
L1__patch_gte = func_8009A6DC;
L1__spu_gcSPU = func_8009FBA8;
L1_bzero = func_800993BC;
L1_calloc3 = func_8009084C;
L1_chkRC2wait = func_80099FFC;
L1_exit = func_80086C6C;
L1_free3 = func_8009097C;
func_8002DD04 = L1_func_8002DD6C;
L1_func_8002E0E8 = func_8002E08C;
func_8002E154 = L1_func_8002E1B0;
func_8002E2C8 = L1_func_8002E318;
L1_func_8002E3A0 = func_8002E350;
L1_func_8002E410 = func_8002E3C0;
L1_func_8002E430 = func_8002E3E0;
L1_func_8002E48C = func_8002E43C;
L1_func_8002E4B4 = func_8002E464;
L1_func_8002E4D4 = func_8002E484;
func_8002E48C = L1_func_8002E4DC;
L1_func_8002E534 = func_8002E4E4;
L1_func_8002E5C4 = func_8002E648;
PROVIDE(L1_func_8002E798 = func_8002E824);
PROVIDE(func_8002E824 = L1_func_8002E798);
L1_func_8002F0A4 = func_8002F130;
L1_func_8002F114 = func_8002F1A0;
L1_func_8002F53C = func_8002F5C8;
func_8002F5F0 = L1_func_8002F564;
func_8002F6B0 = L1_func_8002F624;
L1_func_8002F7CC = func_8002F858;
PROVIDE(L1_func_8002FFD8 = func_80030044);
PROVIDE(func_80030044 = L1_func_8002FFD8);
func_80030184 = L1_func_80030118;
func_80030318 = L1_func_800302AC;
L1_func_80030304 = func_80030370;
L1_func_80030324 = func_80030390;
func_800303A0 = L1_func_80030334;
func_80030420 = L1_func_800303B4;
PROVIDE(L1_func_8003052C = func_80030598);
PROVIDE(func_80030598 = L1_func_8003052C);
L1_func_800305B4 = func_80030620;
L1_func_80030610 = func_8003067C;
func_800306DC = L1_func_80030670;
L1_func_800306A8 = func_80030714;
L1_func_800306F0 = func_8003075C;
func_80030804 = L1_func_80030798;
L1_func_80030868 = func_800308D4;
PROVIDE(L1_func_80030994 = func_80030A00);
PROVIDE(func_80030A00 = L1_func_80030994);
func_80030B70 = L1_func_80030B04;
func_80030D74 = L1_func_80030D08;
func_80030E0C = L1_func_80030DA0;
L1_func_80030EB0 = func_80030F1C;
func_80030F8C = L1_func_80030F20;
func_80031014 = L1_func_80030FA8;
L1_func_800310B4 = func_80031120;
L1_func_80031678 = func_80031734;
L1_func_80031B58 = func_80031C14;
L1_func_80031F18 = func_80031FD4;
func_80032130 = L1_func_80032074;
func_800322AC = L1_func_800321F0;
func_8003254C = L1_func_80032424;
func_80032594 = L1_func_8003246C;
L1_func_800324C0 = func_800325E8;
func_800325F8 = L1_func_800324D0;
L1_func_80032648 = func_80032770;
func_8003284C = L1_func_80032724;
func_80032890 = L1_func_80032768;
L1_func_80032880 = func_800329A8;
func_80032F74 = L1_func_80032E4C;
PROVIDE(L1_func_80032EFC = func_80033024);
PROVIDE(func_80033024 = L1_func_80032EFC);
func_800331B8 = L1_func_80033090;
func_800333CC = L1_func_800332A4;
func_800334F8 = L1_func_80033348;
func_80033584 = L1_func_800333D4;
func_800335D0 = L1_func_800334F4;
L1_func_80033F38 = func_80034968;
func_80035520 = L1_func_80034998;
func_80035580 = L1_func_800349F8;
func_80035BB8 = L1_func_80035030;
L1_func_800350F0 = func_80035C78;
PROVIDE(L1_func_800352B8 = func_80035E40);
PROVIDE(func_80035E40 = L1_func_800352B8);
func_800364EC = L1_func_80035964;
func_80036574 = L1_func_800359EC;
func_80036744 = L1_func_80035BBC;
func_80036970 = L1_func_80035DE8;
func_80036A8C = L1_func_80035F04;
func_80036D44 = L1_func_800361BC;
func_80036EB0 = L1_func_80036328;
func_8003713C = L1_func_800365B4;
func_800371F8 = L1_func_80036670;
L1_func_800368A8 = func_80037430;
L1_func_80036938 = func_800374C0;
func_80037980 = L1_func_80036E10;
L1_func_800373FC = func_80037F6C;
func_80038294 = L1_func_80037768;
func_80038320 = L1_func_800377F4;
func_80038428 = L1_func_800378FC;
func_80038550 = L1_func_80037A24;
func_800385F8 = L1_func_80037ACC;
L1_func_80037B6C = func_80038698;
func_80038BC0 = L1_func_800380DC;
PROVIDE(L1_func_800381CC = func_80038CB0);
PROVIDE(func_80038CB0 = L1_func_800381CC);
func_80038EE8 = L1_func_80038404;
func_80039910 = L1_func_80038984;
func_80039C0C = L1_func_80038C04;
func_80039C94 = L1_func_80038C8C;
L1_func_800390F8 = func_8003A100;
PROVIDE(L1_func_800391B0 = func_8003A1B8);
PROVIDE(func_8003A1B8 = L1_func_800391B0);
L1_func_800393AC = func_8003A3B4;
func_8003A3EC = L1_func_800393E4;
L1_func_80039520 = func_8003A528;
L1_func_800395E8 = func_8003A5F0;
func_8003A788 = L1_func_800397A8;
PROVIDE(L1_func_8003982C = func_8003A80C);
PROVIDE(func_8003A80C = L1_func_8003982C);
func_8003AA14 = L1_func_80039A34;
PROVIDE(L1_func_80039A9C = func_8003AA7C);
PROVIDE(func_8003AA7C = L1_func_80039A9C);
PROVIDE(L1_func_8003A51C = func_8003B4FC);
PROVIDE(func_8003B4FC = L1_func_8003A51C);
PROVIDE(L1_func_8003A68C = func_8003B66C);
PROVIDE(func_8003B66C = L1_func_8003A68C);
L1_func_8003A71C = func_8003B6FC;
func_8003B878 = L1_func_8003A898;
func_8003B9F4 = L1_func_8003AA14;
PROVIDE(L1_func_8003AC1C = func_8003BBFC);
PROVIDE(func_8003BBFC = L1_func_8003AC1C);
func_8003C4D4 = L1_func_8003B4F4;
PROVIDE(L1_func_8003B53C = func_8003C51C);
PROVIDE(func_8003C51C = L1_func_8003B53C);
L1_func_8003B750 = func_8003C730;
PROVIDE(L1_func_8003B808 = func_8003C7DC);
PROVIDE(func_8003C7DC = L1_func_8003B808);
func_8003C914 = L1_func_8003B940;
func_8003CC6C = L1_func_8003BC98;
func_8003CE3C = L1_func_8003BE68;
func_8003CF8C = L1_func_8003BFB8;
func_8003D190 = L1_func_8003C1BC;
func_8003D684 = L1_func_8003C6B0;
func_8003D6B8 = L1_func_8003C6E4;
func_8003D860 = L1_func_8003C88C;
func_8003D878 = L1_func_8003C8A4;
func_8003D998 = L1_func_8003C9C4;
L1_func_8003CA4C = func_8003DA20;
func_8003DA90 = L1_func_8003CABC;
L1_func_8003CC8C = func_8003DC60;
PROVIDE(L1_func_8003D76C = func_8003E6D0);
PROVIDE(func_8003E6D0 = L1_func_8003D76C);
func_8003EDBC = L1_func_8003DE58;
func_8003F0BC = L1_func_8003E158;
func_8003F3F8 = L1_func_8003E494;
PROVIDE(L1_func_8003E5A0 = func_8003F504);
PROVIDE(func_8003F504 = L1_func_8003E5A0);
func_8003F988 = L1_func_8003EA24;
func_8003FA64 = L1_func_8003EB00;
PROVIDE(L1_func_8003EC44 = func_8003FBA8);
PROVIDE(func_8003FBA8 = L1_func_8003EC44);
func_800406CC = L1_func_8003F768;
func_80040C30 = L1_func_8003FCE4;
func_80040EE8 = L1_func_8003FF9C;
L1_func_8004009C = func_80040FE8;
PROVIDE(L1_func_80040778 = func_80041528);
PROVIDE(func_80041528 = L1_func_80040778);
func_80041728 = L1_func_80040978;
func_80041858 = L1_func_80040AA8;
func_80041E0C = L1_func_8004105C;
func_80041F6C = L1_func_800411BC;
L1_func_8004133C = func_800420EC;
func_800421A4 = L1_func_800413F4;
L1_func_800414AC = func_8004225C;
L1_func_80041578 = func_80042328;
func_80042574 = L1_func_800417C4;
L1_func_800419CC = func_80042840;
func_800428AC = L1_func_80041A38;
func_80042A14 = L1_func_80041BA0;
func_80042A9C = L1_func_80041C28;
func_80042B64 = L1_func_80041CF0;
func_80042C30 = L1_func_80041DBC;
func_80042CEC = L1_func_80041E78;
func_80042E94 = L1_func_80042020;
func_80043000 = L1_func_8004218C;
PROVIDE(L1_func_800425E4 = func_80043458);
PROVIDE(func_80043458 = L1_func_800425E4);
L1_func_80042A94 = func_80043908;
L1_func_80042B28 = func_8004399C;
func_80043B90 = L1_func_80042D1C;
L1_func_80042E34 = func_80043CA8;
L1_func_80042E6C = func_80043CE0;
func_80043EEC = L1_func_80043078;
func_80044074 = L1_func_80043200;
L1_func_800433A8 = func_8004421C;
L1_func_800433F4 = func_80044268;
PROVIDE(L1_func_80043610 = func_80044484);
PROVIDE(func_80044484 = L1_func_80043610);
PROVIDE(L1_func_80043B14 = func_80044988);
PROVIDE(func_80044988 = L1_func_80043B14);
L1_func_80043EE0 = func_80044D54;
func_800456F4 = L1_func_800448F4;
L1_func_80044B3C = func_80045924;
L1_func_80044BAC = func_80045994;
L1_func_80044BBC = func_800459A4;
PROVIDE(L1_func_80044BCC = func_80045C7C);
PROVIDE(func_80045C7C = L1_func_80044BCC);
func_80046134 = L1_func_80045084;
func_8004629C = L1_func_8004514C;
func_80046494 = L1_func_80045344;
PROVIDE(L1_func_80045A28 = func_80046B78);
PROVIDE(func_80046B78 = L1_func_80045A28);
func_800473BC = L1_func_8004626C;
func_800484D4 = L1_func_80047318;
PROVIDE(L1_func_800474AC = func_80048668);
PROVIDE(func_80048668 = L1_func_800474AC);
func_80048778 = L1_func_800475BC;
L1_func_800477C0 = func_8004897C;
L1_func_8004782C = func_800489E8;
L1_func_8004783C = func_800489F8;
func_80048BC0 = L1_func_80047A04;
func_80048D0C = L1_func_80047B50;
func_80048F78 = L1_func_80047DBC;
L1_func_80047ECC = func_80049088;
func_80049598 = L1_func_800483D8;
func_800495DC = L1_func_8004841C;
PROVIDE(L1_func_80048794 = func_80049954);
PROVIDE(func_80049954 = L1_func_80048794);
func_80049D0C = L1_func_80048B4C;
func_80049FA4 = L1_func_80048DE4;
func_8004A020 = L1_func_80048E60;
L1_func_80048FE8 = func_8004A1A8;
L1_func_8004900C = func_8004A1CC;
func_8004A580 = L1_func_800493C0;
func_8004A630 = L1_func_80049470;
func_8004A8FC = L1_func_8004973C;
func_8004AAA4 = L1_func_800498E4;
func_8004AC48 = L1_func_80049A88;
L1_func_80049B7C = func_8004AD3C;
func_8004AD44 = L1_func_80049B84;
PROVIDE(L1_func_80049D60 = func_8004AF20);
PROVIDE(func_8004AF20 = L1_func_80049D60);
L1_func_8004A294 = func_8004B454;
L1_func_8004A29C = func_8004B45C;
L1_func_8004A304 = func_8004B4C4;
L1_func_8004A338 = func_8004B4F8;
L1_func_8004A370 = func_8004B530;
L1_func_8004A380 = func_8004B540;
L1_func_8004A398 = func_8004B558;
L1_func_8004A81C = func_8004B994;
L1_func_8004A85C = func_8004B9D4;
L1_func_8004A8A8 = func_8004BA20;
func_8004BA5C = L1_func_8004A8E4;
PROVIDE(L1_func_8004A9E4 = func_8004BB5C);
PROVIDE(func_8004BB5C = L1_func_8004A9E4);
func_8004C084 = L1_func_8004AF0C;
L1_func_8004B028 = func_8004C1A0;
L1_func_8004B04C = func_8004C1C4;
L1_func_8004B06C = func_8004C1E4;
L1_func_8004B084 = func_8004C1FC;
func_8004C228 = L1_func_8004B0B0;
func_8004C30C = L1_func_8004B194;
L1_func_8004B270 = func_8004C3E8;
L1_func_8004B334 = func_8004D9B0;
func_8004DA38 = L1_func_8004B3BC;
func_8004DC08 = L1_func_8004B58C;
func_8004E078 = L1_func_8004B9FC;
func_8004E17C = L1_func_8004BB00;
func_8004E2EC = L1_func_8004BC70;
func_8004E424 = L1_func_8004BDA8;
L1_func_8004BE84 = func_8004E500;
L1_func_8004BF70 = func_8004E5EC;
func_8004E828 = L1_func_8004C0C0;
PROVIDE(L1_func_8004C368 = func_8004EAD0);
PROVIDE(func_8004EAD0 = L1_func_8004C368);
func_8004EC00 = L1_func_8004C498;
L1_func_8004C50C = func_8004EC74;
func_8004ECC0 = L1_func_8004C558;
L1_func_8004C5C8 = func_8004ED30;
L1_func_8004C698 = func_8004EE00;
L1_func_8004C768 = func_8004EED0;
L1_func_8004C824 = func_8004EF8C;
func_8004EF94 = L1_func_8004C82C;
func_8004F0AC = L1_func_8004C944;
func_8004F1C4 = L1_func_8004CA5C;
func_8004F294 = L1_func_8004CB2C;
func_8004F3F0 = L1_func_8004CBF4;
func_8004F4D4 = L1_func_8004CCD8;
func_8004F510 = L1_func_8004CD14;
func_8004F59C = L1_func_8004CDA0;
L1_func_8004CE38 = func_8004F634;
func_8004F670 = L1_func_8004CE74;
func_8004F6FC = L1_func_8004CF00;
PROVIDE(L1_func_8004D048 = func_8004F844);
PROVIDE(func_8004F844 = L1_func_8004D048);
func_8004FA10 = L1_func_8004D214;
func_8004FACC = L1_func_8004D2D0;
L1_func_8004D5A8 = func_8004FDA4;
func_8004FF28 = L1_func_8004D72C;
func_8004FF6C = L1_func_8004D770;
func_80050040 = L1_func_8004D844;
func_80050088 = L1_func_8004D88C;
func_80050174 = L1_func_8004D978;
func_8005025C = L1_func_8004DA60;
func_800503C8 = L1_func_8004DBCC;
func_80050598 = L1_func_8004DD9C;
func_800507F4 = L1_func_8004DFF8;
func_80050878 = L1_func_8004E07C;
func_80050B00 = L1_func_8004E304;
func_80050B24 = L1_func_8004E328;
L1_func_8004E37C = func_80050B78;
PROVIDE(L1_func_8004E5D8 = func_80050CD0);
PROVIDE(func_80050CD0 = L1_func_8004E5D8);
L1_func_8004E78C = func_80050E84;
func_80050E8C = L1_func_8004E794;
func_80050F94 = L1_func_8004E89C;
func_80051064 = L1_func_8004E96C;
func_800510A4 = L1_func_8004E9AC;
L1_func_8004EA68 = func_80051160;
func_800511B0 = L1_func_8004EAB8;
func_80051218 = L1_func_8004EB20;
func_80051368 = L1_func_8004EC70;
func_8005163C = L1_func_8004EF44;
L1_func_8004F134 = func_8005182C;
func_80051840 = L1_func_8004F148;
func_80051A40 = L1_func_8004F348;
L1_func_8004F3D8 = func_80051AD0;
PROVIDE(L1_func_8004F3E8 = func_80051AE0);
PROVIDE(func_80051AE0 = L1_func_8004F3E8);
PROVIDE(L1_func_8004F880 = func_80051F78);
PROVIDE(func_80051F78 = L1_func_8004F880);
PROVIDE(L1_func_8004FD3C = func_80052434);
PROVIDE(func_80052434 = L1_func_8004FD3C);
func_80052878 = L1_func_80050180;
func_80052A84 = L1_func_8005038C;
PROVIDE(L1_func_800503D8 = func_80052AD0);
PROVIDE(func_80052AD0 = L1_func_800503D8);
func_80053058 = L1_func_80050960;
func_80053094 = L1_func_8005099C;
func_800530DC = L1_func_800509E4;
func_80053108 = L1_func_80050A10;
PROVIDE(L1_func_80050A70 = func_80053168);
PROVIDE(func_80053168 = L1_func_80050A70);
func_80053E20 = L1_func_80051728;
func_800549E8 = L1_func_800523E4;
func_80054C34 = L1_func_80052630;
func_80054E0C = L1_func_80052808;
func_80055130 = L1_func_80052B2C;
L1_func_80052BEC = func_800551F0;
func_80055454 = L1_func_80053004;
func_800554D0 = L1_func_80053080;
func_80055A88 = L1_func_80053684;
L1_func_800536F0 = func_80055AF4;
L1_func_80053790 = func_80055B9C;
func_80055C10 = L1_func_80053804;
func_80055D88 = L1_func_8005397C;
func_80055E38 = L1_func_80053A2C;
func_80055E88 = L1_func_80053A7C;
func_80055F70 = L1_func_80053B64;
L1_func_80053BD0 = func_80055FDC;
func_80055FEC = L1_func_80053BE0;
func_800561F0 = L1_func_80053DE4;
func_800562E4 = L1_func_80053ED8;
func_80056528 = L1_func_80054098;
func_8005655C = L1_func_800540CC;
func_800565A8 = L1_func_80054118;
func_800565FC = L1_func_8005416C;
func_800566F8 = L1_func_80054268;
func_8005679C = L1_func_8005430C;
func_8005684C = L1_func_800543BC;
L1_func_80054414 = func_800568A4;
func_80056B24 = L1_func_80054604;
func_80056BBC = L1_func_8005469C;
func_80056CE4 = L1_func_800547C4;
func_80056D5C = L1_func_8005483C;
func_80056E84 = L1_func_80054964;
func_80056FE8 = L1_func_80054AC8;
func_80057118 = L1_func_80054BF8;
func_800572C4 = L1_func_80054DA4;
func_80057358 = L1_func_80054E38;
func_80057454 = L1_func_80054F34;
func_800574FC = L1_func_80054FDC;
func_80057580 = L1_func_80055060;
func_8005768C = L1_func_8005516C;
func_80057724 = L1_func_80055204;
func_800577BC = L1_func_8005529C;
func_8005781C = L1_func_800552FC;
func_8005787C = L1_func_8005535C;
func_800578E0 = L1_func_800553C0;
func_80057A30 = L1_func_80055510;
func_80057AB8 = L1_func_80055598;
func_80057B90 = L1_func_80055670;
func_80057CE8 = L1_func_800557C8;
PROVIDE(L1_func_800557F4 = func_80057D14);
PROVIDE(func_80057D14 = L1_func_800557F4);
func_80057D34 = L1_func_80055814;
func_80058390 = L1_func_80055E24;
func_800584C4 = L1_func_80055F58;
func_800585C0 = L1_func_80056054;
func_8005867C = L1_func_80056110;
PROVIDE(L1_func_80056154 = func_800586C0);
PROVIDE(func_800586C0 = L1_func_80056154);
func_800588C4 = L1_func_80056358;
func_80058928 = L1_func_800563BC;
func_800589B0 = L1_func_80056444;
func_80058A18 = L1_func_800564AC;
func_80058AA4 = L1_func_80056538;
func_80058ADC = L1_func_80056570;
func_80058B48 = L1_func_800565DC;
func_80058B80 = L1_func_80056614;
func_80058C64 = L1_func_800566F8;
func_80058DA8 = L1_func_8005683C;
func_80058E00 = L1_func_80056894;
func_80059288 = L1_func_80056D1C;
func_800594FC = L1_func_80056F90;
func_800595E0 = L1_func_80057074;
func_80059664 = L1_func_800570F8;
func_80059700 = L1_func_80057194;
func_80059724 = L1_func_800571B8;
PROVIDE(L1_func_800572F4 = func_80059860);
PROVIDE(func_80059860 = L1_func_800572F4);
func_80059910 = L1_func_800573A4;
func_8005997C = L1_func_80057410;
func_800599A8 = L1_func_8005743C;
func_800599E8 = L1_func_8005747C;
func_80059B68 = L1_func_800575FC;
L1_func_80057648 = func_80059BB4;
PROVIDE(L1_func_80057750 = func_80059CBC);
PROVIDE(func_80059CBC = L1_func_80057750);
func_8005A01C = L1_func_80057AB0;
L1_func_80057AD8 = func_8005A044;
func_8005A098 = L1_func_80057B2C;
L1_func_80057B94 = func_8005A100;
L1_func_80057BFC = func_8005A168;
L1_func_80058694 = func_8005AC00;
func_8005ADC8 = L1_func_8005885C;
func_8005AFC4 = L1_func_80058A58;
func_8005B07C = L1_func_80058B10;
func_8005B0D8 = L1_func_80058B6C;
L1_func_80058D00 = func_8005B26C;
func_8005B2C8 = L1_func_80058D5C;
func_8005B368 = L1_func_8005AD6C;
L1_func_8005ADB0 = func_8005B3AC;
PROVIDE(L1_func_8005ADD4 = func_8005B3D0);
PROVIDE(func_8005B3D0 = L1_func_8005ADD4);
PROVIDE(L1_func_8005AEF8 = func_8005B4F4);
PROVIDE(func_8005B4F4 = L1_func_8005AEF8);
func_8005BB04 = L1_func_8005B508;
func_8005BB80 = L1_func_8005B584;
func_8005BBA8 = L1_func_8005B5AC;
func_8005BCC8 = L1_func_8005B6CC;
func_8005BD68 = L1_func_8005B76C;
func_8005BDB8 = L1_func_8005B7BC;
func_8005BE68 = L1_func_8005B86C;
func_8005BF68 = L1_func_8005B96C;
func_8005C02C = L1_func_8005BA30;
func_8005C0E4 = L1_func_8005BAE8;
func_8005C27C = L1_func_8005BC80;
func_8005C4EC = L1_func_8005BEF0;
func_8005C708 = L1_func_8005C10C;
PROVIDE(L1_func_8005C214 = func_8005C810);
PROVIDE(func_8005C810 = L1_func_8005C214);
func_8005C938 = L1_func_8005C33C;
L1_func_8005C864 = func_8005CE60;
L1_func_8005C894 = func_8005CE90;
func_8005CEC0 = L1_func_8005C8C4;
func_8005D01C = L1_func_8005CA20;
L1_func_8005CB38 = func_8005D134;
func_8005D4DC = L1_func_8005CED0;
PROVIDE(L1_func_8005CFC8 = func_8005D5D4);
PROVIDE(func_8005D5D4 = L1_func_8005CFC8);
func_8005D8BC = L1_func_8005D2B0;
L1_func_8005D58C = func_8005DB98;
func_8005DBD0 = L1_func_8005D5C4;
func_8005DC3C = L1_func_8005D630;
L1_func_8005D654 = func_8005DC60;
func_8005DCA0 = L1_func_8005D694;
func_8005DD6C = L1_func_8005D760;
L1_func_8005DA90 = func_8005E09C;
PROVIDE(L1_func_8005DB7C = func_8005E188);
PROVIDE(func_8005E188 = L1_func_8005DB7C);
func_8005E24C = L1_func_8005DC40;
L1_func_8005DF40 = func_8005E54C;
func_8005E588 = L1_func_8005DF7C;
func_8005E62C = L1_func_8005E020;
func_8005E834 = L1_func_8005E228;
PROVIDE(L1_func_8005E424 = func_8005EA30);
PROVIDE(func_8005EA30 = L1_func_8005E424);
func_8005F0E8 = L1_func_8005EADC;
func_8005F178 = L1_func_8005EB6C;
func_8005F290 = L1_func_8005EC84;
func_8005F404 = L1_func_8005EE6C;
L1_func_8005F3B0 = func_8005F940;
func_8005FE78 = L1_func_8005F93C;
func_8005FFE4 = L1_func_8005FAA8;
L1_func_80060094 = func_800605C0;
L1_func_800600EC = func_80060618;
func_80060968 = L1_func_8006043C;
L1_func_8006060C = func_80060B68;
func_80060B70 = L1_func_80060614;
func_80060CF4 = L1_func_80060798;
func_80060E40 = L1_func_800608E4;
func_8006101C = L1_func_80060AC0;
L1_func_80060E28 = func_80061380;
L1_func_80061018 = func_80061538;
PROVIDE(L1_func_80061068 = func_800615CC);
PROVIDE(func_800615CC = L1_func_80061068);
func_80061B2C = L1_func_800615C8;
L1_func_80061700 = func_80061C64;
func_80061C6C = L1_func_80061708;
L1_func_80061DC0 = func_800622A8;
func_80062390 = L1_func_80061EC4;
func_800627CC = L1_func_80062300;
L1_func_80062394 = func_80062860;
func_80062C50 = L1_func_80062784;
func_80063034 = L1_func_80062B68;
func_80063404 = L1_func_80062F38;
PROVIDE(L1_func_80062FAC = func_80063478);
PROVIDE(func_80063478 = L1_func_80062FAC);
func_800636FC = L1_func_800632AC;
func_80063800 = L1_func_800633B0;
func_80063910 = L1_func_800634C0;
func_80063B08 = L1_func_800636B8;
func_80063C00 = L1_func_800637B0;
L1_func_80063858 = func_80063CA8;
L1_func_80063ADC = func_80063F2C;
func_80063F70 = L1_func_80063B20;
func_800640FC = L1_func_80063CAC;
func_80064190 = L1_func_80063D40;
L1_func_80063ED4 = func_80064324;
L1_func_80063EF8 = func_80064348;
func_80064384 = L1_func_80063F34;
func_800643D4 = L1_func_80063F84;
func_8006457C = L1_func_8006412C;
func_800645CC = L1_func_8006417C;
func_8006466C = L1_func_8006439C;
func_800647AC = L1_func_800644DC;
func_800648EC = L1_func_8006461C;
func_80064930 = L1_func_80064660;
func_80064B1C = L1_func_8006484C;
func_80064CE0 = L1_func_80064A10;
func_80064EF8 = L1_func_80064C28;
L1_func_80064E40 = func_80065110;
func_80065384 = L1_func_80065510;
L1_func_80065588 = func_800653FC;
func_8006542C = L1_func_800655B8;
func_80065488 = L1_func_80065614;
L1_func_800658B4 = func_80065728;
func_8006579C = L1_func_80065928;
PROVIDE(L1_func_80065A20 = func_80065894);
PROVIDE(func_80065894 = L1_func_80065A20);
func_80065F0C = L1_func_80066098;
func_8006611C = L1_func_800662A8;
func_8006632C = L1_func_800664B8;
func_80066578 = L1_func_80066704;
L1_func_8006692C = func_800667A0;
L1_func_80066968 = func_800667DC;
func_80066818 = L1_func_800669A4;
L1_func_80066A60 = func_800668D4;
L1_func_80066B14 = func_80066F24;
L1_func_80067F18 = func_80069B18;
func_8006AD9C = L1_func_800689F0;
L1_func_80069318 = func_8006B85C;
L1_func_80069328 = func_8006B86C;
L1_func_800693DC = func_8006B8F0;
L1_func_8006981C = func_8006BC24;
L1_func_80069850 = func_8006BCA0;
L1_func_800698B8 = func_8006BD10;
L1_func_8006B198 = func_8006F734;
L1_func_8006B1DC = func_8006F778;
L1_func_8006B230 = func_8006F7CC;
func_8006F810 = L1_func_8006B274;
PROVIDE(L1_func_8006B2C4 = func_8006F860);
PROVIDE(func_8006F860 = L1_func_8006B2C4);
func_80070A30 = L1_func_8006C494;
func_80070E90 = L1_func_8006C8F4;
PROVIDE(L1_func_8006CB88 = func_80071124);
PROVIDE(func_80071124 = L1_func_8006CB88);
PROVIDE(L1_func_8006CEA4 = func_80071440);
PROVIDE(func_80071440 = L1_func_8006CEA4);
func_8007195C = L1_func_8006D3C0;
PROVIDE(L1_func_8006D470 = func_80071A0C);
PROVIDE(func_80071A0C = L1_func_8006D470);
func_800722BC = L1_func_8006DD20;
PROVIDE(L1_func_8006E054 = func_800725F0);
PROVIDE(func_800725F0 = L1_func_8006E054);
func_80072BBC = L1_func_8006E620;
func_80072F7C = L1_func_8006E9E0;
func_80073258 = L1_func_8006ECBC;
func_80073444 = L1_func_8006EEA8;
func_800735D0 = L1_func_8006F034;
PROVIDE(L1_func_8006F168 = func_80073704);
PROVIDE(func_80073704 = L1_func_8006F168);
func_80073C48 = L1_func_8006F6AC;
PROVIDE(L1_func_8006F784 = func_80073D20);
PROVIDE(func_80073D20 = L1_func_8006F784);
func_80073F40 = L1_func_8006F9A4;
func_80073FF0 = L1_func_8006FA54;
func_800740A0 = L1_func_8006FB04;
func_80074470 = L1_func_8006FED4;
func_8007460C = L1_func_80070070;
func_80074868 = L1_func_800702CC;
func_80074B44 = L1_func_800705A8;
func_80074C8C = L1_func_800706F0;
func_80075BD4 = L1_func_80071638;
PROVIDE(L1_func_80072190 = func_8007672C);
PROVIDE(func_8007672C = L1_func_80072190);
func_800769A8 = L1_func_8007240C;
PROVIDE(L1_func_800726D0 = func_80076C6C);
PROVIDE(func_80076C6C = L1_func_800726D0);
func_800772E4 = L1_func_80072D48;
func_800773C4 = L1_func_80072E28;
PROVIDE(L1_func_8007369C = func_80077C38);
PROVIDE(func_80077C38 = L1_func_8007369C);
func_80078984 = L1_func_800743E8;
PROVIDE(L1_func_800746D0 = func_80078C6C);
PROVIDE(func_80078C6C = L1_func_800746D0);
func_80079584 = L1_func_80074FE8;
func_8007985C = L1_func_800752C0;
PROVIDE(L1_func_800752E8 = func_80079884);
PROVIDE(func_80079884 = L1_func_800752E8);
L1_func_800753A4 = func_80079940;
L1_func_800753F0 = func_8007998C;
func_800799F8 = L1_func_8007545C;
func_80079B58 = L1_func_800755BC;
func_80079C18 = L1_func_8007567C;
func_80079D5C = L1_func_800757C0;
L1_func_800758C0 = func_80079E5C;
func_80079E8C = L1_func_800758F0;
func_80079EBC = L1_func_80075920;
func_8007A2E4 = L1_func_80075D48;
func_8007A438 = L1_func_80075E9C;
func_8007A4BC = L1_func_80075F20;
L1_func_80075FA0 = func_8007A53C;
L1_func_80075FE4 = func_8007A580;
func_8007A5B0 = L1_func_80076014;
L1_func_800760B4 = func_8007A650;
func_8007A6A0 = L1_func_80076104;
func_8007A720 = L1_func_80076184;
L1_func_80076A8C = func_8007AFE8;
L1_func_80077764 = func_8007BD58;
L1_func_800779FC = func_8007BFF0;
L1_func_80077CCC = func_8007C2C0;
L1_func_80077D50 = func_8007C344;
L1_func_80077FC4 = func_8007C5B8;
L1_func_800781B4 = func_8007C7A8;
L1_func_80078534 = func_8007CB28;
L1_func_800785A8 = func_8007CB9C;
L1_func_800787FC = func_8007CDF0;
L1_func_80078840 = func_8007CE34;
L1_func_800788E0 = func_8007CED4;
L1_func_800792B8 = func_8007DF48;
L1_func_80079390 = func_8007E020;
L1_func_800793EC = func_8007E2A4;
L1_func_800794A0 = func_8007E358;
L1_func_800794D4 = func_8007E38C;
L1_func_80079588 = func_8007E440;
L1_func_800797A8 = func_8007E660;
L1_func_8007980C = func_8007E6B0;
L1_func_800798A8 = func_8007E7A4;
L1_func_800798D4 = func_8007E7FC;
L1_func_80079B94 = func_8007EABC;
L1_func_80079C04 = func_8007EB2C;
L1_func_80079C54 = func_8007EB7C;
L1_func_80079D84 = func_8007ECD4;
L1_func_80079DB8 = func_8007ED30;
L1_func_80079E10 = func_8007ED88;
L1_func_80079F84 = func_8007EEFC;
L1_func_8007A040 = func_8007EFF0;
L1_func_8007A17C = func_8007F12C;
L1_func_8007A1B0 = func_8007F160;
L1_func_8007A4E4 = func_8007F47C;
L1_func_8007A554 = func_8007F4EC;
L1_func_8007A580 = func_8007F518;
L1_func_8007A614 = func_8007F5AC;
L1_func_8007A694 = func_8007F62C;
L1_func_8007AA94 = func_8007FA2C;
L1_func_8007AC7C = func_8007FC14;
L1_func_8007CE30 = func_80081DC8;
L1_func_8007D184 = func_8008211C;
L1_func_8007D1E8 = func_80082180;
L1_func_8007D260 = func_800821F8;
L1_func_8007D2B4 = func_8008224C;
L1_func_8007D914 = func_800828AC;
L1_func_8007DA88 = func_80082A20;
L1_func_8007DE50 = func_80082DE8;
L1_func_8007E610 = func_800835A8;
L1_func_8007E6A4 = func_8008363C;
L1_func_8007EB7C = func_80083B14;
L1_func_8007EC78 = func_80083C10;
L1_func_8007ED98 = func_80083D30;
L1_func_8007EE34 = func_80083DCC;
L1_func_8007EE64 = func_80083DFC;
L1_func_8007EEBC = func_80083E54;
L1_func_8007EECC = func_80083E64;
L1_func_8007F040 = func_80083FD8;
L1_func_8007F0D8 = func_80084070;
L1_func_8007F140 = func_800840D8;
L1_func_8007F25C = func_800841F4;
L1_func_8007F2EC = func_80084284;
L1_func_8007F34C = func_800842E4;
L1_func_8007F414 = func_800843AC;
L1_func_8007F4C0 = func_80084458;
L1_func_8007F530 = func_800844C8;
L1_func_8007F5F0 = func_80084588;
L1_func_8007FAE8 = func_80084A80;
L1_func_8007FCE0 = func_80084C78;
L1_func_8007FF50 = func_80084EE8;
L1_func_8007FF70 = func_80084F08;
L1_func_80080008 = func_80084FA0;
L1_func_800800A0 = func_80085038;
L1_func_800800BC = func_80085054;
L1_func_8008013C = func_800850D4;
L1_func_80080154 = func_800850EC;
L1_func_80080234 = func_800851CC;
L1_func_80080464 = func_800853FC;
L1_func_800806A0 = func_80085638;
L1_func_80080920 = func_800858B8;
L1_func_80080944 = func_800858DC;
L1_func_80080958 = func_800858F0;
L1_func_80080998 = func_80085930;
L1_func_800809E0 = func_80085978;
L1_func_80080A10 = func_800859A8;
L1_func_80080A34 = func_800859CC;
L1_func_80080CE4 = func_80085C7C;
L1_func_80080F44 = func_80085EDC;
L1_func_80081094 = func_8008602C;
L1_func_800811D0 = func_80086168;
L1_func_80081204 = func_8008619C;
L1_func_80081348 = func_800862E0;
L1_func_800813E8 = func_80086380;
L1_func_80081410 = func_800863A8;
L1_func_80081448 = func_800863E0;
L1_func_80081458 = func_800863F0;
L1_func_800814CC = func_80086464;
L1_func_800815A0 = func_80086538;
L1_func_80081A08 = func_800869A0;
L1_func_80081B74 = func_80086B0C;
L1_func_80081C54 = func_80086BEC;
L1_func_80081C84 = func_80086C1C;
L1_func_80081CE4 = func_80086C7C;
L1_func_80081D14 = func_80086CAC;
L1_func_80082638 = func_800875D0;
L1_func_800828AC = func_80087844;
L1_func_8008297C = func_80087914;
L1_func_80082B64 = func_80087AFC;
L1_func_80082D00 = func_80087C98;
L1_func_80082E04 = func_80087D9C;
L1_func_80082ED8 = func_80087E70;
L1_func_80082EE8 = func_80087E80;
L1_func_80082EF8 = func_80087E90;
L1_func_80082F04 = func_80087E9C;
L1_func_80082F24 = func_80087EBC;
L1_func_80082F44 = func_80087EDC;
L1_func_80082F64 = func_80087EFC;
L1_func_80082F78 = func_80087F10;
L1_func_80082F8C = func_80087F24;
L1_func_800830C8 = func_80088060;
L1_func_800831FC = func_80088194;
L1_func_80083348 = func_800882E0;
L1_func_80083368 = func_80088300;
L1_func_80083388 = func_80088320;
L1_func_800833AC = func_80088344;
L1_func_800833CC = func_80088364;
L1_func_800834D0 = func_80088468;
L1_func_80083F14 = func_80088EAC;
L1_func_80084134 = func_800890CC;
L1_func_80084164 = func_800890FC;
L1_func_80084194 = func_8008912C;
L1_func_800841C4 = func_8008915C;
L1_func_800841F8 = func_80089190;
L1_func_80084228 = func_800891C0;
L1_func_80084238 = func_800891D0;
L1_func_80084250 = func_800891E8;
L1_func_80084328 = func_800892C0;
L1_func_800844F8 = func_80089490;
L1_func_80084640 = func_800895D8;
L1_func_800846E0 = func_80089678;
L1_func_80084758 = func_800896F0;
L1_func_80084E0C = func_80089DA4;
L1_func_800855BC = func_8008A554;
L1_func_8008571C = func_8008A6B4;
L1_func_8008596C = func_8008A904;
L1_func_800859B8 = func_8008A950;
L1_func_80085B5C = func_8008AAF4;
L1_func_80085BD0 = func_8008AB68;
L1_func_800865BC = func_8008B554;
L1_func_80086688 = func_8008B620;
L1_func_80086780 = func_8008B718;
L1_func_80086854 = func_8008B7EC;
L1_func_8008688C = func_8008B824;
L1_func_800868D4 = func_8008B86C;
L1_func_80086928 = func_8008B8C0;
L1_func_80086A40 = func_8008B9D8;
L1_func_80086A6C = func_8008BA04;
L1_func_80086AD4 = func_8008BA6C;
L1_func_80086C64 = func_8008BBFC;
L1_func_80086D30 = func_8008BCC8;
L1_func_80086D74 = func_8008BD0C;
L1_func_800870A8 = func_8008C040;
L1_func_80087198 = func_8008C130;
L1_func_800873A8 = func_8008C340;
L1_func_80087620 = func_8008C5B8;
L1_func_800876B0 = func_8008C648;
L1_func_800876E4 = func_8008C67C;
L1_func_80088C44 = func_8008DBDC;
L1_func_8008A404 = func_8008F39C;
L1_func_8008A904 = func_8008F89C;
L1_func_8008C5A4 = func_8009154C;
L1_func_8008C5C4 = func_8009156C;
L1_func_8008C5D8 = func_80091580;
L1_func_8008C638 = func_800915E0;
L1_func_8008CCB8 = func_800919D0;
L1_func_8008D2EC = func_80092004;
L1_func_8008DAAC = func_800927C4;
L1_func_8008DB68 = func_80092880;
L1_func_8008DBDC = func_800928F4;
L1_func_8008E03C = func_80092FE4;
L1_func_8008E378 = func_80093320;
L1_func_8008FAE8 = func_80094A80;
L1_func_80090004 = func_80094F9C;
L1_func_80090164 = func_800950FC;
L1_func_80090880 = func_80095818;
L1_func_80090B00 = func_80095A98;
L1_func_80090CC0 = func_80095C58;
L1_func_80090D7C = func_80095D14;
L1_func_80090FFC = func_80095F94;
L1_func_80091080 = func_80096018;
L1_func_800910C4 = func_8009605C;
L1_func_80091168 = func_80096100;
L1_func_800911C0 = func_80096158;
L1_func_800911E8 = func_80096180;
L1_func_80091210 = func_800961A8;
L1_func_80091450 = func_800963E8;
L1_func_80091480 = func_80096418;
L1_func_800919DC = func_80096974;
L1_func_80091C5C = func_80096BF4;
L1_func_80091F24 = func_80096EBC;
L1_func_80092330 = func_800972C8;
L1_func_80092404 = func_8009739C;
L1_func_800924F4 = func_8009748C;
L1_func_800926D4 = func_8009766C;
L1_func_8009283C = func_800977D4;
L1_func_8009293C = func_800978D4;
L1_func_80092A34 = func_800979CC;
L1_func_80092F24 = func_80097EBC;
L1_func_80092F5C = func_80097EF4;
L1_func_8009302C = func_80097FC4;
L1_func_80093C64 = func_80098BFC;
L1_func_80093E24 = func_80098DBC;
L1_func_80093F24 = func_80098EBC;
L1_func_80093F4C = func_80098EE4;
L1_func_80094434 = func_800993CC;
L1_func_80094440 = func_800993D8;
L1_func_800944C4 = func_8009945C;
L1_func_80094734 = func_800996CC;
L1_func_8009476C = func_80099704;
L1_func_80094840 = func_800997D8;
L1_func_800948E8 = func_80099880;
L1_func_80094CE0 = func_80099C78;
L1_func_80094D48 = func_80099CE0;
L1_func_80094D64 = func_80099CFC;
L1_func_80094E2C = func_80099DC4;
L1_func_80094EC4 = func_80099E5C;
L1_func_80094F18 = func_80099EB0;
L1_func_80094F78 = func_80099F10;
L1_func_80094F98 = func_80099F30;
L1_func_80094FAC = func_80099F44;
L1_func_80094FCC = func_80099F64;
L1_func_80094FEC = func_80099F84;
L1_func_8009500C = func_80099FA4;
L1_func_80095104 = func_8009A09C;
L1_func_800957F0 = func_8009A788;
L1_func_80095914 = func_8009A8AC;
L1_func_80095934 = func_8009A8CC;
L1_func_80095954 = func_8009A8EC;
L1_func_80095A44 = func_8009A9DC;
L1_func_80095A64 = func_8009A9FC;
L1_func_80095D7C = func_8009AD14;
L1_func_80095ECC = func_8009AE64;
L1_func_80096270 = func_8009B208;
L1_func_800963C4 = func_8009B35C;
L1_func_80096738 = func_8009B6D0;
L1_func_800967BC = func_8009B754;
L1_func_80096BC0 = func_8009BB58;
L1_func_80096C54 = func_8009BBEC;
L1_func_80096C9C = func_8009BC34;
L1_func_80096F50 = func_8009BEE8;
L1_func_80099EB0 = func_8009EE48;
L1_func_8009A0A0 = func_8009F038;
L1_func_8009A1F0 = func_8009F188;
L1_func_8009A3B0 = func_8009F348;
L1_func_8009A9E0 = func_8009F978;
L1_func_8009AB60 = func_8009FAF8;
L1_func_8009B940 = func_800A08D8;
L1_func_8009BEAC = func_800A0E44;
L1_func_8009BF10 = func_800A0EA8;
L1_func_8009BFC0 = func_800A0F58;
L1_func_800AACFC = func_800B149C;
L1_func_800AAEF8 = func_800B1698;
L1_gPsi = D_800B673C;
L1_g_Args = D_800B671C;
L1_g_CamPosX = D_800B67CC;
L1_g_CamPosY = D_800B67D0;
L1_g_CamRotX = D_800B6794;
L1_g_CamTargetX = D_800B6788;
L1_g_Camera = D_800B6784;
L1_g_CheatCodeProgress = D_800B77C0;
L1_g_CheatCodes = D_800A1C54;
L1_g_CutScene = D_800A1C94;
L1_g_DebugPageNames = D_800A1DEC;
L1_g_DebugTextX = D_800A1FB4;
L1_g_DebugTextY = D_800A1FB6;
L1_g_DevMenu = D_800D9CCC;
L1_g_FrameCap = D_800B7744;
L1_g_FrameRate = D_800A1D48;
L1_g_GodMode = D_800A1CD6;
L1_g_Invincible = D_800A1A20;
L1_g_MenuUpdateFunc = D_800DB0C4;
L1_g_PadAxes = D_800B7B04;
L1_g_PadAxesPrev = D_800B7B08;
L1_g_PadHeld = D_800B7AEC;
L1_g_PadPressed = D_800B7AF4;
L1_g_PadPrev = D_800B7AF8;
L1_g_Player = D_800B77A8;
L1_g_Projection = D_800B6830;
L1_g_Weapons = D_800B6844;
L1_gteMIMefunc = func_8009142C;
L1_gte_rotate_z_matrix = func_80097FFC;
L1_jtbl_800A6F68 = jtbl_800AD370;
L1_jtbl_800A7168 = jtbl_800AD570;
L1_jtbl_800A74B0 = jtbl_800AD8B8;
L1_jtbl_800A7764 = jtbl_800ADB6C;
L1_jtbl_800A7ED8 = jtbl_800AE370;
L1_jtbl_800A8028 = jtbl_800AE4C0;
L1_jtbl_800A8088 = jtbl_800AE520;
L1_jtbl_800A859C = jtbl_800AEA44;
L1_jtbl_800A8BE8 = jtbl_800AF0E4;
L1_jtbl_800A98E4 = jtbl_800B0034;
L1_jtbl_800A9AEC = jtbl_800B0288;
L1_jtbl_800A9DF8 = jtbl_800B0594;
L1_jtbl_800AA190 = jtbl_800B092C;
L1_jtbl_800AA1F0 = jtbl_800B098C;
L1_jtbl_800AA270 = jtbl_800B0A0C;
L1_jtbl_800AA2A8 = jtbl_800B0A44;
L1_jtbl_800AA330 = jtbl_800B0ACC;
L1_jtbl_800AA540 = jtbl_800B0CDC;
L1_jtbl_800AA560 = jtbl_800B0CFC;
L1_jtbl_800AA780 = jtbl_800B0F1C;
L1_jtbl_800AA860 = jtbl_800B0FFC;
L1_jtbl_800AA880 = jtbl_800B101C;
L1_malloc3 = func_800908CC;
L1_memchr = func_80090B8C;
L1_memcpy = func_8009141C;
L1_memmove = func_80096370;
L1_memset = func_8009140C;
L1_note2pitch = func_80094310;
L1_note2pitch2 = func_8009435C;
L1_printf = func_80083E34;
L1_rand = func_80086A2C;
L1_ratan2 = func_80090F8C;
L1_rcos = func_8009F1D8;
L1_rsin = func_8009F278;
L1_setRC2wait = func_80099FDC;
L1_setjmp = func_80097BF4;
L1_sin_1 = func_8009F2B4;
L1_sprintf = func_80086D0C;
L1_start = func_8002C808;
L1_startIntrDMA = func_80097C14;
L1_startIntrVSync = func_80097AB4;
L1_strcat = func_80088E78;
L1_strcmp = func_80090BCC;
L1_strcpy = func_80086C3C;
L1_strlen = func_80086C0C;
L1_strncmp = func_80097AA4;
L1_strncpy = func_80093590;
L1_strstr = func_80090D0C;
L1_strtok = func_80090BDC;
L1_strtol = func_80090CFC;
L1_toupper = func_80086AFC;
L1_vmNoiseOff = func_80095458;
L1_vmNoiseOn = func_80093DA0;
L2_D_800A03C0 = D_800A1120;
L2_D_800A0425 = D_800A1185;
L2_D_800A0426 = D_800A1186;
L2_D_800A0438 = D_800A1198;
L2_D_800A0C92 = D_800A19F2;
L2_D_800A0CC0 = D_800A1A20;
L2_D_800A0CC4 = D_800A1A24;
L2_D_800A0CD4 = D_800A1A34;
L2_D_800A0CDC = D_800A1A3C;
L2_D_800A0CF7 = D_800A1A57;
L2_D_800A0CFC = D_800A1A5C;
L2_D_800A0EF4 = D_800A1C54;
L2_D_800A0F34 = D_800A1C94;
L2_D_800A0F68 = D_800A1CCC;
L2_D_800A0F88 = D_800A1CEC;
L2_D_800A0F8C = D_800A1CF0;
L2_D_800A0F9C = D_800A1D00;
L2_D_800A0FAB = D_800A1D0F;
L2_D_800A0FD0 = D_800A1D34;
L2_D_800A0FE0 = D_800A1D44;
L2_D_800A0FE4 = D_800A1D48;
L2_D_800A1000 = D_800A1D64;
L2_D_800A101F = D_800A1D83;
L2_D_800A106C = D_800A1DD0;
L2_D_800A1070 = D_800A1DD4;
L2_D_800A1078 = D_800A1DDC;
L2_D_800A11E8 = D_800A1F40;
L2_D_800A11F0 = D_800A1F48;
L2_D_800A11FE = D_800A1F56;
L2_D_800A1200 = D_800A1F58;
L2_D_800A1204 = D_800A1F5C;
L2_D_800A1208 = D_800A1F60;
L2_D_800A1230 = D_800A1F88;
L2_D_800A123C = D_800A1F94;
L2_D_800A1240 = D_800A1F98;
L2_D_800A1242 = D_800A1F9A;
L2_D_800A1244 = D_800A1F9C;
L2_D_800A1248 = D_800A1FA0;
L2_D_800A124C = D_800A1FA4;
L2_D_800A1250 = D_800A1FA8;
L2_D_800A1254 = D_800A1FAC;
L2_D_800A1258 = D_800A1FB0;
L2_D_800A125A = D_800A1FB2;
L2_D_800A125C = D_800A1FB4;
L2_D_800A125E = D_800A1FB6;
L2_D_800A14A4 = D_800A2200;
L2_D_800A14A8 = D_800A2204;
L2_D_800A14AC = D_800A2240;
L2_D_800A1634 = D_800A23D8;
L2_D_800A167C = D_800A2420;
L2_D_800A1680 = D_800A2424;
L2_D_800A19A0 = D_800A27E4;
L2_D_800A1A1C = D_800A2860;
L2_D_800A1C74 = D_800A2AB8;
L2_D_800A1CC4 = D_800A2B08;
L2_D_800A1EEC = D_800A2D30;
L2_D_800A3AAC = D_800A4780;
L2_D_800A3BF8 = D_800A4930;
L2_D_800A3E74 = D_800A4C3C;
L2_D_800A3E8C = D_800A4C54;
L2_D_800A40AC = D_800A4EDC;
L2_D_800AC49C = D_800AD2C8;
L2_D_800AC6FC = D_800AD528;
L2_D_800AC80C = D_800AD638;
L2_D_800AC820 = D_800AD64C;
L2_D_800ACABC = D_800AD8E8;
L2_D_800ACAEC = D_800AD918;
L2_D_800ACC9C = D_800ADAC8;
L2_D_800ACFCC = D_800ADDF8;
L2_D_800AD820 = D_800AE678;
L2_D_800ADA08 = D_800AE860;
L2_D_800ADA50 = D_800AE8A8;
L2_D_800ADA58 = D_800AE8B0;
L2_D_800ADC24 = D_800AEA8C;
L2_D_800AE308 = D_800AF174;
L2_D_800AE5A4 = D_800AF488;
L2_D_800AE968 = D_800AF84C;
L2_D_800AF064 = D_800AFDD8;
L2_D_800AF09C = D_800AFE10;
L2_D_800AF140 = D_800AFEB4;
L2_D_800AF160 = D_800AFED4;
L2_D_800AF188 = D_800AFEFC;
L2_D_800B0F58 = D_800B1CE0;
L2_D_800B1018 = D_800B1DA0;
L2_D_800B102C = D_800B1DB4;
L2_D_800B1CBC = D_800B2A24;
L2_D_800B1DC4 = D_800B2B2C;
L2_D_800B1F2C = D_800B2C78;
L2_D_800B1F30 = D_800B2C7C;
L2_D_800B1FA0 = D_800B2CEC;
L2_D_800B4E3C = D_800B5548;
L2_D_800B4E6C = D_800B5578;
L2_D_800B56B4 = D_800B5DC0;
L2_D_800B5738 = D_800B5E44;
L2_D_800B5739 = D_800B5E45;
L2_D_800B5F3C = D_800B6648;
L2_D_800B5F49 = D_800B6655;
L2_D_800B5F4A = D_800B6656;
L2_D_800B5F4B = D_800B6657;
L2_D_800B5F50 = D_800B665C;
L2_D_800B5FB4 = D_800B66C0;
L2_D_800B6010 = D_800B671C;
L2_D_800B6014 = D_800B6720;
L2_D_800B6030 = D_800B673C;
L2_D_800B6038 = D_800B6744;
L2_D_800B603C = D_800B6748;
L2_D_800B6054 = D_800B6760;
L2_D_800B6058 = D_800B6764;
L2_D_800B605C = D_800B6768;
L2_D_800B6060 = D_800B676C;
L2_D_800B6064 = D_800B6770;
L2_D_800B60C0 = D_800B67CC;
L2_D_800B6104 = D_800B6810;
L2_D_800B6120 = D_800B682C;
L2_D_800B6138 = D_800B6844;
L2_D_800B6A94 = D_800B7258;
L2_D_800B6C78 = D_800B743C;
L2_D_800B6C8C = D_800B7450;
L2_D_800B6C94 = D_800B7458;
L2_D_800B6CA8 = D_800B746C;
L2_D_800B6D4C = D_800B7510;
L2_D_800B6F80 = D_800B7744;
L2_D_800B6F88 = D_800B774C;
L2_D_800B6F8C = D_800B7750;
L2_D_800B6FC4 = D_800B7788;
L2_D_800B6FE0 = D_800B77A4;
L2_D_800B6FE4 = D_800B77A8;
L2_D_800B6FFC = D_800B77C0;
L2_D_800B7084 = D_800B7848;
L2_D_800B70F4 = D_800B78B8;
L2_D_800B7114 = D_800B78D8;
L2_D_800B7140 = D_800B7904;
L2_D_800B7160 = D_800B7924;
L2_D_800B7170 = D_800B7934;
L2_D_800B7284 = D_800B7A48;
L2_D_800B7288 = D_800B7A4C;
L2_D_800B72A4 = D_800B7A68;
L2_D_800B72B4 = D_800B7A78;
L2_D_800B72B8 = D_800B7A7C;
L2_D_800B72BC = D_800B7A80;
L2_D_800B72C0 = D_800B7A84;
L2_D_800B72C8 = D_800B7A8C;
L2_D_800B7318 = D_800B7ADC;
L2_D_800B7324 = D_800B7AE8;
L2_D_800B7328 = D_800B7AEC;
L2_D_800B7330 = D_800B7AF4;
L2_D_800B7334 = D_800B7AF8;
L2_D_800B7338 = D_800B7AFC;
L2_D_800B733C = D_800B7B00;
L2_D_800B7340 = D_800B7B04;
L2_D_800B7344 = D_800B7B08;
L2_D_800BF408 = D_800BFBCC;
L2_D_800BF46C = D_800BFC30;
L2_D_800C625C = D_800C88FC;
L2_D_800CD020 = D_800D159C;
L2_D_800D5318 = D_800D9894;
L2_D_800D55A0 = D_800D9B1C;
L2_D_800D55A4 = D_800D9B20;
L2_D_800D55A8 = D_800D9B24;
L2_D_800D55AC = D_800D9B28;
L2_D_800D5670 = D_800D9BEC;
L2_D_800D56BC = D_800D9C38;
L2_D_800D56D0 = D_800D9C4C;
L2_D_800D56D4 = D_800D9C50;
L2_D_800D56D8 = D_800D9C54;
L2_D_800D56EC = D_800D9C68;
L2_D_800D58E0 = D_800D9E5C;
L2_D_800D6978 = D_800DAEF4;
L2_D_800D6B48 = D_800DB0C4;
L2_D_800D6BB8 = D_800DB11C;
L2_D_800D6D20 = D_800DB28C;
L2_D_800D70B4 = D_800DB620;
L2_D_800D8500 = D_800DCA6C;
L2_D_800D869C = D_800DCC08;
L2_D_800D9F14 = D_800DE480;
L2_D_800DA12C = D_800DE698;
L2_D_800DA410 = D_800DE97C;
L2_D_800DA414 = D_800DE980;
L2_D_800DA894 = D_800DEE00;
L2_D_800DA8AC = D_800DEE18;
L2_D_800DAE20 = D_800DF38C;
L2_D_800DAE24 = D_800DF390;
L2_D_800DB814 = D_800DFCC0;
L2_D_800DBA48 = D_800DFEAC;
L2_D_800DBA6C = D_800DFED0;
L2_D_800DBA70 = D_800DFED4;
L2_D_800DBA98 = D_800DFEFC;
L2_D_800DBAAC = D_800DFF10;
L2_D_800DBAD8 = D_800DFF3C;
L2_D_800DCAE0 = D_800E0F44;
L2_D_800DCD68 = D_800E11CC;
L2_D_800E0068 = D_800E708C;
L2_D_800E006C = D_800E7090;
L2_D_800E0070 = D_800E7094;
L2_D_800E0074 = D_800E7098;
L2_D_800E0078 = D_800E709C;
L2_D_800E007C = D_800E70A0;
L2_D_800E0080 = D_800E70A4;
L2_D_800E0084 = D_800E70A8;
L2_D_800E0088 = D_800E70AC;
L2_D_800E008C = D_800E70B0;
L2_D_800E00E4 = D_800E7108;
L2_D_800E00E8 = D_800E710C;
L2_D_800E00EC = D_800E7110;
L2_D_800E01B0 = D_800E71D4;
L2_D_800E01B4 = D_800E71D8;
L2_D_800E01B8 = D_800E71DC;
L2_D_800E01BC = D_800E71E0;
L2_D_800E01C4 = D_800E71E8;
L2_D_800E01C8 = D_800E71EC;
L2_D_800E01D0 = D_800E71F4;
L2_D_800E01D4 = D_800E71F8;
L2_D_800E01D8 = D_800E71FC;
L2_D_800E01DC = D_800E7200;
L2_D_800E0228 = D_800E724C;
L2_D_800E022C = D_800E7250;
L2_D_800E0304 = D_800E7328;
L2_D_800E0308 = D_800E732C;
L2_D_800E030C = D_800E7330;
L2_D_800E0310 = D_800E7334;
L2_D_800E032C = D_800E7350;
L2_D_800E0410 = D_800E7434;
L2_D_800E04FC = D_800E7520;
L2_D_800E0500 = D_800E7524;
L2_D_800E0504 = D_800E7528;
L2_D_800E0D10 = D_800E7D30;
L2_D_800E1510 = D_800E8530;
L2_D_800E1514 = D_800E8534;
L2_D_800E1554 = D_800E8574;
L2_D_800E680C = D_800EE474;
L2_D_800E6810 = D_800EE478;
L2_D_800F4010 = D_800FB478;
L2_D_800F430C = D_800FB7E0;
L2_D_800F4458 = D_800FB92C;
L2_D_800F44DC = D_800FB9B0;
L2_func_8002680C = func_8002680C;
func_800268CC = L2_func_800268CC;
L2_func_80026B00 = func_80026B00;
L2_func_80026C14 = func_80026C14;
L2_func_80026F5C = func_80026F30;
L2_func_80027274 = func_80027248;
func_800286EC = L2_func_800288B4;
L2_func_800288F4 = func_8002872C;
L2_func_800289D8 = func_80028810;
func_80029038 = L2_func_80029200;
L2_func_80029A30 = func_80029868;
L2_func_80029B94 = func_800299CC;
L2_func_8002A7E4 = func_8002A61C;
L2_func_8002A8E8 = func_8002A720;
func_8002AAC4 = L2_func_8002AC8C;
func_8002ADF0 = L2_func_8002AFB8;
func_8002AF08 = L2_func_8002B0D0;
func_8002B064 = L2_func_8002B22C;
L2_func_8002B268 = func_8002B0A0;
L2_func_8002B464 = func_8002B29C;
func_8002BB34 = L2_func_8002BCFC;
L2_func_8002BDE0 = func_8002BC18;
func_8002BDE4 = L2_func_8002BFAC;
L2_func_8002C330 = func_8002C168;
func_8002C2D8 = L2_func_8002C4A0;
func_8002C664 = L2_func_8002C82C;
L2_func_8002CA04 = func_8002C83C;
L2_func_8002D39C = func_8002D1D4;
L2_func_8002D6AC = func_8002D4E4;
func_8002E08C = L2_func_8002E24C;
func_8002E0E4 = L2_func_8002E2A4;
func_8002E13C = L2_func_8002E2FC;
func_8002E1CC = L2_func_8002E38C;
func_8002E350 = L2_func_8002E508;
L2_func_8002E578 = func_8002E3C0;
func_8002E3E0 = L2_func_8002E598;
func_8002E43C = L2_func_8002E5F4;
L2_func_8002E61C = func_8002E464;
L2_func_8002E63C = func_8002E484;
func_8002E4E4 = L2_func_8002E69C;
func_8002F130 = L2_func_8002F214;
L2_func_8002F284 = func_8002F1A0;
func_8002F248 = L2_func_8002F32C;
func_8002F280 = L2_func_8002F364;
func_8002F500 = L2_func_8002F5E4;
L2_func_8002F68C = func_8002F5A8;
func_8002F5C8 = L2_func_8002F6AC;
L2_func_8002F6D4 = func_8002F5F0;
L2_func_8002F814 = func_8002F730;
func_8002FE70 = L2_func_8002FF60;
func_80030370 = L2_func_80030454;
L2_func_80030474 = func_80030390;
func_800303C0 = L2_func_800304A4;
L2_func_80030504 = func_80030420;
L2_func_80030704 = func_80030620;
L2_func_800307C0 = func_800306DC;
L2_func_800307F8 = func_80030714;
func_80030F1C = L2_func_80031000;
L2_func_80031CF8 = func_80031C14;
L2_func_80031F34 = func_80031E50;
L2_func_800320B8 = func_80031FD4;
L2_func_800320C8 = func_80031FE4;
L2_func_800321C4 = func_800320E0;
func_8003220C = L2_func_800322F0;
func_80032404 = L2_func_800324E8;
L2_func_8003251C = func_80032438;
L2_func_80032684 = func_800325E8;
L2_func_8003292C = func_80032890;
L2_func_80033254 = func_800331B8;
L2_func_80033568 = func_800334CC;
L2_func_80035C7C = func_80035E40;
L2_func_800368C8 = func_80036A8C;
L2_func_8003838C = func_80038550;
func_80038B00 = L2_func_80038930;
func_80039478 = L2_func_800393F8;
func_800397CC = L2_func_8003974C;
func_800397EC = L2_func_8003976C;
L2_func_8003978C = func_8003980C;
func_800398E0 = L2_func_800398F0;
L2_func_80039920 = func_80039910;
func_80039A30 = L2_func_80039A40;
func_80039C4C = L2_func_80039C5C;
L2_func_80039CA4 = func_80039C94;
func_8003A100 = L2_func_8003A110;
func_8003A3B4 = L2_func_8003A3C4;
L2_func_8003A3FC = func_8003A3EC;
func_8003A5F0 = L2_func_8003A600;
L2_func_8003AA8C = func_8003AA7C;
L2_func_8003D7CC = func_8003D860;
L2_func_80041918 = func_800419AC;
L2_func_80041954 = func_800419E8;
func_80041A24 = L2_func_80041990;
func_800420EC = L2_func_80042058;
L2_func_8004209C = func_80042130;
func_8004225C = L2_func_800421C8;
L2_func_80042294 = func_80042328;
L2_func_800426E8 = func_8004277C;
func_80042840 = L2_func_800427AC;
L2_func_80042A08 = func_80042A9C;
func_80043908 = L2_func_80043874;
L2_func_80043908 = func_8004399C;
L2_func_80043AFC = func_80043B90;
func_80043CA8 = L2_func_80043C14;
L2_func_80043C4C = func_80043CE0;
L2_func_80043E58 = func_80043EEC;
func_800456B8 = L2_func_80045624;
L2_func_80045848 = func_800458DC;
L2_func_80045890 = func_80045924;
func_8004595C = L2_func_800458C8;
L2_func_80045900 = func_80045994;
L2_func_80045910 = func_800459A4;
func_800461E4 = L2_func_80045E88;
L2_func_80046098 = func_80046494;
L2_func_80046174 = func_80046570;
L2_func_800462CC = func_800466CC;
L2_func_80046638 = func_80046A38;
L2_func_800466D8 = func_80046AD8;
L2_func_800481FC = func_80048668;
func_8004897C = L2_func_80048510;
L2_func_8004857C = func_800489E8;
func_800489F8 = L2_func_8004858C;
L2_func_80048B04 = func_80048F70;
L2_func_800497E4 = func_80049D0C;
func_8004A1A8 = L2_func_80049C80;
L2_func_8004A814 = func_8004AD3C;
L2_func_8004AF2C = func_8004B454;
func_8004B45C = L2_func_8004AF34;
func_8004B4A0 = L2_func_8004AF78;
func_8004B4C4 = L2_func_8004AF9C;
func_8004B4F8 = L2_func_8004AFD0;
func_8004B530 = L2_func_8004B008;
func_8004B540 = L2_func_8004B018;
func_8004B994 = L2_func_8004B46C;
func_8004B9D4 = L2_func_8004B4AC;
func_8004BA20 = L2_func_8004B4F8;
func_8004C1A0 = L2_func_8004BC78;
L2_func_8004BC9C = func_8004C1C4;
func_8004C1D4 = L2_func_8004BCAC;
func_8004C1E4 = L2_func_8004BCBC;
func_8004C1FC = L2_func_8004BCD4;
L2_func_8004BDD8 = func_8004C300;
L2_func_8004BE84 = func_8004C3AC;
func_8004C3E8 = L2_func_8004BEC0;
func_8004D9B0 = L2_func_8004D48C;
L2_func_8004DC58 = func_8004E17C;
L2_func_8004E0C4 = func_8004E500;
func_8004E5EC = L2_func_8004E1B0;
func_8004EC74 = L2_func_8004E88C;
L2_func_8004EBA4 = func_8004EF8C;
func_8004F634 = L2_func_8004F24C;
L2_func_8004F288 = func_8004F670;
L2_func_8004F314 = func_8004F6FC;
L2_func_800501B0 = func_80050598;
L2_func_80050A9C = func_80050E84;
L2_func_80050AA4 = func_80050E8C;
func_80051160 = L2_func_80050D78;
func_8005182C = L2_func_80051444;
L2_func_800516E8 = func_80051AD0;
L2_func_80054E34 = func_800551F0;
L2_func_80054E54 = func_80055210;
func_80055544 = L2_func_80055188;
func_80055A54 = L2_func_80055698;
func_80055AF4 = L2_func_80055738;
func_80055E64 = L2_func_80055938;
func_80055F4C = L2_func_80055A20;
L2_func_80055AB0 = func_80055FDC;
func_800561B8 = L2_func_80055C8C;
func_800564A4 = L2_func_80055F78;
func_800565DC = L2_func_800560EC;
func_80058A6C = L2_func_80058570;
L2_func_8005966C = func_80059B68;
L2_func_800596B8 = func_80059BB4;
func_80059C98 = L2_func_8005979C;
func_80059F90 = L2_func_80059A94;
func_8005A044 = L2_func_80059B48;
func_8005A100 = L2_func_80059C04;
func_8005A168 = L2_func_80059C6C;
L2_func_80059EF0 = func_8005A3EC;
L2_func_8005AE6C = func_8005B368;
func_8005B3AC = L2_func_8005AEB0;
L2_func_8005B608 = func_8005BB04;
L2_func_8005BA6C = func_8005BF68;
L2_func_8005C964 = func_8005CE60;
L2_func_8005C994 = func_8005CE90;
func_8005D54C = L2_func_8005CF80;
func_8005DB98 = L2_func_8005D5CC;
L2_func_8005D604 = func_8005DBD0;
L2_func_8005D670 = func_8005DC3C;
L2_func_8005D694 = func_8005DC60;
L2_func_8005D6D4 = func_8005DCA0;
func_8005E09C = L2_func_8005DAD0;
func_8005E54C = L2_func_8005DF80;
func_8005F2C0 = L2_func_8005ECF4;
func_8005F394 = L2_func_8005EDC8;
L2_func_8005EF48 = func_8005F514;
L2_func_8005F374 = func_8005F940;
L2_func_8005F74C = func_8005FD18;
L2_func_8005FFF4 = func_800605C0;
func_8006093C = L2_func_80060370;
L2_func_80060594 = func_800609DC;
L2_func_8006066C = func_80060AE4;
L2_func_800606F0 = func_80060B68;
L2_func_800606F8 = func_80060B70;
L2_func_8006087C = func_80060CF4;
func_80061364 = L2_func_80060EC4;
L2_func_800617E4 = func_80061C64;
L2_func_800617EC = func_80061C6C;
L2_func_800619B8 = func_80061E38;
func_80061E70 = L2_func_800619F0;
L2_func_80061CE8 = func_80062174;
L2_func_80061E1C = func_800622A8;
func_80062404 = L2_func_80061F64;
L2_func_800622F4 = func_800627CC;
L2_func_80063630 = func_80063B08;
L2_func_800637D0 = func_80063CA8;
func_80063F2C = L2_func_80063A54;
L2_func_80063A98 = func_80063F70;
func_80064324 = L2_func_80063E4C;
L2_func_80063E70 = func_80064348;
L2_func_80063EFC = func_800643D4;
func_800653FC = L2_func_80064F24;
L2_func_80064FB0 = func_80065488;
func_80065728 = L2_func_80065250;
L2_func_800660A0 = func_80066578;
L2_func_800662C8 = func_800667A0;
L2_func_80066304 = func_800667DC;
func_800668D4 = L2_func_800663FC;
func_8006B85C = L2_func_80069DD8;
L2_func_80069DE8 = func_8006B86C;
L2_func_80069EBC = func_8006B8F0;
L2_func_80069FA0 = func_8006BA9C;
L2_func_8006B2F0 = func_8006C7EC;
L2_func_8006BE78 = func_8006BCA0;
L2_func_8006BF24 = func_8006BD10;
L2_func_8006C250 = func_8006C7FC;
L2_func_8006D6D0 = func_8006C80C;
L2_func_8006D7A0 = func_8006ED00;
L2_func_8006E034 = func_8006C4EC;
L2_func_8006E8F4 = func_8006F708;
func_8006F778 = L2_func_8006E97C;
L2_func_8006E9D0 = func_8006F7CC;
L2_func_80072648 = func_80073444;
L2_func_800727D4 = func_800735D0;
func_80079384 = L2_func_80078588;
func_800793D4 = L2_func_800785D8;
L2_func_80078A60 = func_8007985C;
func_80079940 = L2_func_80078B44;
func_8007998C = L2_func_80078B90;
func_80079E3C = L2_func_80079040;
L2_func_80079060 = func_80079E5C;
func_80079E68 = L2_func_8007906C;
func_8007A4A8 = L2_func_800796AC;
func_8007A53C = L2_func_80079740;
func_8007A580 = L2_func_80079784;
func_8007A650 = L2_func_80079854;
func_8007A984 = L2_func_80079B2C;
L2_func_8007A190 = func_8007AFE8;
func_8007B0F8 = L2_func_8007A2A0;
L2_func_8007A4D4 = func_8007B32C;
func_8007B4D0 = L2_func_8007A678;
L2_func_8007D6E0 = func_8007E440;
L2_func_8007E33C = func_8007F12C;
L2_func_8007E370 = func_8007F160;
L2_func_8007F098 = func_8007FE88;
L2_func_8007F210 = func_80080000;
L2_func_8007F36C = func_8008015C;
L2_func_8007F520 = func_80080310;
L2_func_8007FF68 = func_80080D58;
L2_func_800800D4 = func_80080EC4;
L2_func_80080238 = func_80081028;
L2_func_800803A8 = func_80081198;
L2_func_80080518 = func_80081308;
L2_func_80080660 = func_80081450;
L2_func_800807A0 = func_80081590;
L2_func_80080930 = func_80081720;
L2_func_80080AC8 = func_800818B8;
L2_func_80080C04 = func_800819F4;
L2_func_80080D44 = func_80081B34;
L2_func_80080E8C = func_80081C7C;
L2_func_80081390 = func_80082180;
L2_func_80083044 = func_80083E34;
L2_func_80083064 = func_80083E54;
L2_func_80083074 = func_80083E64;
L2_func_80083280 = func_80084070;
L2_func_80083494 = func_80084284;
L2_func_800855E0 = func_800863D0;
L2_func_800855F0 = func_800863E0;
L2_func_80085600 = func_800863F0;
L2_func_80085AA0 = func_80086890;
L2_func_80085C3C = func_80086A2C;
L2_func_80085C4C = func_80086A3C;
L2_func_80085D5C = func_80086B4C;
L2_func_80085E4C = func_80086C3C;
L2_func_80085E7C = func_80086C6C;
L2_func_80085E8C = func_80086C7C;
L2_func_80085EDC = func_80086CCC;
L2_func_80085F1C = func_80086D0C;
L2_func_80086EA8 = func_80087C98;
L2_func_80086FAC = func_80087D9C;
L2_func_800870CC = func_80087EBC;
L2_func_8008710C = func_80087EFC;
L2_func_80087120 = func_80087F10;
L2_func_80087134 = func_80087F24;
L2_func_800873A4 = func_80088194;
L2_func_80087530 = func_80088320;
L2_func_80087574 = func_80088364;
L2_func_8008836C = func_8008915C;
L2_func_80089774 = func_8008A564;
L2_func_80089AF4 = func_8008A8E4;
L2_func_80089BB4 = func_8008A9A4;
L2_func_80089D04 = func_8008AAF4;
L2_func_80089D44 = func_8008AB34;
L2_func_80089D64 = func_8008AB54;
L2_func_80089D94 = func_8008AB84;
L2_func_80089F64 = func_8008AD54;
L2_func_8008A014 = func_8008AE04;
L2_func_8008A0C4 = func_8008AEB4;
L2_func_8008A724 = func_8008B514;
L2_func_8008AAD0 = func_8008B8C0;
L2_func_8008C0C0 = func_8008CEB0;
L2_func_8008C48C = func_8008D27C;
L2_func_8008C6CC = func_8008D4BC;
L2_func_8008C90C = func_8008D6FC;
L2_func_8008CBBC = func_8008D9AC;
L2_func_8008CE0C = func_8008DBFC;
L2_func_8008D02C = func_8008DE1C;
L2_func_8008D33C = func_8008E12C;
L2_func_8008D66C = func_8008E45C;
L2_func_8008D92C = func_8008E71C;
L2_func_8008DB6C = func_8008E95C;
L2_func_8008DCEC = func_8008EADC;
L2_func_8008DF2C = func_8008ED1C;
L2_func_8008E09C = func_8008EE8C;
L2_func_8008E28C = func_8008F07C;
L2_func_8008E5CC = func_8008F3BC;
L2_func_8008E7EC = func_8008F5DC;
L2_func_8008EAFC = func_8008F8EC;
L2_func_8008ECEC = func_8008FADC;
L2_func_8008EEEC = func_8008FCDC;
L2_func_8008F21C = func_8009000C;
L2_func_8008F49C = func_8009028C;
L2_func_8008F74C = func_8009053C;
L2_func_8008FA5C = func_8009084C;
L2_func_8008FADC = func_800908CC;
L2_func_800900AC = func_80090E9C;
L2_func_800912A4 = func_80092004;
D_1F8003D4 = 0x1F8003D4;
D_1F8003D8 = 0x1F8003D8;
D_1F8003DC = 0x1F8003DC;
L1_D_800AB540_b = L1_D_800AB540;
L1_D_800AB540_c = L1_D_800AB540;
L1_D_8009CE24 = L1_D_8009CE20 + 4;
