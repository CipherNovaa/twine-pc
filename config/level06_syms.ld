/* Generated by tools/port_level.py: LEVEL01 names (L1_ prefix) bound to level06's symbols. */
L1_AddPrim = func_8008B724;
L1_ApplyBonusCheats = func_8002E070;
L1_ApplyMatrix = func_8008E404;
L1_ApplyMatrixLV = func_8007C6F4;
L1_ApplyMatrixSV = func_800904F8;
L1_Args_GetFlag115 = func_8002E21C;
L1_CALLOC3_OBJ_54 = func_8008D8E8;
func_800502A4 = L1_Camera_ResetZoom;
func_8002C31C = L1_CdBin_Disable;
func_8002C360 = L1_CdBin_Enable;
func_8002C47C = L1_CdBin_SetLevel;
L1_CdInit = func_800879EC;
L1_CdSearchFile = func_80085550;
L1_ChangeClearPAD = func_80094C1C;
L1_ChangeClearRCnt = func_80094C2C;
func_8002DCE8 = L1_Cheat_CheckCodes;
L1_Cheat_DoAction = func_8002DA5C;
L1_Cheat_ResetCodes = func_8002E1C4;
L1_CloseEvent = func_80083418;
L1_D_80082604 = func_800845E4;
L1_D_80095808 = D_800977E8;
L1_D_8009C180 = D_8009E160;
L1_D_8009C184 = D_8009E164;
L1_D_8009C1EC = D_8009E1CC;
L1_D_8009C1ED = D_8009E1CD;
L1_D_8009C1F0 = D_8009E1D0;
L1_D_8009C1F4 = D_8009E1D4;
L1_D_8009C1F8 = D_8009E1D8;
L1_D_8009C200 = D_8009E1E0;
L1_D_8009C204 = D_8009E1E4;
L1_D_8009C208 = D_8009E1E8;
L1_D_8009C20A = D_8009E1EA;
L1_D_8009C20C = D_8009E1EC;
L1_D_8009CA56 = D_8009EA36;
L1_D_8009CA58 = D_8009EA38;
L1_D_8009CA59 = D_8009EA39;
L1_D_8009CA5A = D_8009EA3A;
L1_D_8009CA5C = D_8009EA3C;
L1_D_8009CA5E = D_8009EA3E;
L1_D_8009CA60 = D_8009EA40;
L1_D_8009CA64 = D_8009EA44;
L1_D_8009CA68 = D_8009EA48;
L1_D_8009CA70 = D_8009EA50;
L1_D_8009CA74 = D_8009EA54;
L1_D_8009CA78 = D_8009EA58;
L1_D_8009CA7C = D_8009EA5C;
L1_D_8009CA80 = D_8009EA60;
L1_D_8009CA84 = D_8009EA64;
L1_D_8009CA8C = D_8009EA6C;
L1_D_8009CA90 = D_8009EA70;
L1_D_8009CA94 = D_8009EA74;
L1_D_8009CA98 = D_8009EA78;
L1_D_8009CA9C = D_8009EA7C;
L1_D_8009CAA0 = D_8009EA80;
L1_D_8009CAA4 = D_8009EA84;
L1_D_8009CAA8 = D_8009EA88;
L1_D_8009CAAC = D_8009EA8C;
L1_D_8009CABD = D_8009EA9D;
L1_D_8009CABE = D_8009EA9E;
L1_D_8009CABF = D_8009EA9F;
L1_D_8009CAC0 = D_8009EAA0;
L1_D_8009CAC4 = D_8009EAA4;
L1_D_8009CACC = D_8009EAAC;
L1_D_8009CAD0 = D_8009EAB0;
L1_D_8009CD00 = D_8009ECE0;
L1_D_8009CD30 = D_8009ED10;
L1_D_8009CD3C = D_8009ED1C;
L1_D_8009CD4C = D_8009ED2C;
L1_D_8009CD50 = D_8009ED30;
L1_D_8009CD54 = D_8009ED34;
L1_D_8009CD58 = D_8009ED38;
L1_D_8009CD5C = D_8009ED3C;
L1_D_8009CD5E = D_8009ED3E;
L1_D_8009CD60 = D_8009ED40;
L1_D_8009CD62 = D_8009ED42;
L1_D_8009CD6C = D_8009ED4C;
L1_D_8009CD6E = D_8009ED4E;
L1_D_8009CD78 = D_8009ED58;
L1_D_8009CD80 = D_8009ED60;
L1_D_8009CD88 = D_8009ED68;
L1_D_8009CD8C = D_8009ED6C;
L1_D_8009CD98 = D_8009ED78;
L1_D_8009CDA0 = D_8009ED80;
L1_D_8009CDA2 = D_8009ED82;
L1_D_8009CDA8 = D_8009ED88;
L1_D_8009CDD0 = D_8009EDB0;
L1_D_8009CDDC = D_8009EDBC;
L1_D_8009CDE4 = D_8009EDC4;
L1_D_8009CDE5 = D_8009EDC5;
L1_D_8009CDE6 = D_8009EDC6;
L1_D_8009CDE7 = D_8009EDC7;
L1_D_8009CDE8 = D_8009EDC8;
L1_D_8009CDEC = D_8009EDCC;
L1_D_8009CDF0 = D_8009EDD0;
L1_D_8009CE20 = D_8009EE00;
L1_D_8009CE38 = D_8009EE18;
L1_D_8009CEB0 = D_8009EE90;
L1_D_8009CEE0 = D_8009EEC0;
L1_D_8009CF10 = D_8009EEF0;
L1_D_8009CF14 = D_8009EEF4;
L1_D_8009CF2C = D_8009EF0C;
L1_D_8009CF30 = D_8009EF10;
L1_D_8009CF34 = D_8009EF14;
L1_D_8009CF48 = D_8009EF28;
L1_D_8009CF4C = D_8009EF2C;
L1_D_8009CF50 = D_8009EF30;
L1_D_8009CF54 = D_8009EF34;
L1_D_8009CF68 = D_8009EF48;
L1_D_8009CF6C = D_8009EF4C;
L1_D_8009CF70 = D_8009EF50;
L1_D_8009CF74 = D_8009EF54;
L1_D_8009CF7C = D_8009EF5C;
L1_D_8009CF80 = D_8009EF60;
L1_D_8009CF8C = D_8009EF6C;
L1_D_8009CF90 = D_8009EF70;
L1_D_8009CF94 = D_8009EF74;
L1_D_8009CF98 = D_8009EF78;
L1_D_8009CF9C = D_8009EF7C;
L1_D_8009CFA8 = D_8009EF88;
L1_D_8009CFB0 = D_8009EF90;
L1_D_8009CFB4 = D_8009EF94;
L1_D_8009CFBB = D_8009EF9B;
L1_D_8009CFBE = D_8009EF9E;
L1_D_8009CFC0 = D_8009EFA0;
L1_D_8009CFC4 = D_8009EFA4;
L1_D_8009CFC8 = D_8009EFA8;
L1_D_8009CFCC = D_8009EFAC;
L1_D_8009CFE4 = D_8009EFC4;
L1_D_8009CFE8 = D_8009EFC8;
L1_D_8009CFEC = D_8009EFCC;
L1_D_8009CFF0 = D_8009EFD0;
L1_D_8009CFF6 = D_8009EFD6;
L1_D_8009CFF8 = D_8009EFD8;
L1_D_8009CFFC = D_8009EFDC;
L1_D_8009D000 = D_8009EFE0;
L1_D_8009D002 = D_8009EFE2;
L1_D_8009D004 = D_8009EFE4;
L1_D_8009D008 = D_8009EFE8;
L1_D_8009D00C = D_8009EFEC;
L1_D_8009D00E = D_8009EFEE;
L1_D_8009D010 = D_8009EFF0;
L1_D_8009D014 = D_8009EFF4;
L1_D_8009D018 = D_8009EFF8;
L1_D_8009D01A = D_8009EFFA;
L1_D_8009D020 = D_8009F000;
L1_D_8009D038 = D_8009F018;
L1_D_8009D03C = D_8009F01C;
L1_D_8009D040 = D_8009F020;
L1_D_8009D084 = D_8009F064;
L1_D_8009D088 = D_8009F068;
L1_D_8009D09C = D_8009F07C;
L1_D_8009D0FC = D_8009F0DC;
L1_D_8009D104 = D_8009F0E4;
L1_D_8009D106 = D_8009F0E6;
L1_D_8009D108 = D_8009F0E8;
L1_D_8009D10A = D_8009F0EA;
L1_D_8009D10C = D_8009F0EC;
L1_D_8009D124 = D_8009F104;
L1_D_8009D130 = D_8009F110;
L1_D_8009D26C = D_8009F250;
L1_D_8009D270 = D_8009F25C;
L1_D_8009D274 = D_8009F264;
L1_D_8009D280 = D_8009F288;
L1_D_8009D2A8 = D_8009F254;
L1_D_8009D2AC = D_8009F260;
L1_D_8009D2B0 = D_8009F268;
L1_D_8009D35C = D_8009F3EC;
L1_D_8009D368 = D_8009F3F8;
L1_D_8009D36C = D_8009F3FC;
L1_D_8009D374 = D_8009F404;
L1_D_8009D384 = D_8009F414;
L1_D_8009D394 = D_8009F424;
L1_D_8009D3A4 = D_8009F434;
L1_D_8009D3A8 = D_8009F438;
L1_D_8009D3AC = D_8009F43C;
L1_D_8009D3B0 = D_8009F440;
L1_D_8009D3BC = D_8009F44C;
L1_D_8009D3F0 = D_8009F480;
L1_D_8009D3F4 = D_8009F484;
L1_D_8009D3F8 = D_8009F488;
L1_D_8009D3FC = D_8009F48C;
L1_D_8009D444 = D_8009F4D4;
L1_D_8009D5A8 = D_8009F6BC;
L1_D_8009D5AC = D_8009F6C0;
L1_D_8009D5F8 = D_8009F70C;
L1_D_8009D5FC = D_8009F710;
L1_D_8009D600 = D_8009F714;
L1_D_8009D610 = D_8009F724;
L1_D_8009D620 = D_8009F734;
L1_D_8009D660 = D_8009F774;
L1_D_8009D7A4 = D_8009F8B8;
L1_D_8009D7A8 = D_8009F8BC;
L1_D_8009D8B8 = D_8009F9CC;
L1_D_8009D8D4 = D_8009F9E8;
L1_D_8009D8E4 = D_8009F9F0;
L1_D_8009D8E8 = D_8009F9F4;
L1_D_8009D8F0 = D_8009F9FC;
L1_D_8009D8F4 = D_8009FA00;
L1_D_8009D8F8 = D_8009FA04;
L1_D_8009D8FC = D_8009FA08;
L1_D_8009D900 = D_8009FA0C;
L1_D_8009D904 = D_8009FA10;
L1_D_8009D90C = D_8009FA18;
L1_D_8009D910 = D_8009FA1C;
L1_D_8009D914 = D_8009FA20;
L1_D_8009D918 = D_8009FA24;
L1_D_8009D91C = D_8009FA28;
L1_D_8009D920 = D_8009FA2C;
L1_D_8009D924 = D_8009FA30;
L1_D_8009D928 = D_8009FA34;
L1_D_8009DB50 = D_8009FC48;
L1_D_8009E480 = D_800A11C8;
L1_D_8009E490 = D_800A11E0;
L1_D_8009E908 = D_800A14C4;
L1_D_8009E9A8 = D_800A1568;
L1_D_8009E9B4 = D_800A1574;
L1_D_8009E9B8 = D_800A1578;
L1_D_8009E9BC = D_800A157C;
L1_D_8009E9C0 = D_800A1580;
L1_D_8009E9D8 = D_800A1598;
L1_D_8009EADC = D_800A17B8;
L1_D_8009EB5C = D_800A1838;
L1_D_8009EB7C = D_800A1858;
L1_D_8009EB88 = D_800A1864;
L1_D_8009EB8C = D_800A1868;
L1_D_8009EE0C = D_800A1AE8;
L1_D_8009EE3D = D_800A1B19;
L1_D_8009EE8C = D_800A1B68;
L1_D_8009EEC4 = D_800A1BA0;
L1_D_8009EEC8 = D_800A1BA4;
L1_D_8009EED0 = D_800A1BAC;
L1_D_8009EED4 = D_800A1BB0;
L1_D_8009EED8 = D_800A1BB4;
L1_D_8009EEF0 = D_800A1BD0;
L1_D_8009EEF4 = D_800A1BD4;
L1_D_8009EEF8 = D_800A1BD8;
L1_D_8009EF1C = D_800A1BFC;
L1_D_8009EF94 = D_800A1C74;
L1_D_8009EF98 = D_800A1C78;
L1_D_8009EF9C = D_800A1C7C;
L1_D_8009EFA0 = D_800A1C80;
L1_D_8009EFA4 = D_800A1C84;
L1_D_8009EFA8 = D_800A1C88;
L1_D_8009EFC8 = D_800A1CA8;
L1_D_8009F008 = D_800A1CE8;
L1_D_8009F00C = D_800A1CEC;
L1_D_8009F010 = D_800A1CF0;
L1_D_8009F012 = D_800A1CF2;
L1_D_8009F013 = D_800A1CF3;
L1_D_8009F014 = D_800A1CF4;
L1_D_8009F016 = D_800A1CF6;
L1_D_8009F018 = D_800A1CF8;
L1_D_8009F01C = D_800A1CFC;
L1_D_8009F07C = D_800A1D5C;
L1_D_8009F084 = D_800A1D64;
L1_D_8009F090 = D_800A1D70;
L1_D_8009F09C = D_800A1D7C;
L1_D_8009F0BC = D_800A1D9C;
L1_D_8009F0D0 = D_800A1DB0;
L1_D_8009F0E4 = D_800A1DC4;
L1_D_8009F0E6 = D_800A1DC6;
L1_D_8009F10C = D_800A1DEC;
L1_D_8009F114 = D_800A1DF4;
L1_D_8009F118 = D_800A1DF8;
L1_D_8009F11C = D_800A1DFC;
L1_D_8009F120 = D_800A1E00;
L1_D_8009F124 = D_800A1E04;
L1_D_8009F128 = D_800A1E08;
L1_D_8009F12C = D_800A1E0C;
L1_D_8009F130 = D_800A1E10;
L1_D_8009F134 = D_800A1E14;
L1_D_8009F138 = D_800A1E18;
L1_D_8009F13C = D_800A1E1C;
L1_D_8009F140 = D_800A1E20;
L1_D_8009F144 = D_800A1E24;
L1_D_8009F148 = D_800A1E28;
L1_D_8009F14C = D_800A1E2C;
L1_D_8009F150 = D_800A1E30;
L1_D_8009F160 = D_800A1E40;
L1_D_8009F170 = D_800A1E50;
L1_D_8009F178 = D_800A1E58;
L1_D_8009F17C = D_800A1E5C;
L1_D_8009F18C = D_800A1E6C;
L1_D_8009F190 = D_800A1E70;
L1_D_8009F194 = D_800A1E74;
L1_D_8009F198 = D_800A1E78;
L1_D_8009F1B0 = D_800A1E90;
L1_D_8009F230 = D_800A1F10;
L1_D_8009F234 = D_800A1F14;
L1_D_8009F248 = D_800A1F28;
L1_D_8009F24C = D_800A1F2C;
L1_D_8009F250 = D_800A1F30;
L1_D_8009F254 = D_800A1F34;
L1_D_8009F2B8 = D_800A1F98;
L1_D_8009F2BA = D_800A1F9A;
L1_D_8009F2BC = D_800A1F9C;
L1_D_8009F2E8 = D_800A1FC8;
L1_D_8009F2F4 = D_800A1FD4;
L1_D_800A0340 = D_800A3020;
L1_D_800A0344 = D_800A3024;
L1_D_800A0348 = D_800A3028;
L1_D_800A034C = D_800A302C;
L1_D_800A0350 = D_800A3030;
L1_D_800A0370 = D_800A3050;
L1_D_800A4370 = D_800A7050;
L1_D_800A4374 = D_800A7054;
L1_D_800A4378 = D_800A7058;
L1_D_800A437C = D_800A705C;
L1_D_800A4380 = D_800A7060;
L1_D_800A4382 = D_800A7062;
L1_D_800A4384 = D_800A7064;
L1_D_800A4390 = D_800A7070;
L1_D_800A4394 = D_800A7074;
L1_D_800A43B0 = D_800A7090;
L1_D_800A43C8 = D_800A70A8;
L1_D_800A43CC = D_800A70AC;
L1_D_800A43D0 = D_800A70B0;
L1_D_800A43D4 = D_800A70B4;
L1_D_800A43D8 = D_800A70B8;
L1_D_800A43DC = D_800A70BC;
L1_D_800A43E0 = D_800A70C0;
L1_D_800A43E4 = D_800A70C4;
L1_D_800A43E8 = D_800A70C8;
L1_D_800A43EC = D_800A70CC;
L1_D_800A43F0 = D_800A70D0;
L1_D_800A43F4 = D_800A70D4;
L1_D_800A43F8 = D_800A70D8;
L1_D_800A43FC = D_800A70DC;
L1_D_800A4400 = D_800A70E0;
L1_D_800A4404 = D_800A70E4;
L1_D_800A4408 = D_800A70E8;
L1_D_800A440C = D_800A70EC;
L1_D_800A4410 = D_800A70F0;
L1_D_800A4414 = D_800A70F4;
L1_D_800A4418 = D_800A70F8;
L1_D_800A441C = D_800A70FC;
L1_D_800A4420 = D_800A7100;
L1_D_800A4428 = D_800A7108;
L1_D_800A442C = D_800A710C;
L1_D_800A4430 = D_800A7110;
L1_D_800A4440 = D_800A7120;
L1_D_800A4450 = D_800A7130;
L1_D_800A4460 = D_800A7140;
L1_D_800A446C = D_800A714C;
L1_D_800A4470 = D_800A7150;
L1_D_800A4474 = D_800A7154;
L1_D_800A4478 = D_800A7158;
L1_D_800A447C = D_800A715C;
L1_D_800A45D0 = D_800A72B0;
L1_D_800A45D4 = D_800A72B4;
L1_D_800A45D8 = D_800A72B8;
L1_D_800A4EA0 = D_800A7B80;
L1_D_800A4FD8 = D_800A7CB8;
L1_D_800A4FDC = D_800A7CBC;
L1_D_800A4FF0 = D_800A7CD0;
L1_D_800A5000 = D_800A7CE0;
L1_D_800A5010 = D_800A7CF0;
L1_D_800A56A0 = D_800A8380;
L1_D_800A5834 = D_800A8514;
L1_D_800A59D0 = D_800A86B0;
L1_D_800A59D4 = D_800A86B4;
L1_D_800A59D8 = D_800A86B8;
L1_D_800A59DC = D_800A86BC;
L1_D_800A59E0 = D_800A86C0;
L1_D_800A5B60 = D_800A8840;
L1_D_800A5B6C = D_800A884C;
L1_D_800A5B90 = D_800A8870;
L1_D_800A5BA8 = D_800A8888;
L1_D_800A5CB0 = D_800A8990;
L1_D_800A5CB4 = D_800A8994;
L1_D_800A5CB8 = D_800A8998;
L1_D_800A5CBC = D_800A899C;
L1_D_800A5CC0 = D_800A89A0;
L1_D_800A5CC8 = D_800A89A8;
L1_D_800A5CCC = D_800A89AC;
L1_D_800A5CD0 = D_800A89B0;
L1_D_800A5CD4 = D_800A89B4;
L1_D_800A5CD8 = D_800A89B8;
L1_D_800A5CDC = D_800A89BC;
L1_D_800A5CE0 = D_800A89C0;
L1_D_800A5CE4 = D_800A89C4;
L1_D_800A5CE8 = D_800A89C8;
L1_D_800A5CEC = D_800A89CC;
L1_D_800A5CF0 = D_800A89D0;
L1_D_800A5D00 = D_800A89E0;
L1_D_800A5D04 = D_800A89E4;
L1_D_800A5D08 = D_800A89E8;
L1_D_800A5D18 = D_800A89F8;
L1_D_800A5D1C = D_800A89FC;
L1_D_800A5D20 = D_800A8A00;
L1_D_800A5D24 = D_800A8A04;
L1_D_800A5D28 = D_800A8A08;
L1_D_800A5D2C = D_800A8A0C;
L1_D_800A5D34 = D_800A8A14;
L1_D_800A5D44 = D_800A8A24;
L1_D_800A5D48 = D_800A8A28;
L1_D_800A5D4C = D_800A8A2C;
L1_D_800A5D7A = D_800A8A5A;
L1_D_800A5D7C = D_800A8A5C;
L1_D_800A5D80 = D_800A8A60;
L1_D_800A5D98 = D_800A8A78;
L1_D_800A5D9C = D_800A8A7C;
L1_D_800A5DA0 = D_800A8A80;
L1_D_800A5DA4 = D_800A8A84;
L1_D_800A5DA8 = D_800A8A88;
L1_D_800A5DAC = D_800A8A8C;
L1_D_800A5DB0 = D_800A8A90;
L1_D_800A5DB4 = D_800A8A94;
L1_D_800A5DB5 = D_800A8A95;
L1_D_800A5DBC = D_800A8A9C;
L1_D_800A5E3C = D_800A8B1C;
L1_D_800A5E5C = D_800A8B3C;
L1_D_800A5EA0 = D_800A8B80;
L1_D_800A5EDC = D_800A8BBC;
L1_D_800A5F5C = D_800A8C3C;
L1_D_800A5FDC = D_800A8CBC;
L1_D_800A605C = D_800A8D3C;
L1_D_800A6060 = D_800A8D40;
L1_D_800A6064 = D_800A8D44;
L1_D_800A6068 = D_800A8D48;
L1_D_800A606C = D_800A8D4C;
L1_D_800A6070 = D_800A8D50;
L1_D_800A6074 = D_800A8D54;
L1_D_800A6075 = D_800A8D55;
L1_D_800A6078 = D_800A8D58;
L1_D_800A6090 = D_800A8D70;
L1_D_800A6094 = D_800A8D74;
L1_D_800A6098 = D_800A8D78;
L1_D_800A609C = D_800A8D7C;
L1_D_800A60A0 = D_800A8D80;
L1_D_800A60B0 = D_800A8D90;
L1_D_800A60D0 = D_800A8DB0;
L1_D_800A60D4 = D_800A8DB4;
L1_D_800A60E0 = D_800A8DC0;
L1_D_800A60E4 = D_800A8DC4;
L1_D_800A6104 = D_800A8DE4;
L1_D_800A6110 = D_800A8DF0;
L1_D_800A6114 = D_800A8DF4;
L1_D_800A6118 = D_800A8DF8;
L1_D_800A611C = D_800A8DFC;
L1_D_800A6120 = D_800A8E00;
L1_D_800A6140 = D_800A8E20;
L1_D_800A6170 = D_800A8E50;
L1_D_800A6174 = D_800A8E54;
L1_D_800A6178 = D_800A8E58;
L1_D_800A6180 = D_800A8E60;
L1_D_800A6198 = D_800A8E78;
L1_D_800A62A0 = D_800A8F80;
L1_D_800A66A0 = D_800A9380;
L1_D_800A6EB0 = D_800A9B90;
L1_D_800A6ED0 = D_800A9BB0;
L1_D_800A6EF8 = D_800A9BD8;
L1_D_800A6F00 = D_800A9BE0;
L1_D_800A6F1C = D_800A9BFC;
L1_D_800A6F4C = D_800A9C2C;
L1_D_800A7048 = D_800A9D28;
L1_D_800A7060 = D_800A9D40;
L1_D_800A70A0 = D_800A9D80;
L1_D_800A70C8 = D_800A9DA8;
L1_D_800A70D4 = D_800A9DB4;
L1_D_800A70F8 = D_800A9DD8;
L1_D_800A7190 = D_800A9E70;
L1_D_800A71EC = D_800A9ECC;
L1_D_800A71F0 = D_800A9ED0;
L1_D_800A71F4 = D_800A9ED4;
L1_D_800A71F8 = D_800A9ED8;
L1_D_800A7214 = D_800A9EF4;
L1_D_800A7260 = D_800A9F40;
L1_D_800A7290 = D_800A9F70;
L1_D_800A72E8 = D_800A9FC8;
L1_D_800A7300 = D_800A9FE0;
L1_D_800A7310 = D_800A9FF0;
L1_D_800A7320 = D_800AA000;
L1_D_800A7324 = D_800AA004;
L1_D_800A7330 = D_800AA010;
L1_D_800A7344 = D_800AA024;
L1_D_800A735C = D_800AA03C;
L1_D_800A73BC = D_800AA09C;
L1_D_800A73D8 = D_800AA0B8;
L1_D_800A7418 = D_800AA0F8;
L1_D_800A7424 = D_800AA104;
L1_D_800A7474 = D_800AA154;
L1_D_800A747C = D_800AA15C;
L1_D_800A7498 = D_800AA178;
L1_D_800A74D4 = D_800AA1B4;
L1_D_800A74E0 = D_800AA1C0;
L1_D_800A7510 = D_800AA1F0;
L1_D_800A75D0 = D_800AA2B0;
L1_D_800A7678 = D_800AA358;
L1_D_800A76A0 = D_800AA380;
L1_D_800A76E4 = D_800AA3C4;
L1_D_800A76F8 = D_800AA3D8;
L1_D_800A770C = D_800AA3EC;
L1_D_800A7714 = D_800AA3F4;
L1_D_800A7728 = D_800AA408;
L1_D_800A773C = D_800AA41C;
L1_D_800A7750 = D_800AA430;
L1_D_800A775C = D_800AA43C;
L1_D_800A7778 = D_800AA458;
L1_D_800A7784 = D_800AA464;
L1_D_800A77B4 = D_800AA494;
L1_D_800A77CC = D_800AA4AC;
L1_D_800A79F0 = D_800AA6D0;
L1_D_800A7A0C = D_800AA6EC;
L1_D_800A7A24 = D_800AA704;
L1_D_800A7A30 = D_800AA710;
L1_D_800A7CF0 = D_800AAA10;
L1_D_800A7D08 = D_800AAA28;
L1_D_800A7D20 = D_800AAA40;
L1_D_800A7D44 = D_800AAA64;
L1_D_800A7D64 = D_800AAA84;
L1_D_800A7D74 = D_800AAAA8;
L1_D_800A7D90 = D_800AAAC4;
L1_D_800A7DC0 = D_800AAAF4;
L1_D_800A7DE8 = D_800AAB1C;
L1_D_800A7DF4 = D_800AAB28;
L1_D_800A7E14 = D_800AAB48;
L1_D_800A7E34 = D_800AAB68;
L1_D_800A7E50 = D_800AAB84;
L1_D_800A7E74 = D_800AABA8;
L1_D_800A7E90 = D_800AABC4;
L1_D_800A7EC4 = D_800AABF8;
L1_D_800A7EFC = D_800AAC30;
L1_D_800A7F1C = D_800AAC50;
L1_D_800A7F2C = D_800AAC60;
L1_D_800A7FF8 = D_800AAD2C;
L1_D_800A8000 = D_800AAD34;
L1_D_800A80A4 = D_800AADD8;
L1_D_800A80B0 = D_800AADE4;
L1_D_800A80BC = D_800AADF0;
L1_D_800A80C8 = D_800AADFC;
L1_D_800A811C = D_800AAE50;
L1_D_800A81F8 = D_800AAF2C;
L1_D_800A8210 = D_800AAF44;
L1_D_800A8224 = D_800AAF58;
L1_D_800A8238 = D_800AAF6C;
L1_D_800A824C = D_800AAF80;
L1_D_800A8260 = D_800AAF94;
L1_D_800A8274 = D_800AAFA8;
L1_D_800A8280 = D_800AAFB4;
L1_D_800A828C = D_800AAFC0;
L1_D_800A82B4 = D_800AAFE8;
L1_D_800A82DC = D_800AB010;
L1_D_800A8304 = D_800AB038;
L1_D_800A8308 = D_800AB03C;
L1_D_800A8310 = D_800AB044;
L1_D_800A8318 = D_800AB04C;
L1_D_800A8320 = D_800AB054;
L1_D_800A832C = D_800AB060;
L1_D_800A8340 = D_800AB074;
L1_D_800A8370 = D_800AB0A4;
L1_D_800A8390 = D_800AB0C4;
L1_D_800A83B0 = D_800AB0E4;
L1_D_800A83BC = D_800AB0F0;
L1_D_800A83C8 = D_800AB0FC;
L1_D_800A83D4 = D_800AB108;
L1_D_800A83E0 = D_800AB114;
L1_D_800A83E8 = D_800AB11C;
L1_D_800A83F0 = D_800AB124;
L1_D_800A8400 = D_800AB134;
L1_D_800A8410 = D_800AB144;
L1_D_800A8418 = D_800AB14C;
L1_D_800A8420 = D_800AB154;
L1_D_800A842C = D_800AB160;
L1_D_800A8444 = D_800AB178;
L1_D_800A844C = D_800AB180;
L1_D_800A8458 = D_800AB18C;
L1_D_800A8460 = D_800AB194;
L1_D_800A8464 = D_800AB198;
L1_D_800A8468 = D_800AB19C;
L1_D_800A8478 = D_800AB1AC;
L1_D_800A8484 = D_800AB1B8;
L1_D_800A8490 = D_800AB1C4;
L1_D_800A849C = D_800AB1D0;
L1_D_800A84A8 = D_800AB1DC;
L1_D_800A84B4 = D_800AB1E8;
L1_D_800A84B8 = D_800AB1EC;
L1_D_800A84D0 = D_800AB204;
L1_D_800A84D8 = D_800AB20C;
L1_D_800A84E4 = D_800AB218;
L1_D_800A84F0 = D_800AB224;
L1_D_800A84FC = D_800AB230;
L1_D_800A850C = D_800AB240;
L1_D_800A851C = D_800AB250;
L1_D_800A8528 = D_800AB25C;
L1_D_800A8534 = D_800AB268;
L1_D_800A8544 = D_800AB278;
L1_D_800A857C = D_800AB2B0;
L1_D_800A85C4 = D_800AB2F8;
L1_D_800A85D4 = D_800AB308;
L1_D_800A85F8 = D_800AB32C;
L1_D_800A86C0 = D_800AB424;
L1_D_800A86CC = D_800AB430;
L1_D_800A8764 = D_800AB4F0;
L1_D_800A87EC = D_800AB578;
L1_D_800A87F8 = D_800AB584;
L1_D_800A8808 = D_800AB594;
L1_D_800A880C = D_800AB598;
L1_D_800A8820 = D_800AB5AC;
L1_D_800A8858 = D_800AB5E4;
L1_D_800A887C = D_800AB608;
L1_D_800A8884 = D_800AB610;
L1_D_800A8894 = D_800AB620;
L1_D_800A88A4 = D_800AB630;
L1_D_800A88D0 = D_800AB65C;
L1_D_800A89A4 = D_800AB728;
L1_D_800A89F0 = D_800AB774;
L1_D_800A8A2C = D_800AB7B0;
L1_D_800A8AA8 = D_800AB82C;
L1_D_800A8C08 = D_800AB98C;
L1_D_800A8C28 = D_800AB9AC;
L1_D_800A8C48 = D_800AB9CC;
L1_D_800A8D14 = D_800ABA98;
L1_D_800A8D44 = D_800ABAB8;
L1_D_800A8D58 = D_800ABACC;
L1_D_800A8F94 = D_800ABC54;
L1_D_800A8FAC = D_800ABC6C;
L1_D_800A9390 = D_800AC050;
L1_D_800A9488 = D_800AC11C;
L1_D_800A9498 = D_800AC12C;
L1_D_800A9794 = D_800AC7C4;
L1_D_800A97BC = D_800AC7EC;
L1_D_800A98C8 = D_800AC978;
L1_D_800A99D0 = D_800ACA94;
L1_D_800A99EC = D_800ACAB0;
L1_D_800A9A08 = D_800ACACC;
L1_D_800A9A60 = D_800ACB24;
L1_D_800A9A84 = D_800ACB48;
L1_D_800A9AA8 = D_800ACB6C;
L1_D_800A9B6C = D_800ACC30;
L1_D_800A9B78 = D_800ACC3C;
L1_D_800A9BE8 = D_800ACCAC;
L1_D_800A9C08 = D_800ACCCC;
L1_D_800A9C78 = D_800ACD3C;
L1_D_800A9C8C = D_800ACD50;
L1_D_800A9CA0 = D_800ACD64;
L1_D_800A9CAC = D_800ACD70;
L1_D_800A9CC0 = D_800ACD84;
L1_D_800A9CC4 = D_800ACD88;
L1_D_800A9CDC = D_800ACDA0;
L1_D_800A9D00 = D_800ACDC4;
L1_D_800A9D18 = D_800ACDDC;
L1_D_800A9D30 = D_800ACDF4;
L1_D_800A9D44 = D_800ACE08;
L1_D_800A9D78 = D_800ACE3C;
L1_D_800A9D90 = D_800ACE54;
L1_D_800A9EB0 = D_800ACF74;
L1_D_800A9EC8 = D_800ACF8C;
L1_D_800A9EE0 = D_800ACFA4;
L1_D_800A9F10 = D_800ACFD4;
L1_D_800A9F2C = D_800ACFF0;
L1_D_800A9F44 = D_800AD008;
L1_D_800A9F60 = D_800AD024;
L1_D_800A9F80 = D_800AD044;
L1_D_800A9F8C = D_800AD050;
L1_D_800A9F9C = D_800AD060;
L1_D_800A9FC8 = D_800AD08C;
L1_D_800A9FD0 = D_800AD094;
L1_D_800AA000 = D_800AD0C4;
L1_D_800AA024 = D_800AD0E8;
L1_D_800AA044 = D_800AD108;
L1_D_800AA058 = D_800AD11C;
L1_D_800AA07C = D_800AD140;
L1_D_800AA09C = D_800AD160;
L1_D_800AA0B8 = D_800AD17C;
L1_D_800AA0BC = D_800AD180;
L1_D_800AA0BE = D_800AD182;
L1_D_800AA0C0 = D_800AD184;
L1_D_800AA0DC = D_800AD1A0;
L1_D_800AA110 = D_800AD1D4;
L1_D_800AA154 = D_800AD218;
L1_D_800AA170 = D_800AD234;
L1_D_800AA1B0 = D_800AD274;
L1_D_800AA1D0 = D_800AD294;
L1_D_800AA3C0 = D_800AD484;
L1_D_800AA3E8 = D_800AD4AC;
L1_D_800AA410 = D_800AD4D4;
L1_D_800AA438 = D_800AD4FC;
L1_D_800AA444 = D_800AD508;
L1_D_800AA46C = D_800AD530;
L1_D_800AA494 = D_800AD558;
L1_D_800AA4C0 = D_800AD584;
L1_D_800AA4F0 = D_800AD5B4;
L1_D_800AA518 = D_800AD5DC;
L1_D_800AA580 = D_800AD644;
L1_D_800AA590 = D_800AD654;
L1_D_800AA5A0 = D_800AD664;
L1_D_800AA5B4 = D_800AD678;
L1_D_800AA70C = D_800AD7D0;
L1_D_800AA71C = D_800AD7E0;
L1_D_800AA738 = D_800AD7FC;
L1_D_800AA744 = D_800AD808;
L1_D_800AA760 = D_800AD824;
L1_D_800AA774 = D_800AD838;
L1_D_800AA794 = D_800AD858;
L1_D_800AA79C = D_800AD860;
L1_D_800AA7A8 = D_800AD86C;
L1_D_800AA7B0 = D_800AD874;
L1_D_800AA7C0 = D_800AD884;
L1_D_800AA800 = D_800AD8C4;
L1_D_800AA80C = D_800AD8D0;
L1_D_800AA818 = D_800AD8DC;
L1_D_800AA830 = D_800AD8F4;
L1_D_800AA84C = D_800AD910;
L1_D_800AA8A0 = D_800AD964;
L1_D_800AA8C8 = D_800AD98C;
L1_D_800AA8E0 = D_800AD9A4;
L1_D_800AA8E8 = D_800AD9AC;
L1_D_800AA8F0 = D_800AD9B4;
L1_D_800AB540 = D_800AE608;
L1_D_800AB5E0 = D_800AE6A8;
L1_D_800AB5E4 = D_800AE6AC;
L1_D_800AB5E8 = D_800AE6B0;
L1_D_800AB5EC = D_800AE6B4;
L1_D_800AB5F0 = D_800AE6B8;
L1_D_800AB5F4 = D_800AE6BC;
L1_D_800AB5F8 = D_800AE6C0;
L1_D_800AB5FC = D_800AE6C4;
L1_D_800AB600 = D_800AE6C8;
L1_D_800AB604 = D_800AE6CC;
L1_D_800AB608 = D_800AE6D0;
L1_D_800AB60C = D_800AE6D4;
L1_D_800AB610 = D_800AE6D8;
L1_D_800AB614 = D_800AE6DC;
L1_D_800AB618 = D_800AE6E0;
L1_D_800AB744 = D_800AE80C;
L1_D_800AB754 = D_800AE81C;
L1_D_800AC284 = D_800AF34C;
L1_D_800AC384 = D_800AF44C;
L1_D_800AC38C = D_800AF454;
L1_D_800AC4C8 = D_800AF590;
L1_D_800AC4D0 = D_800AF598;
L1_D_800AC4D8 = D_800AF5A0;
L1_D_800AC4DC = D_800AF5A4;
L1_D_800AC4E0 = D_800AF5A8;
L1_D_800AC4E4 = D_800AF5AC;
L1_D_800AC4E8 = D_800AF5B0;
L1_D_800AC4EC = D_800AF5B4;
L1_D_800AC54C = D_800AF614;
L1_D_800AC550 = D_800AF618;
L1_D_800AE940 = D_800B1F30;
L1_D_800AE9B8 = D_800B1FA8;
L1_D_800AE9C0 = D_800B1FB0;
L1_D_800AEB1A = D_800B210A;
L1_D_800AEC38 = D_800B2228;
L1_D_800AEDA0 = D_800B2390;
L1_D_800AEDA4 = D_800B2394;
L1_D_800AEDA8 = D_800B2398;
L1_D_800AEDAC = D_800B239C;
L1_D_800AEDB0 = D_800B23A0;
L1_D_800AEDB4 = D_800B23A4;
L1_D_800AEDB8 = D_800B23A8;
L1_D_800AEDBC = D_800B23AC;
L1_D_800AEDD4 = D_800B23C4;
L1_D_800AEDD8 = D_800B23C8;
L1_D_800AEDDC = D_800B23CC;
L1_D_800AEDE0 = D_800B23D0;
L1_D_800AEDE4 = D_800B23D4;
L1_D_800AEDE8 = D_800B23D8;
L1_D_800AEDEC = D_800B23DC;
L1_D_800AEDF0 = D_800B23E0;
L1_D_800AEE10 = D_800B2400;
L1_D_800AEE14 = D_800B2404;
L1_D_800AF620 = D_800B2C10;
L1_D_800AF624 = D_800B2C14;
L1_D_800AF6A4 = D_800B2C94;
L1_D_800AF6A5 = D_800B2C95;
L1_D_800AF6A8 = D_800B2C98;
L1_D_800AFEA8 = D_800B3498;
L1_D_800AFEAC = D_800B349C;
L1_D_800AFEB0 = D_800B34A0;
L1_D_800AFEB5 = D_800B34A5;
L1_D_800AFEB6 = D_800B34A6;
L1_D_800AFEB7 = D_800B34A7;
L1_D_800AFEB8 = D_800B34A8;
L1_D_800AFEB9 = D_800B34A9;
L1_D_800AFEBC = D_800B34AC;
L1_D_800AFEC0 = D_800B34B0;
L1_D_800AFEC8 = D_800B34B8;
L1_D_800AFF2C = D_800B351C;
L1_D_800AFF48 = D_800B3538;
L1_D_800AFF4C = D_800B353C;
L1_D_800AFF58 = D_800B3548;
L1_D_800AFF5C = D_800B354C;
L1_D_800AFF60 = D_800B3550;
L1_D_800AFF64 = D_800B3554;
L1_D_800AFF68 = D_800B3558;
L1_D_800AFF70 = D_800B3560;
L1_D_800AFF78 = D_800B3568;
L1_D_800AFF80 = D_800B3570;
L1_D_800AFF84 = D_800B3574;
L1_D_800AFF88 = D_800B3578;
L1_D_800AFF8C = D_800B357C;
L1_D_800AFF94 = D_800B3584;
L1_D_800AFF98 = D_800B3588;
L1_D_800AFFA4 = D_800B3594;
L1_D_800AFFA8 = D_800B3598;
L1_D_800AFFAC = D_800B359C;
L1_D_800AFFB0 = D_800B35A0;
L1_D_800AFFB4 = D_800B35A4;
L1_D_800AFFC0 = D_800B35B0;
L1_D_800AFFC4 = D_800B35B4;
L1_D_800AFFC8 = D_800B35B8;
L1_D_800AFFCC = D_800B35BC;
L1_D_800B0014 = D_800B3604;
L1_D_800B0018 = D_800B3608;
L1_D_800B0064 = D_800B3654;
L1_D_800B0066 = D_800B3656;
L1_D_800B0068 = D_800B3658;
L1_D_800B0070 = D_800B3660;
L1_D_800B0084 = D_800B3674;
L1_D_800B008C = D_800B367C;
L1_D_800B0094 = D_800B3684;
L1_D_800B00A0 = D_800B3690;
L1_D_800B0108 = D_800B36F8;
L1_D_800B05AC = D_800B3FEC;
L1_D_800B05B0 = D_800B3FF0;
L1_D_800B077C = D_800B41BC;
L1_D_800B0794 = D_800B41D4;
L1_D_800B0798 = D_800B41D8;
L1_D_800B07A4 = D_800B41E4;
L1_D_800B07A8 = D_800B41E8;
L1_D_800B07AC = D_800B41EC;
L1_D_800B07B0 = D_800B41F0;
L1_D_800B07B4 = D_800B41F4;
L1_D_800B07B8 = D_800B41F8;
L1_D_800B07BC = D_800B41FC;
L1_D_800B07C0 = D_800B4200;
L1_D_800B07C4 = D_800B4204;
L1_D_800B0804 = D_800B4244;
L1_D_800B0808 = D_800B4248;
L1_D_800B0848 = D_800B4288;
L1_D_800B0868 = D_800B42A8;
L1_D_800B086C = D_800B42AC;
L1_D_800B087C = D_800B42BC;
L1_D_800B0A94 = D_800B44D4;
L1_D_800B0A98 = D_800B44D8;
L1_D_800B0AA0 = D_800B44E0;
L1_D_800B0AA4 = D_800B44E4;
L1_D_800B0AA8 = D_800B44E8;
L1_D_800B0AB4 = D_800B44F4;
L1_D_800B0AB8 = D_800B44F8;
L1_D_800B0AC0 = D_800B4500;
L1_D_800B0AC8 = D_800B4508;
L1_D_800B0ACC = D_800B450C;
L1_D_800B0AD0 = D_800B4510;
L1_D_800B0AD4 = D_800B4514;
L1_D_800B0ADC = D_800B451C;
L1_D_800B0AE0 = D_800B4520;
L1_D_800B0AE4 = D_800B4524;
L1_D_800B0AE8 = D_800B4528;
L1_D_800B0AEC = D_800B452C;
L1_D_800B0AFC = D_800B453C;
L1_D_800B0B10 = D_800B4550;
L1_D_800B0B14 = D_800B4554;
L1_D_800B0B54 = D_800B4594;
L1_D_800B0B58 = D_800B4598;
L1_D_800B0B64 = D_800B45A4;
L1_D_800B0B68 = D_800B45A8;
L1_D_800B0B6A = D_800B45AA;
L1_D_800B0B6C = D_800B45AC;
L1_D_800B0B70 = D_800B45B0;
L1_D_800B0B72 = D_800B45B2;
L1_D_800B0B78 = D_800B45B8;
L1_D_800B0B80 = D_800B45C0;
L1_D_800B0B84 = D_800B45C4;
L1_D_800B0B88 = D_800B45C8;
L1_D_800B0B8C = D_800B45CC;
L1_D_800B0B9C = D_800B45DC;
L1_D_800B0BA0 = D_800B45E0;
L1_D_800B0BB4 = D_800B45F4;
L1_D_800B0BB8 = D_800B45F8;
L1_D_800B0BBC = D_800B45FC;
L1_D_800B0BC0 = D_800B4600;
L1_D_800B0C10 = D_800B4650;
L1_D_800B0C30 = D_800B4670;
L1_D_800B0C38 = D_800B4678;
L1_D_800B0C58 = D_800B4698;
L1_D_800B0C5C = D_800B469C;
L1_D_800B0C60 = D_800B46A0;
L1_D_800B0C64 = D_800B46A4;
L1_D_800B0C68 = D_800B46A8;
L1_D_800B0C74 = D_800B46B4;
L1_D_800B0C84 = D_800B46C4;
L1_D_800B0C8C = D_800B46CC;
L1_D_800B0C94 = D_800B46D4;
L1_D_800B0C98 = D_800B46D8;
L1_D_800B0C9C = D_800B46DC;
L1_D_800B0CA0 = D_800B46E0;
L1_D_800B0CA4 = D_800B46E4;
L1_D_800B0CA8 = D_800B46E8;
L1_D_800B0CAC = D_800B46EC;
L1_D_800B0CB0 = D_800B46F0;
L1_D_800B0CC4 = D_800B4704;
L1_D_800B0D50 = D_800B4790;
L1_D_800B0D94 = D_800B47D4;
L1_D_800B0D9C = D_800B47DC;
L1_D_800B0DA0 = D_800B47E0;
L1_D_800B0DA4 = D_800B47E4;
L1_D_800B0DA8 = D_800B47E8;
L1_D_800B0DAC = D_800B47EC;
L1_D_800B0DB0 = D_800B47F0;
L1_D_800B0DB4 = D_800B47F4;
L1_D_800B0DB8 = D_800B47F8;
L1_D_800B0DBC = D_800B47FC;
L1_D_800B0DC0 = D_800B4800;
L1_D_800B0DC4 = D_800B4804;
L1_D_800B0DC8 = D_800B4808;
L1_D_800B0DCC = D_800B480C;
L1_D_800B0DD4 = D_800B4814;
L1_D_800B0DD8 = D_800B4818;
L1_D_800B0DDC = D_800B481C;
L1_D_800B0DE4 = D_800B4824;
L1_D_800B0E34 = D_800B4874;
L1_D_800B0E36 = D_800B4876;
L1_D_800B0E40 = D_800B4880;
L1_D_800B0E48 = D_800B4888;
L1_D_800B0E54 = D_800B4894;
L1_D_800B0E58 = D_800B4898;
L1_D_800B0E5E = D_800B489E;
L1_D_800B0E5F = D_800B489F;
L1_D_800B0E62 = D_800B48A2;
L1_D_800B0E63 = D_800B48A3;
L1_D_800B0E8C = D_800B48CC;
L1_D_800B0EA0 = D_800B48E0;
L1_D_800B0EFC = D_800B493C;
L1_D_800B8EFC = D_800BC93C;
L1_D_800B8F24 = D_800BC964;
L1_D_800B8F28 = D_800BC968;
L1_D_800B8F68 = D_800BC9A8;
L1_D_800B8F88 = D_800BC9C8;
L1_D_800B8FB0 = D_800BC9F0;
L1_D_800B8FB4 = D_800BC9F4;
L1_D_800C1C54 = D_800C5694;
L1_D_800CA8F4 = D_800CE334;
L1_D_800D28F4 = D_800D6334;
L1_D_800D2AF4 = D_800D6534;
L1_D_800D2AF8 = D_800D6538;
L1_D_800D2AFC = D_800D653C;
L1_D_800D2BC4 = D_800D6604;
L1_D_800D2BE8 = D_800D6628;
L1_D_800D2BEC = D_800D662C;
L1_D_800D2BF0 = D_800D6630;
L1_D_800D2D30 = D_800D6770;
L1_D_800D2E70 = D_800D68B0;
L1_D_800D2E74 = D_800D68B4;
L1_D_800D2E84 = D_800D68C4;
L1_D_800D2E90 = D_800D68D0;
L1_D_800D2F48 = D_800D6988;
L1_D_800D2F68 = D_800D69A8;
L1_D_800D2F90 = D_800D69D0;
L1_D_800D2FA4 = D_800D69E4;
L1_D_800D2FAC = D_800D69EC;
L1_D_800D2FB0 = D_800D69F0;
L1_D_800D2FC0 = D_800D6A00;
L1_D_800D2FC4 = D_800D6A04;
L1_D_800D2FF4 = D_800D6A34;
L1_D_800D305C = D_800D6A9C;
L1_D_800D3068 = D_800D6AA8;
L1_D_800D308C = D_800D6ACC;
L1_D_800D30C0 = D_800D6B00;
L1_D_800D30D4 = D_800D6B14;
L1_D_800D30D8 = D_800D6B18;
L1_D_800D31B8 = D_800D6BF8;
L1_D_800D31C0 = D_800D6C00;
L1_D_800D31D0 = D_800D6C10;
L1_D_800D3238 = D_800D6C78;
L1_D_800D3288 = D_800D6CC8;
L1_D_800D3FA8 = D_800D79E8;
L1_D_800D3FAC = D_800D79EC;
L1_D_800D3FB0 = D_800D79F0;
L1_D_800D3FD4 = D_800D7A14;
L1_D_800D3FD8 = D_800D7A18;
L1_D_800D3FE0 = D_800D7A20;
L1_D_800D3FE4 = D_800D7A24;
L1_D_800D3FEC = D_800D7A2C;
L1_D_800D3FF0 = D_800D7A30;
L1_D_800D4050 = D_800D7A90;
L1_D_800D4058 = D_800D7A98;
L1_D_800D4068 = D_800D7AA8;
L1_D_800D406C = D_800D7AAC;
L1_D_800D4070 = D_800D7AB0;
L1_D_800D4074 = D_800D7AB4;
L1_D_800D4080 = D_800D7AC0;
L1_D_800D40D8 = D_800D7B18;
L1_D_800D40F8 = D_800D7B38;
L1_D_800D40FC = D_800D7B3C;
L1_D_800D4100 = D_800D7B40;
L1_D_800D4104 = D_800D7B44;
L1_D_800D4108 = D_800D7B48;
L1_D_800D410C = D_800D7B4C;
L1_D_800D4110 = D_800D7B50;
L1_D_800D4114 = D_800D7B54;
L1_D_800D424C = D_800D7C8C;
L1_D_800D4250 = D_800D7C90;
L1_D_800D4384 = D_800D7DC4;
L1_D_800D4385 = D_800D7DC5;
L1_D_800D4386 = D_800D7DC6;
L1_D_800D4387 = D_800D7DC7;
L1_D_800D4388 = D_800D7DC8;
L1_D_800D4389 = D_800D7DC9;
L1_D_800D438A = D_800D7DCA;
L1_D_800D438B = D_800D7DCB;
L1_D_800D438C = D_800D7DCC;
L1_D_800D438D = D_800D7DCD;
L1_D_800D438E = D_800D7DCE;
L1_D_800D438F = D_800D7DCF;
L1_D_800D4390 = D_800D7DD0;
L1_D_800D43A8 = D_800D7DE8;
L1_D_800D43AC = D_800D7DEC;
L1_D_800D43C0 = D_800D7E00;
L1_D_800D43C4 = D_800D7E04;
L1_D_800D43CC = D_800D7E0C;
L1_D_800D43D0 = D_800D7E10;
L1_D_800D43E4 = D_800D7E24;
L1_D_800D43F0 = D_800D7E30;
L1_D_800D43F4 = D_800D7E34;
L1_D_800D43F8 = D_800D7E38;
L1_D_800D4400 = D_800D7E40;
L1_D_800D4404 = D_800D7E44;
L1_D_800D440C = D_800D7E4C;
L1_D_800D4410 = D_800D7E50;
L1_D_800D4414 = D_800D7E54;
L1_D_800D4424 = D_800D7E64;
L1_D_800D4440 = D_800D7E80;
L1_D_800D4444 = D_800D7E84;
L1_D_800D4450 = D_800D7EA8;
L1_D_800D4454 = D_800D7EAC;
L1_D_800D4458 = D_800D7EB0;
L1_D_800D445C = D_800D7EB4;
L1_D_800D4464 = D_800D7EBC;
L1_D_800D4468 = D_800D7EC0;
L1_D_800D446C = D_800D7EC4;
L1_D_800D4474 = D_800D7ED0;
L1_D_800D4484 = D_800D7EE4;
L1_D_800D4564 = D_800D7FC4;
L1_D_800D45C4 = D_800D8024;
L1_D_800D45F4 = D_800D8054;
L1_D_800D4688 = D_800D80E8;
L1_D_800D46D8 = D_800D8138;
L1_D_800D4958 = D_800D83B8;
L1_D_800D4984 = D_800D83E4;
L1_D_800D5DA4 = D_800D9804;
L1_D_800D5E80 = D_800D98E0;
L1_D_800D5ED0 = D_800D9930;
L1_D_800D5ED8 = D_800D9938;
L1_D_800D5EF0 = D_800D9950;
L1_D_800D5F40 = D_800D99A0;
L1_D_800D5F48 = D_800D99A8;
L1_D_800D74F8 = D_800DAF58;
L1_D_800D74FC = D_800DAF5C;
L1_D_800D7500 = D_800DAF60;
L1_D_800D7550 = D_800DAFB0;
L1_D_800D7554 = D_800DAFB4;
L1_D_800D7588 = D_800DAFE8;
L1_D_800D77B8 = D_800DB218;
L1_D_800D77E8 = D_800DB248;
L1_D_800D7838 = D_800DB298;
L1_D_800D7888 = D_800DB2E8;
L1_D_800D78D8 = D_800DB338;
L1_D_800D7930 = D_800DB390;
L1_D_800D7980 = D_800DB3E0;
L1_D_800D79D0 = D_800DB430;
L1_D_800D79D4 = D_800DB434;
L1_D_800D7A1C = D_800DB47C;
L1_D_800D7A20 = D_800DB480;
L1_D_800D7AB8 = D_800DB518;
L1_D_800D7B08 = D_800DB568;
L1_D_800D7BE8 = D_800DB648;
L1_D_800D7BF0 = D_800DB650;
L1_D_800D7C24 = D_800DB684;
L1_D_800D7C64 = D_800DB6C4;
L1_D_800D7CB4 = D_800DB714;
L1_D_800D7CB8 = D_800DB718;
L1_D_800D7D08 = D_800DB768;
L1_D_800D7DF8 = D_800DB858;
L1_D_800D7DFC = D_800DB85C;
L1_D_800D7E9C = D_800DB8FC;
L1_D_800D7EEC = D_800DB94C;
L1_D_800D7FDC = D_800DBA3C;
L1_D_800D811C = D_800DBB7C;
L1_D_800D8138 = D_800DBB98;
L1_D_800D8150 = D_800DBBB0;
L1_D_800D8154 = D_800DBBB4;
L1_D_800D861C = D_800DC07C;
L1_D_800D8620 = D_800DC080;
L1_D_800D8624 = D_800DC084;
L1_D_800D8674 = D_800DC0D4;
L1_D_800D86C4 = D_800DC124;
L1_D_800D86C8 = D_800DC128;
L1_D_800D86DC = D_800DC13C;
L1_D_800D86E0 = D_800DC140;
L1_D_800D86E4 = D_800DC144;
L1_D_800D86E8 = D_800DC148;
L1_D_800D8BE8 = D_800DC648;
L1_D_800D8C7C = D_800DC6DC;
L1_D_800D8C90 = D_800DC6F0;
L1_D_800D8C94 = D_800DC6F4;
L1_D_800D8E74 = D_800DC8D4;
L1_D_800D8E8C = D_800DC8EC;
L1_D_800D8EA4 = D_800DC904;
L1_D_800D8EA8 = D_800DC908;
L1_D_800D8EE8 = D_800DC948;
L1_D_800D8FE8 = D_800DCA48;
L1_D_800D8FF8 = D_800DCA58;
L1_D_800D90C0 = D_800DCB20;
L1_D_800D911C = D_800DCB7C;
L1_D_800D91E4 = D_800DCC44;
L1_D_800D91E7 = D_800DCC47;
L1_D_800D91E8 = D_800DCC48;
L1_D_800D91F0 = D_800DCC50;
L1_D_800D91F8 = D_800DCC58;
L1_D_800D91FC = D_800DCC5C;
L1_D_800D9200 = D_800DCC60;
L1_D_800D9208 = D_800DCC68;
L1_D_800D920C = D_800DCC6C;
L1_D_800D9210 = D_800DCC70;
L1_D_800D9214 = D_800DCC74;
L1_D_800D9218 = D_800DCC78;
L1_D_800D9232 = D_800DCC92;
L1_D_800D9248 = D_800DCCA8;
L1_D_800D9268 = D_800DCCC8;
L1_D_800D9278 = D_800DCCD8;
L1_D_800DA270 = D_800DDCD0;
L1_D_800DA5C0 = D_800DE020;
L1_D_800DB884 = D_800E05A4;
L1_D_800DCB44 = D_800E1864;
L1_D_800DCB4C = D_800E186C;
L1_D_800DD7F4 = D_800E2514;
L1_D_800DDC44 = D_800E2518;
L1_D_800DDC48 = D_800E251C;
L1_D_800DDC4C = D_800E2520;
L1_D_800DDC50 = D_800E2524;
L1_D_800DDC54 = D_800E2528;
L1_D_800DDC58 = D_800E252C;
L1_D_800DDC5C = D_800E2530;
L1_D_800DDC60 = D_800E2534;
L1_D_800DDC64 = D_800E2538;
L1_D_800DDC68 = D_800E253C;
L1_D_800DDC6C = D_800E2540;
L1_D_800DDCC0 = D_800E2594;
L1_D_800DDCC4 = D_800E2598;
L1_D_800DDCC8 = D_800E259C;
L1_D_800DDCCC = D_800E25A0;
L1_D_800DDD8C = D_800E2660;
L1_D_800DDD90 = D_800E2664;
L1_D_800DDD94 = D_800E2668;
L1_D_800DDD98 = D_800E266C;
L1_D_800DDDA0 = D_800E2674;
L1_D_800DDDA4 = D_800E2678;
L1_D_800DDDA8 = D_800E267C;
L1_D_800DDDAC = D_800E2680;
L1_D_800DDDB0 = D_800E2684;
L1_D_800DDDB4 = D_800E2688;
L1_D_800DDDB8 = D_800E268C;
L1_D_800DDDBC = D_800E2690;
L1_D_800DDDCC = D_800E26A0;
L1_D_800DDDDC = D_800E26B0;
L1_D_800DDDEC = D_800E26C0;
L1_D_800DDE04 = D_800E26D8;
L1_D_800DDE08 = D_800E26DC;
L1_D_800DDE10 = D_800E26E4;
L1_D_800DDE30 = D_800E2704;
L1_D_800DDE34 = D_800E2708;
L1_D_800DDEE0 = D_800E27B4;
L1_D_800DDEE4 = D_800E27B8;
L1_D_800DDEE8 = D_800E27BC;
L1_D_800DDEEC = D_800E27C0;
L1_D_800DDEF0 = D_800E27C4;
L1_D_800DDF08 = D_800E27DC;
L1_D_800DDF24 = D_800E27F8;
L1_D_800DDFEC = D_800E28C0;
L1_D_800DE000 = D_800E28D4;
L1_D_800DE004 = D_800E28D8;
L1_D_800DE018 = D_800E28EC;
L1_D_800DE0C4 = D_800E2998;
L1_D_800DE0C8 = D_800E299C;
L1_D_800DE0D4 = D_800E29A8;
L1_D_800DE0D8 = D_800E29AC;
L1_D_800DE0DC = D_800E29B0;
L1_D_800DE0E0 = D_800E29B4;
L1_D_800DE0E4 = D_800E29B8;
L1_D_800DE0E8 = D_800E29CC;
L1_D_800DE8E8 = D_800E31CC;
L1_D_800DF0E8 = D_800E39CC;
L1_D_800DF0EC = D_800E39D0;
L1_D_800DF0F0 = D_800E39D4;
L1_D_800DF0F8 = D_800E39DC;
L1_D_800DF10C = D_800E39F0;
L1_D_800DF12C = D_800E3A10;
L1_D_800DF1F4 = D_800E3AD8;
L1_D_800DF200 = D_800E3AE4;
L1_D_800DF540 = D_800E3E24;
L1_D_800DF5B8 = D_800E3E9C;
L1_D_800DF684 = D_800E3F68;
L1_D_800E02B4 = D_800E4BB4;
L1_D_800E23D4 = D_800E6F2C;
L1_D_800E23E8 = D_800E6F4C;
L1_D_800E2438 = D_800E6F8C;
L1_D_800E2448 = D_800E6F9C;
L1_D_800E2DA8 = D_800E78FC;
L1_D_800E2DBC = D_800E7910;
L1_D_800E2DE0 = D_800E7934;
L1_D_800E2DE4 = D_800E7938;
L1_D_800E2DF4 = D_800E7948;
L1_D_800E2E44 = D_800E7998;
L1_D_800E2E48 = D_800E799C;
L1_D_800E2E4C = D_800E79A0;
L1_D_800E2F2C = D_800E7A80;
L1_D_800E2F38 = D_800E7A8C;
L1_D_800E2F3C = D_800E7A90;
L1_D_800E2F54 = D_800E7AA8;
L1_D_800E2F58 = D_800E7AAC;
L1_D_800E2F5C = D_800E7AB0;
L1_D_800F0F5C = D_800F62B0;
L1_D_800F0F80 = D_800F62D4;
L1_D_800F1180 = D_800F661C;
L1_D_800F11A0 = D_800F663C;
L1_D_800F11D0 = D_800F666C;
L1_D_800F11F0 = D_800F668C;
L1_D_800F128C = D_800F6728;
L1_D_800F1294 = D_800F6730;
L1_D_800F12D4 = D_800F6770;
L1_D_800F12EC = D_800F6788;
L1_D_800F12F4 = D_800F6790;
L1_D_800F1314 = D_800F67B0;
L1_D_800F1354 = D_800F67F0;
L1_D_800F136C = D_800F6808;
L1_D_800F1374 = D_800F6810;
L1_D_800F138C = D_800F6828;
L1_D_800F1398 = D_800F6834;
L1_D_800F13A8 = D_800F6844;
L1_D_800F1DCC = D_800F7268;
L1_D_800F25D8 = D_800F7A74;
L1_D_800F2FBC = D_800F8458;
L1_D_800F3848 = D_800F8CE4;
L1_D_800F3B48 = D_800F8FE4;
L1_D_800F3E98 = D_800F9334;
L1_D_800F40DC = D_800F9578;
L1_D_800F40E0 = D_800F957C;
L1_D_800F40F8 = D_800F9594;
L1_D_800F40FC = D_800F9598;
L1_D_800F4114 = D_800F95B0;
L1_D_800F413C = D_800F95D8;
L1_D_800F415C = D_800F95F8;
L1_D_800F4264 = D_800F9700;
L1_D_800F4268 = D_800F9704;
L1_D_800F426C = D_800F9708;
L1_D_800F4270 = D_800F970C;
L1_D_800F5A64 = D_800FAF00;
L1_D_800F5A65 = D_800FAF01;
L1_D_800F5A66 = D_800FAF02;
L1_D_800F5A68 = D_800FAF04;
L1_D_800F5A6C = D_800FAF08;
L1_D_800F6040 = D_800FB4DC;
L1_D_800F6064 = D_800FB500;
L1_D_800F6068 = D_800FB504;
L1_D_800F606C = D_800FB508;
L1_D_800F6070 = D_800FB50C;
L1_D_800F7664 = D_800FCB00;
L1_D_800F7E64 = D_800FD300;
L1_D_800F7EC4 = D_800FD360;
L1_D_800F7EC8 = D_800FD364;
L1_D_800F7EC9 = D_800FD365;
L1_D_800F7ECA = D_800FD366;
L1_D_800F7ECC = D_800FD368;
L1_D_800F7ECE = D_800FD36A;
L1_D_800F7ED0 = D_800FD36C;
L1_D_800F7ED2 = D_800FD36E;
L1_D_800F7EE4 = D_800FD380;
L1_D_800F7EE8 = D_800FD384;
L1_D_800F7EEC = D_800FD388;
L1_D_800F7EF4 = D_800FD390;
L1_D_800F7EF8 = D_800FD394;
L1_D_800F7EFC = D_800FD398;
L1_D_800F7F00 = D_800FD39C;
L1_D_800F7F04 = D_800FD3A0;
L1_D_800F7F08 = D_800FD3A4;
L1_D_800F7F10 = D_800FD3AC;
L1_D_800F7F1C = D_800FD3B8;
L1_D_800F7F64 = D_800FD400;
L1_D_800F7F68 = D_800FD404;
L1_D_800F7F6C = D_800FD408;
L1_D_800F7F70 = D_800FD40C;
L1_D_800F7F74 = D_800FD410;
L1_D_800F7F81 = D_800FD41D;
L1_D_800F7F84 = D_800FD420;
L1_D_800F7FCC = D_800FD468;
L1_D_800F8014 = D_800FD4B0;
L1_D_800F81F4 = D_800FD690;
L1_D_800F81F8 = D_800FD694;
L1_D_800F8204 = D_800FD6A0;
L1_D_800F8208 = D_800FD6A4;
L1_D_800F8214 = D_800FD6B0;
L1_D_800F8614 = D_800FDAB0;
L1_D_800FC614 = D_80101AB0;
L1_D_800FC616 = D_80101AB2;
L1_D_800FC624 = D_80101AC0;
L1_D_800FC628 = D_80101AC4;
L1_D_800FC62C = D_80101AC8;
L1_D_800FC630 = D_80101ACC;
L1_D_800FC640 = D_80101ADC;
L1_D_800FC644 = D_80101AE0;
L1_D_800FC648 = D_80101AE4;
L1_D_800FC650 = D_80101AEC;
L1_D_800FC654 = D_80101AF0;
L1_D_800FC658 = D_80101AF4;
L1_D_800FC65C = D_80101AF8;
L1_D_800FC660 = D_80101AFC;
L1_D_800FC664 = D_80101B00;
L1_D_800FC670 = D_80101B0C;
L1_D_800FC67C = D_80101B18;
L1_D_800FC6A0 = D_80101B3C;
L1_D_800FC6B0 = D_80101B4C;
L1_D_800FC6C0 = D_80101B5C;
L1_D_800FC780 = D_80101C1C;
L1_D_800FC784 = D_80101C20;
L1_D_800FC788 = D_80101C24;
L1_D_800FC790 = D_80101C2C;
L1_D_800FC794 = D_80101C30;
L1_D_800FCF94 = D_80102430;
L1_D_800FCF98 = D_80102434;
L1_D_800FCF9C = D_80102438;
L1_D_800FCFA0 = D_8010243C;
L1_D_800FCFA4 = D_80102440;
L1_D_800FCFA8 = D_80102444;
L1_D_800FCFAC = D_80102448;
L1_D_800FCFB0 = D_8010244C;
L1_D_800FCFB4 = D_80102450;
L1_D_800FD038 = D_801024D4;
L1_D_800FD0B8 = D_80102554;
L1_D_800FD0F8 = D_80102594;
L1_D_800FD138 = D_801025D4;
L1_D_800FD178 = D_80102614;
L1_D_800FD17C = D_80102618;
L1_D_800FD190 = D_8010262C;
L1_D_800FD191 = D_8010262D;
L1_D_800FD195 = D_80102631;
L1_D_800FD197 = D_80102633;
L1_D_800FD19A = D_80102636;
L1_D_800FD19B = D_80102637;
L1_D_800FD19F = D_8010263B;
L1_D_800FD1A1 = D_8010263D;
L1_D_800FD1A2 = D_8010263E;
L1_D_800FD1A4 = D_80102640;
L1_D_800FD1A6 = D_80102640 + 0x2;
L1_D_800FD1A8 = D_80102644;
L1_D_800FD1AC = D_80102648;
L1_D_800FD1BC = D_80102658;
L1_D_800FD1C0 = D_8010265C;
L1_D_800FD1C4 = D_80102660;
L1_D_800FD1C8 = D_80102664;
L1_D_800FD208 = D_801026A4;
L1_D_800FD248 = D_801026E4;
L1_D_800FD24C = D_801026E8;
L1_D_800FD254 = D_801026F0;
L1_D_800FD258 = D_801026F4;
L1_D_800FD25C = D_801026F8;
L1_D_800FD260 = D_801026FC;
L1_D_800FD264 = D_80102700;
L1_D_800FD266 = D_80102702;
L1_D_800FD268 = D_80102704;
L1_D_800FD26A = D_80102706;
L1_D_800FD26C = D_80102708;
L1_D_800FD3E4 = D_80102880;
L1_D_800FD3E8 = D_80102884;
L1_D_800FD400 = D_8010289C;
L1_D_800FD440 = D_801028DC;
L1_D_800FD442 = D_801028DE;
L1_D_800FD444 = D_801028E0;
L1_D_800FD446 = D_801028E2;
L1_D_800FD448 = D_801028E4;
L1_D_800FD44A = D_801028E6;
L1_D_800FD44C = D_801028E8;
L1_D_800FD44E = D_801028EA;
L1_D_800FD450 = D_801028EC;
L1_D_800FD452 = D_801028EE;
L1_D_800FD454 = D_801028F0;
L1_D_800FD456 = D_801028F2;
L1_D_800FD458 = D_801028F4;
L1_D_800FD45A = D_801028F6;
L1_D_800FD45D = D_801028F9;
L1_D_800FD45E = D_801028FA;
L1_D_800FD460 = D_801028FC;
L1_D_800FD462 = D_801028FE;
L1_D_800FD464 = D_80102900;
L1_D_800FD466 = D_80102902;
L1_D_800FD46A = D_80102906;
L1_D_800FD46C = D_80102908;
L1_D_800FD46E = D_8010290A;
L1_D_800FD470 = D_8010290C;
L1_D_800FD472 = D_8010290E;
L1_D_800FD476 = D_80102912;
L1_D_800FD824 = D_80102CC0;
L1_D_800FD980 = D_80102E1C;
L1_D_800FD984 = D_80102E20;
L1_D_800FD988 = D_80102E24;
L1_D_800FD98C = D_80102E28;
L1_D_800FD990 = D_80102E2C;
L1_D_800FD994 = D_80102E30;
L1_D_800FD998 = D_80102E34;
L1_D_800FD99C = D_80102E38;
L1_D_800FD9A0 = D_80102E3C;
L1_D_800FD9A4 = D_80102E40;
L1_D_800FD9AC = D_80102E48;
L1_D_800FD9C0 = D_80102E5C;
L1_D_800FD9C8 = D_80102E64;
L1_D_800FD9D0 = D_80102E6C;
L1_D_800FD9D8 = D_80102E74;
L1_D_800FD9DC = D_80102E78;
L1_D_800FD9E0 = D_80102E7C;
L1_D_800FD9F4 = D_80102E90;
L1_D_800FDA04 = D_80102EA0;
L1_D_800FDA08 = D_80102EA4;
L1_D_800FDA0C = D_80102EA8;
L1_D_800FDA24 = D_80102EC0;
L1_D_800FDB2C = D_80102FC8;
L1_DebugPage_ArtProfile = func_800417C4;
func_80041ABC = L1_DebugPage_Camera;
L1_DebugPage_ContourMask = func_800759DC;
L1_DebugPage_FPWeapon = func_8007B424;
L1_DebugPage_Framerate = func_80041800;
L1_DebugPage_Loadpoint = func_80031DC4;
func_8004184C = L1_DebugPage_ObjectCount;
L1_DebugPage_Profile = func_80041788;
func_8002FD54 = L1_DebugScreen_DrawPage;
L1_DeliverEvent = func_80095C34;
func_80032C54 = L1_DevMenu_Draw;
func_800329FC = L1_DevMenu_HandleInput;
func_80032E1C = L1_DevMenu_Init;
L1_DisableEvent = func_8009CBE0;
L1_EVENT_OBJ_11C = func_80087B08;
L1_EVENT_OBJ_90 = func_80087A7C;
L1_EVENT_OBJ_CC = func_80087AB8;
L1_EVENT_OBJ_F4 = func_80087AE0;
L1_EnableEvent = func_80080D68;
L1_FlushCache = func_8009CEF0;
L1_FntFlush = func_80089BDC;
L1_FntLoad = func_80089884;
L1_FntOpen = func_80089924;
L1_FntPrint = func_80089EF8;
L1_GPU_cw = func_80090618;
L1_GS_001_OBJ_1F8 = func_80086954;
L1_GS_001_OBJ_74 = func_800867D0;
L1_GS_107_OBJ_4B8 = func_80078D58;
L1_GS_107_OBJ_51C = func_80078DBC;
L1_GetClut = func_80083C94;
L1_GetTPage = func_80083D14;
func_8002F770 = L1_Gfx_Init;
L1_GsClearOt = func_8008B064;
L1_GsDefDispBuff = func_8008C344;
L1_GsGetActiveBuff = func_80086CCC;
L1_GsGetHeadpUnit = func_80090350;
L1_GsGetLs = func_8007C1F4;
L1_GsGetLsUnit = func_8008EABC;
L1_GsGetLwUnit = func_8008ED8C;
L1_GsGetTimInfo = func_8008DEE4;
L1_GsInit3D = func_8008C2C4;
L1_GsInitGraph = func_8008675C;
L1_GsInitGraph2 = func_800868EC;
L1_GsInitVcount = func_80087BCC;
L1_GsLinkAnim = func_8008FFE4;
L1_GsLinkObject4 = func_80087C0C;
L1_GsMapCoordUnit = func_8008F5EC;
L1_GsMapModelingData = func_8008D824;
L1_GsMapUnit = func_8008F66C;
L1_GsScanAnim = func_8008FF3C;
L1_GsScanUnit = func_80090198;
L1_GsSetAmbient = func_800904C8;
L1_GsSetDrawBuffClip = func_80094F8C;
L1_GsSetDrawBuffOffset = func_80086CDC;
L1_GsSetFlatLight = func_800788A0;
L1_GsSetRefView2 = func_80086EAC;
L1_GsSortClear = func_80086B74;
L1_GsSortObject4 = func_8007D510;
L1_GsSortOt = func_80089784;
L1_GsSortUnit = func_8008E8E8;
L1_GsSwapDispBuff = func_8008B0C4;
L1_GsTMDdivF3NL = func_8008C934;
L1_GsTMDdivG3NL = func_8008CB24;
L1_GsTMDdivNF3 = func_8008BED4;
L1_GsTMDdivNG3 = func_8008C0C4;
L1_GsTMDdivTF3L = func_8008CD24;
L1_GsTMDdivTF3LFG = func_8008B174;
L1_GsTMDdivTF3NL = func_8008A744;
L1_GsTMDdivTG3NL = func_8008A9F4;
L1_GsTMDdivTNF3 = func_8008D2D4;
L1_GsTMDdivTNG3 = func_8008D584;
L1_GsTMDfastF3GL = func_8008AC44;
L1_GsTMDfastF3GLFG = func_8008C404;
L1_GsTMDfastF3GNL = func_8008B9A4;
L1_GsTMDfastF3L = func_8007EB7C;
L1_GsTMDfastF3LFG = func_8007ECC4;
L1_GsTMDfastF3NL = func_8007EA3C;
L1_GsTMDfastG3GL = func_8008AE64;
L1_GsTMDfastG3GLFG = func_8008C624;
L1_GsTMDfastG3GNL = func_8008BD64;
L1_GsTMDfastG3L = func_8007E5D8;
L1_GsTMDfastG3LFG = func_8007E768;
L1_GsTMDfastG3NL = func_8007E498;
L1_GsTMDfastNF3 = func_8007E900;
L1_GsTMDfastNG3 = func_8007E350;
L1_GsTMDfastTF3L = func_8007E070;
L1_GsTMDfastTF3LFG = func_8007E1E0;
L1_GsTMDfastTF3NL = func_8007DF0C;
L1_GsTMDfastTG3L = func_8007D1A4;
L1_GsTMDfastTG3LFG = func_8007D358;
L1_GsTMDfastTG3NL = func_8007D048;
L1_GsTMDfastTNF3 = func_8007DDA0;
L1_GsTMDfastTNG3 = func_8007CED0;
L1_GsU_00000008 = func_8009B4B0;
L1_GsU_00000009 = func_8009B630;
L1_GsU_0000000c = func_8009AB70;
L1_GsU_0000000d = func_8009AD30;
L1_GsU_0000000f = func_8009AF00;
L1_GsU_00000209 = func_8009B7C0;
L1_GsU_0000020d = func_8009B0E0;
L1_GsU_00200009 = func_8009B960;
L1_GsU_0020000d = func_8009B2D0;
L1_GsU_01000000 = func_80099BD0;
L1_GsU_0100000c = func_80099730;
L1_GsU_0100000d = func_800999A0;
L1_GsU_02000000 = func_800995F0;
L1_GsU_02000001 = func_80099680;
L1_GsU_03000000 = D_80099D00;
L1_GsU_03000001 = func_8009A440;
L1_GsU_03000010 = func_8009A620;
L1_GsU_03000011 = func_8009A810;
L1_Gssub_make_matrix = func_8008E2F4;
L1_HookEntryInt = func_80094C4C;
L1_INTR_DMA_OBJ_1CC = func_80094E28;
L1_INTR_DMA_OBJ_278 = func_80094ED4;
L1_INTR_DMA_OBJ_4C = func_80094CA8;
L1_INTR_VB_OBJ_58 = func_80094B54;
L1_INTR_VB_OBJ_C4 = func_80094BC0;
L1_INTR_VB_OBJ_F0 = func_80094BEC;
L1_ISO9660_OBJ_2D8 = func_80085828;
L1_ISO9660_OBJ_2F8 = func_80085848;
L1_ISO9660_OBJ_5BC = func_80085B0C;
L1_ISO9660_OBJ_660 = func_80085BB0;
L1_ISO9660_OBJ_8FC = func_80085E4C;
L1_InitGeom = func_800896FC;
L1_InitHeap3 = func_8008D7C4;
L1_LoadClut = func_8008DE04;
L1_LoadClut2 = func_8008DE74;
L1_LoadTPage = func_80097804;
func_80075D20 = L1_Math_Abs;
func_80075D5C = L1_Math_Max;
func_80075E10 = L1_Math_Max3;
func_80075DA8 = L1_Math_Min3;
L1_Menu_ResetState = func_80029114;
L1_MulMatrix = func_8007C854;
L1_MulMatrix2 = func_8007C964;
L1_OpenEvent = func_80080E8C;
L1_PADIF_OBJ_120 = func_80097204;
L1_PADIF_OBJ_1CC = func_800972B0;
L1_PADIF_OBJ_290 = func_80097374;
L1_PADIF_OBJ_48 = func_8009712C;
L1_PADPORTD_OBJ_160 = func_8008805C;
L1_PADPORTD_OBJ_1C8 = func_800880C4;
L1_PADPORTD_OBJ_2BC = func_800881B8;
L1_PADPORTD_OBJ_2CC = func_800881C8;
L1_PADPORTD_OBJ_388 = func_80088284;
L1_PADPORTD_OBJ_604 = func_80088500;
L1_PADPORTD_OBJ_63C = func_80088538;
L1_PADSEQD_OBJ_144 = func_80096088;
L1_PADSEQD_OBJ_34 = func_80095F78;
L1_PADSEQD_OBJ_488 = func_800963CC;
L1_PATCHGTE_OBJ_DC = D_80097800;
L1_PCcreat = func_80086CAC;
L1_PClseek = func_80085ED0;
L1_PCopen = func_80085530;
L1_PCread = func_80084DF8;
L1_PadInitDirect = func_80087EFC;
func_80045328 = L1_Pad_StickToSpeed;
func_8002F304 = L1_Pad_Update;
func_80042148 = L1_PauseMenu_Open;
L1_PopMatrix = func_80078F74;
L1_PushMatrix = func_80078ED0;
L1_ResetEntryInt = func_80094F2C;
func_80042B28 = L1_RestartPrompt_Open;
L1_ReturnFromException = func_80094F1C;
L1_RotAverage3 = func_80098344;
L1_RotAverageNclip3 = func_800982B4;
L1_RotAverageNclipColorCol3 = func_80098CC0;
L1_RotAverageNclipColorDpq3 = func_80097954;
L1_RotAverageNclipColorDpq3_1 = func_80097DAC;
L1_RotMatrix = func_8008FA1C;
L1_RotMatrixY = func_8008E154;
L1_RotMatrixYXZ = func_8008FCAC;
L1_RotMatrixYXZ_gte = func_8008E6E8;
L1_RotTrans = func_800905E8;
L1_ScaleMatrix = func_80090388;
L1_SetBackColor = func_8009BB00;
L1_SetColorMatrix = func_80078EA0;
L1_SetDefDispEnv = func_8008C8F4;
L1_SetDefDrawEnv = func_8008C824;
L1_SetDrawMode = func_80083B94;
L1_SetDumpFnt = func_80089844;
L1_SetFarColor = func_8009C200;
L1_SetLightMatrix = func_800905A8;
L1_SetLineF4 = func_80083B74;
L1_SetRotMatrix = func_80090558;
L1_SetTransMatrix = func_80090588;
L1_SpuClearReverbWorkArea = func_80095C64;
L1_SpuFree = func_80095E84;
L1_SpuGetVoiceEnvelope = func_8009BE70;
L1_SpuInitMalloc = func_8009CF10;
L1_SpuIsTransferCompleted = func_80098E80;
L1_SpuMalloc = func_80099320;
L1_SpuRead = func_80098E20;
L1_SpuSetCommonAttr = func_800924E0;
L1_SpuSetKey = func_8009BEC0;
L1_SpuSetNoiseClock = func_8009C0B0;
L1_SpuSetTransferMode = func_80098D90;
L1_SpuSetTransferStartAddr = func_80098DC0;
L1_SpuSetVoiceAttr = func_800953C4;
L1_SpuStart = func_80093340;
L1_SquareRoot0 = func_80078E10;
L1_SquareRoot12 = func_8008E4F4;
L1_SsEnd = func_80087E4C;
L1_SsPitchFromNote = func_8009140C;
L1_SsSeqCalledTbyT = func_800959C4;
L1_SsSetSerialAttr = func_80083A84;
L1_SsSetSerialVol = func_800838D8;
L1_SsSetTickMode = func_800875AC;
L1_SsUtAllKeyOff = func_8008744C;
L1_SsVabClose = func_80087D9C;
L1_SsVabOpenHead = func_8008DD64;
L1_SsVabTransBody = func_8008DB14;
L1_SsVabTransCompleted = func_8008DBE4;
L1_SsVoKeyOn = func_80083530;
L1_SysDeqIntRP = func_80097004;
L1_SysEnqIntRP = func_80097014;
L1_TestEvent = func_8009CF00;
L1_TransposeMatrix = func_8008E3C4;
L1_VSYNC_OBJ_178 = func_8008607C;
L1_VS_VH2_OBJ_34 = func_8008DD98;
L1_VSync = func_80085F04;
func_80075A4C = L1_Vec_Dot;
func_80075AC8 = L1_Vec_ProjectXZ;
func_80075B70 = L1_Vec_Scale;
L1_WaitEvent = func_8009CBD0;
L1__SN_read = func_80093448;
L1__SN_write = func_8009502C;
L1__SpuInit = func_80093258;
L1__SpuSetAnyVoice = func_8009CF70;
L1__SsGetSeqData = func_8009D570;
L1__SsInit = func_80090628;
L1__SsReadDeltaValue = func_8009E0B0;
L1__SsSeqGetEof = func_8009D32C;
L1__SsSeqPlay = func_8009D230;
L1__SsSndCrescendo = func_8009C490;
L1__SsSndNextSep = func_8009DFB0;
L1__SsSndPause = func_8009C8C0;
L1__SsSndPlay = func_8009C460;
L1__SsSndReplay = func_8009C960;
L1__SsSndTempo = func_8009C6A0;
L1__SsVmAlloc = func_80092230;
L1__SsVmDoAllocate = func_80090C18;
L1__SsVmFlush = func_80090788;
L1__SsVmInit = func_8009BB20;
L1__SsVmKeyOffNow = func_80091A08;
L1__SsVmKeyOnNow = func_80091538;
L1__SsVmSelectToneAndVag = func_8009C100;
L1__SsVmVSetUp = func_800906C8;
L1__dirFailAuto = func_800962EC;
L1__gp = D_800AD9A4;
L1__padInitDirSeq = func_80095F44;
L1__patch_gte = func_80097724;
L1__spu_gcSPU = func_8009CBF0;
L1_bzero = func_80096404;
L1_calloc3 = func_8008D894;
L1_chkRC2wait = func_80097044;
L1_exit = func_80083CB4;
L1_free3 = func_8008D9C4;
PROVIDE(L1_func_800274F4 = func_800275D0);
PROVIDE(func_800275D0 = L1_func_800274F4);
func_8002844C = L1_func_80028370;
func_80028754 = L1_func_80028678;
L1_func_800286EC = func_800287C8;
func_80028808 = L1_func_8002872C;
func_800288EC = L1_func_80028810;
func_80028934 = L1_func_80028858;
func_80028A34 = L1_func_80028958;
L1_func_800289C0 = func_80028A9C;
func_80028C34 = L1_func_80028B58;
func_80028CE4 = L1_func_80028C08;
func_80028E98 = L1_func_80028DBC;
func_80029140 = L1_func_80029064;
L1_func_800291B0 = func_8002928C;
func_80029590 = L1_func_800294B4;
func_800295E0 = L1_func_80029504;
func_80029760 = L1_func_80029684;
func_80029944 = L1_func_80029868;
L1_func_800299CC = func_80029AA8;
PROVIDE(L1_func_80029A34 = func_80029B10);
PROVIDE(func_80029B10 = L1_func_80029A34);
func_8002A4A4 = L1_func_8002A3C8;
func_8002A6F8 = L1_func_8002A61C;
func_8002A7FC = L1_func_8002A720;
func_8002A930 = L1_func_8002A854;
func_8002AB70 = L1_func_8002AA94;
L1_func_8002AAC4 = func_8002ABA0;
func_8002ABD8 = L1_func_8002AAFC;
func_8002AD6C = L1_func_8002AC90;
L1_func_8002ADF0 = func_8002AECC;
func_8002AF10 = L1_func_8002AE34;
L1_func_8002AF08 = func_8002AFE4;
func_8002B0D4 = L1_func_8002AFF8;
L1_func_8002B064 = func_8002B140;
func_8002B17C = L1_func_8002B0A0;
func_8002B258 = L1_func_8002B17C;
PROVIDE(L1_func_8002B29C = func_8002B378);
PROVIDE(func_8002B378 = L1_func_8002B29C);
func_8002B778 = L1_func_8002B69C;
L1_func_8002BB34 = func_8002BC10;
func_8002BC44 = L1_func_8002BB68;
func_8002BCF4 = L1_func_8002BC18;
func_8002BF00 = L1_func_8002BE24;
func_8002C010 = L1_func_8002BF34;
func_8002C244 = L1_func_8002C168;
L1_func_8002C2D8 = func_8002C3B4;
func_8002C56C = L1_func_8002C490;
L1_func_8002C664 = func_8002C740;
func_8002C798 = L1_func_8002C6BC;
L1_func_8002C83C = func_8002C918;
L1_func_8002C844 = func_8002C920;
func_8002D1CC = L1_func_8002D0F0;
func_8002D2B0 = L1_func_8002D1D4;
func_8002D5C0 = L1_func_8002D4E4;
func_8002D6E0 = L1_func_8002D604;
func_8002D7E4 = L1_func_8002D708;
func_8002DDE0 = L1_func_8002DD6C;
L1_func_8002E0E8 = func_8002E16C;
L1_func_8002E190 = func_8002E214;
func_8002E234 = L1_func_8002E1B0;
func_8002E3A8 = L1_func_8002E318;
L1_func_8002E3A0 = func_8002E430;
L1_func_8002E410 = func_8002E4A0;
L1_func_8002E430 = func_8002E4C0;
L1_func_8002E48C = func_8002E51C;
L1_func_8002E4B4 = func_8002E544;
L1_func_8002E4D4 = func_8002E564;
func_8002E56C = L1_func_8002E4DC;
L1_func_8002E534 = func_8002E5C4;
L1_func_8002E5C4 = func_8002E688;
PROVIDE(L1_func_8002E798 = func_8002E864);
PROVIDE(func_8002E864 = L1_func_8002E798);
L1_func_8002F0A4 = func_8002F170;
L1_func_8002F114 = func_8002F1E0;
L1_func_8002F53C = func_8002F608;
func_8002F630 = L1_func_8002F564;
func_8002F6F0 = L1_func_8002F624;
L1_func_8002F7CC = func_8002F898;
PROVIDE(L1_func_8002FFD8 = func_80030084);
PROVIDE(func_80030084 = L1_func_8002FFD8);
func_800301C4 = L1_func_80030118;
func_80030358 = L1_func_800302AC;
L1_func_80030304 = func_800303B0;
L1_func_80030324 = func_800303D0;
func_800303E0 = L1_func_80030334;
func_80030460 = L1_func_800303B4;
PROVIDE(L1_func_8003052C = func_800305D8);
PROVIDE(func_800305D8 = L1_func_8003052C);
L1_func_800305B4 = func_80030660;
L1_func_80030610 = func_800306BC;
func_8003071C = L1_func_80030670;
L1_func_800306A8 = func_80030754;
L1_func_800306F0 = func_8003079C;
func_80030844 = L1_func_80030798;
L1_func_80030868 = func_80030914;
PROVIDE(L1_func_80030994 = func_80030A40);
PROVIDE(func_80030A40 = L1_func_80030994);
func_80030BB0 = L1_func_80030B04;
func_80030DB4 = L1_func_80030D08;
func_80030E4C = L1_func_80030DA0;
L1_func_80030EB0 = func_80030F5C;
func_80030FCC = L1_func_80030F20;
func_80031054 = L1_func_80030FA8;
L1_func_800310B4 = func_80031160;
L1_func_80031678 = func_80031774;
L1_func_80031F18 = func_80032014;
func_80032170 = L1_func_80032074;
func_800322EC = L1_func_800321F0;
func_8003258C = L1_func_8003246C;
L1_func_800324C0 = func_800325E0;
func_800325F0 = L1_func_800324D0;
L1_func_80032648 = func_80032768;
func_80032844 = L1_func_80032724;
func_80032888 = L1_func_80032768;
L1_func_80032880 = func_800329A0;
func_80032F6C = L1_func_80032E4C;
PROVIDE(L1_func_80032EFC = func_8003301C);
PROVIDE(func_8003301C = L1_func_80032EFC);
func_800331B0 = L1_func_80033090;
func_800333C4 = L1_func_800332A4;
func_800334F0 = L1_func_80033348;
func_8003357C = L1_func_800333D4;
func_800335C8 = L1_func_800334F4;
L1_func_80033F38 = func_800347D8;
func_80035294 = L1_func_80034998;
func_800352F4 = L1_func_800349F8;
func_8003592C = L1_func_80035030;
L1_func_800350F0 = func_800359EC;
PROVIDE(L1_func_800352B8 = func_80035BE4);
PROVIDE(func_80035BE4 = L1_func_800352B8);
func_80036290 = L1_func_80035964;
func_80036318 = L1_func_800359EC;
func_800364E8 = L1_func_80035BBC;
func_80036714 = L1_func_80035DE8;
func_80036830 = L1_func_80035F04;
func_80036AE8 = L1_func_800361BC;
func_80036C54 = L1_func_80036328;
func_80036EE0 = L1_func_800365B4;
func_80036F9C = L1_func_80036670;
L1_func_800368A8 = func_800371D4;
L1_func_80036938 = func_80037264;
func_80037724 = L1_func_80036E10;
L1_func_800373FC = func_80037D10;
func_80038038 = L1_func_80037768;
func_800380C4 = L1_func_800377F4;
func_800381CC = L1_func_800378FC;
func_800382F4 = L1_func_80037A24;
func_8003839C = L1_func_80037ACC;
L1_func_80037B6C = func_8003843C;
func_80038958 = L1_func_800380DC;
PROVIDE(L1_func_800381CC = func_80038A48);
PROVIDE(func_80038A48 = L1_func_800381CC);
func_80038C80 = L1_func_80038404;
func_80038F80 = L1_func_8003872C;
func_800397EC = L1_func_80038984;
func_80039A6C = L1_func_80038C04;
func_80039AF4 = L1_func_80038C8C;
L1_func_800390F8 = func_80039F60;
PROVIDE(L1_func_800391B0 = func_8003A018);
PROVIDE(func_8003A018 = L1_func_800391B0);
L1_func_800393AC = func_8003A214;
func_8003A24C = L1_func_800393E4;
L1_func_80039520 = func_8003A388;
L1_func_800395E8 = func_8003A450;
func_8003A5E8 = L1_func_800397A8;
PROVIDE(L1_func_8003982C = func_8003A66C);
PROVIDE(func_8003A66C = L1_func_8003982C);
func_8003A874 = L1_func_80039A34;
PROVIDE(L1_func_80039A9C = func_8003A8DC);
PROVIDE(func_8003A8DC = L1_func_80039A9C);
PROVIDE(L1_func_8003A51C = func_8003B35C);
PROVIDE(func_8003B35C = L1_func_8003A51C);
PROVIDE(L1_func_8003A68C = func_8003B4CC);
PROVIDE(func_8003B4CC = L1_func_8003A68C);
L1_func_8003A71C = func_8003B55C;
func_8003B6D8 = L1_func_8003A898;
func_8003B854 = L1_func_8003AA14;
PROVIDE(L1_func_8003AC1C = func_8003BA5C);
PROVIDE(func_8003BA5C = L1_func_8003AC1C);
func_8003C334 = L1_func_8003B4F4;
PROVIDE(L1_func_8003B53C = func_8003C37C);
PROVIDE(func_8003C37C = L1_func_8003B53C);
L1_func_8003B750 = func_8003C590;
PROVIDE(L1_func_8003B808 = func_8003C648);
PROVIDE(func_8003C648 = L1_func_8003B808);
func_8003C780 = L1_func_8003B940;
func_8003CAD8 = L1_func_8003BC98;
func_8003CCA8 = L1_func_8003BE68;
L1_func_8003BFB8 = func_8003CDF8;
L1_func_8003C1BC = func_8003D044;
func_8003D460 = L1_func_8003C6B0;
func_8003D494 = L1_func_8003C6E4;
func_8003D63C = L1_func_8003C88C;
func_8003D654 = L1_func_8003C8A4;
func_8003D774 = L1_func_8003C9C4;
L1_func_8003CA4C = func_8003D7FC;
func_8003D86C = L1_func_8003CABC;
L1_func_8003CC8C = func_8003DA3C;
PROVIDE(L1_func_8003D76C = func_8003E4AC);
PROVIDE(func_8003E4AC = L1_func_8003D76C);
func_8003EB98 = L1_func_8003DE58;
func_8003EE98 = L1_func_8003E158;
func_8003F1D4 = L1_func_8003E494;
PROVIDE(L1_func_8003E5A0 = func_8003F2E0);
PROVIDE(func_8003F2E0 = L1_func_8003E5A0);
func_8003F764 = L1_func_8003EA24;
func_8003F840 = L1_func_8003EB00;
PROVIDE(L1_func_8003EC44 = func_8003F984);
PROVIDE(func_8003F984 = L1_func_8003EC44);
func_800404A8 = L1_func_8003F768;
func_80040A0C = L1_func_8003FCE4;
func_80040CC4 = L1_func_8003FF9C;
L1_func_8004009C = func_80040DC4;
PROVIDE(L1_func_80040778 = func_80041304);
PROVIDE(func_80041304 = L1_func_80040778);
func_80041504 = L1_func_80040978;
func_80041634 = L1_func_80040AA8;
func_80041BE8 = L1_func_8004105C;
func_80041D48 = L1_func_800411BC;
L1_func_8004133C = func_80041EC8;
func_80041F80 = L1_func_800413F4;
L1_func_800414AC = func_80042038;
L1_func_80041578 = func_80042104;
func_80042350 = L1_func_800417C4;
L1_func_800419CC = func_8004261C;
func_80042688 = L1_func_80041A38;
func_800427F0 = L1_func_80041BA0;
func_80042878 = L1_func_80041C28;
func_80042940 = L1_func_80041CF0;
func_80042A0C = L1_func_80041DBC;
func_80042AC8 = L1_func_80041E78;
func_80042C70 = L1_func_80042020;
func_80042DDC = L1_func_8004218C;
PROVIDE(L1_func_800425E4 = func_80043234);
PROVIDE(func_80043234 = L1_func_800425E4);
L1_func_80042A94 = func_800436E4;
L1_func_80042B28 = func_80043778;
func_8004396C = L1_func_80042D1C;
L1_func_80042E34 = func_80043A84;
L1_func_80042E6C = func_80043ABC;
func_80043CC8 = L1_func_80043078;
func_80043E50 = L1_func_80043200;
L1_func_800433A8 = func_80043FF8;
L1_func_800433F4 = func_80044044;
PROVIDE(L1_func_80043610 = func_80044260);
PROVIDE(func_80044260 = L1_func_80043610);
PROVIDE(L1_func_80043B14 = func_80044764);
PROVIDE(func_80044764 = L1_func_80043B14);
L1_func_80043EE0 = func_80044B30;
func_800454D0 = L1_func_800448F4;
L1_func_80044B3C = func_80045700;
L1_func_80044B74 = func_80045738;
L1_func_80044BAC = func_80045770;
L1_func_80044BBC = func_80045780;
PROVIDE(L1_func_80044BCC = func_80045790);
PROVIDE(func_80045790 = L1_func_80044BCC);
func_80045C48 = L1_func_80045084;
func_80045D10 = L1_func_8004514C;
func_80045F08 = L1_func_80045344;
func_80046290 = L1_func_800456D0;
PROVIDE(L1_func_80045A28 = func_800465E8);
PROVIDE(func_800465E8 = L1_func_80045A28);
func_80046E2C = L1_func_8004626C;
PROVIDE(L1_func_800463C8 = func_80046F88);
PROVIDE(func_80046F88 = L1_func_800463C8);
func_80047ED8 = L1_func_80047318;
PROVIDE(L1_func_800474AC = func_8004806C);
PROVIDE(func_8004806C = L1_func_800474AC);
func_8004817C = L1_func_800475BC;
L1_func_800477C0 = func_80048380;
L1_func_8004782C = func_800483EC;
L1_func_8004783C = func_800483FC;
func_800485C4 = L1_func_80047A04;
func_80048710 = L1_func_80047B50;
func_800489D4 = L1_func_80047DBC;
L1_func_80047ECC = func_80048AE4;
func_80048DCC = L1_func_800481B0;
func_80048FF4 = L1_func_800483D8;
func_80049038 = L1_func_8004841C;
PROVIDE(L1_func_80048794 = func_800493B0);
PROVIDE(func_800493B0 = L1_func_80048794);
func_80049768 = L1_func_80048B4C;
func_80049A00 = L1_func_80048DE4;
func_80049A7C = L1_func_80048E60;
L1_func_80048FE8 = func_80049C04;
L1_func_8004900C = func_80049C28;
func_80049FDC = L1_func_800493C0;
func_8004A08C = L1_func_80049470;
func_8004A358 = L1_func_8004973C;
func_8004A500 = L1_func_800498E4;
func_8004A6A4 = L1_func_80049A88;
L1_func_80049B7C = func_8004A798;
func_8004A7A0 = L1_func_80049B84;
PROVIDE(L1_func_80049D60 = func_8004A97C);
PROVIDE(func_8004A97C = L1_func_80049D60);
L1_func_8004A294 = func_8004AEB0;
L1_func_8004A29C = func_8004AEB8;
L1_func_8004A304 = func_8004AF20;
L1_func_8004A338 = func_8004AF54;
L1_func_8004A370 = func_8004AF8C;
L1_func_8004A380 = func_8004AF9C;
L1_func_8004A398 = func_8004AFB4;
L1_func_8004A81C = func_8004B3F0;
L1_func_8004A85C = func_8004B430;
L1_func_8004A8A8 = func_8004B47C;
func_8004B4B8 = L1_func_8004A8E4;
PROVIDE(L1_func_8004A9E4 = func_8004B5B8);
PROVIDE(func_8004B5B8 = L1_func_8004A9E4);
func_8004BAE0 = L1_func_8004AF0C;
L1_func_8004B028 = func_8004BBFC;
L1_func_8004B04C = func_8004BC20;
L1_func_8004B06C = func_8004BC40;
L1_func_8004B084 = func_8004BC58;
func_8004BC84 = L1_func_8004B0B0;
func_8004BD68 = L1_func_8004B194;
L1_func_8004B270 = func_8004BE44;
L1_func_8004B334 = func_8004D408;
func_8004D490 = L1_func_8004B3BC;
func_8004D660 = L1_func_8004B58C;
func_8004DAD0 = L1_func_8004B9FC;
func_8004DBD4 = L1_func_8004BB00;
func_8004DD44 = L1_func_8004BC70;
func_8004DE7C = L1_func_8004BDA8;
L1_func_8004BE84 = func_8004E040;
L1_func_8004BF70 = func_8004E12C;
func_8004E3BC = L1_func_8004C0C0;
PROVIDE(L1_func_8004C368 = func_8004E664);
PROVIDE(func_8004E664 = L1_func_8004C368);
func_8004E794 = L1_func_8004C498;
L1_func_8004C50C = func_8004E808;
func_8004E854 = L1_func_8004C558;
L1_func_8004C5C8 = func_8004E8C4;
L1_func_8004C698 = func_8004E994;
L1_func_8004C768 = func_8004EA64;
L1_func_8004C824 = func_8004EB20;
func_8004EB28 = L1_func_8004C82C;
func_8004EC40 = L1_func_8004C944;
func_8004ED58 = L1_func_8004CA5C;
func_8004EE28 = L1_func_8004CB2C;
func_8004EEF0 = L1_func_8004CBF4;
func_8004EFD4 = L1_func_8004CCD8;
func_8004F010 = L1_func_8004CD14;
func_8004F09C = L1_func_8004CDA0;
L1_func_8004CE38 = func_8004F134;
func_8004F170 = L1_func_8004CE74;
func_8004F1FC = L1_func_8004CF00;
L1_func_8004D048 = func_8004F344;
func_8004F510 = L1_func_8004D214;
func_8004F5CC = L1_func_8004D2D0;
L1_func_8004D5A8 = func_8004F8A4;
func_8004FA28 = L1_func_8004D72C;
func_8004FA6C = L1_func_8004D770;
func_8004FB40 = L1_func_8004D844;
func_8004FB88 = L1_func_8004D88C;
func_8004FC74 = L1_func_8004D978;
func_8004FD5C = L1_func_8004DA60;
func_8004FEC8 = L1_func_8004DBCC;
func_80050098 = L1_func_8004DD9C;
func_800502F4 = L1_func_8004DFF8;
func_80050378 = L1_func_8004E07C;
func_80050600 = L1_func_8004E304;
func_80050624 = L1_func_8004E328;
L1_func_8004E37C = func_80050678;
PROVIDE(L1_func_8004E5D8 = func_800507D0);
PROVIDE(func_800507D0 = L1_func_8004E5D8);
L1_func_8004E78C = func_80050984;
func_8005098C = L1_func_8004E794;
func_80050A94 = L1_func_8004E89C;
func_80050B64 = L1_func_8004E96C;
func_80050BA4 = L1_func_8004E9AC;
L1_func_8004EA68 = func_80050C60;
func_80050CB0 = L1_func_8004EAB8;
func_80050D18 = L1_func_8004EB20;
func_80050E68 = L1_func_8004EC70;
func_8005113C = L1_func_8004EF44;
L1_func_8004F134 = func_8005132C;
func_80051340 = L1_func_8004F148;
func_80051540 = L1_func_8004F348;
L1_func_8004F3D8 = func_800515D0;
PROVIDE(L1_func_8004F3E8 = func_800515E0);
PROVIDE(func_800515E0 = L1_func_8004F3E8);
PROVIDE(L1_func_8004F880 = func_80051A78);
PROVIDE(func_80051A78 = L1_func_8004F880);
PROVIDE(L1_func_8004FD3C = func_80051F34);
PROVIDE(func_80051F34 = L1_func_8004FD3C);
func_80052378 = L1_func_80050180;
func_80052584 = L1_func_8005038C;
PROVIDE(L1_func_800503D8 = func_800525D0);
PROVIDE(func_800525D0 = L1_func_800503D8);
func_80052B58 = L1_func_80050960;
func_80052B94 = L1_func_8005099C;
func_80052BDC = L1_func_800509E4;
func_80052C08 = L1_func_80050A10;
PROVIDE(L1_func_80050A70 = func_80052C68);
PROVIDE(func_80052C68 = L1_func_80050A70);
func_80053920 = L1_func_80051728;
func_80054514 = L1_func_800523E4;
func_80054760 = L1_func_80052630;
func_80054938 = L1_func_80052808;
func_80054C5C = L1_func_80052B2C;
L1_func_80052BEC = func_80054D1C;
func_80054F80 = L1_func_80053004;
func_80054FFC = L1_func_80053080;
func_800555B4 = L1_func_80053684;
L1_func_800536F0 = func_80055620;
func_800556C0 = L1_func_80053790;
func_80055734 = L1_func_80053804;
func_800558AC = L1_func_8005397C;
func_8005595C = L1_func_80053A2C;
func_800559AC = L1_func_80053A7C;
func_80055A94 = L1_func_80053B64;
L1_func_80053BD0 = func_80055B00;
func_80055B10 = L1_func_80053BE0;
func_80055D14 = L1_func_80053DE4;
func_80055E08 = L1_func_80053ED8;
func_800560C0 = L1_func_80054098;
func_800560F4 = L1_func_800540CC;
func_80056140 = L1_func_80054118;
func_80056194 = L1_func_8005416C;
func_80056290 = L1_func_80054268;
func_80056334 = L1_func_8005430C;
func_800563E4 = L1_func_800543BC;
L1_func_80054414 = func_8005643C;
func_800566BC = L1_func_80054604;
func_80056754 = L1_func_8005469C;
func_8005687C = L1_func_800547C4;
func_800568F4 = L1_func_8005483C;
func_80056A1C = L1_func_80054964;
func_80056B80 = L1_func_80054AC8;
func_80056CB0 = L1_func_80054BF8;
func_80056E5C = L1_func_80054DA4;
func_80056EF0 = L1_func_80054E38;
func_80056FEC = L1_func_80054F34;
func_80057094 = L1_func_80054FDC;
func_80057118 = L1_func_80055060;
func_80057224 = L1_func_8005516C;
func_800572BC = L1_func_80055204;
func_80057354 = L1_func_8005529C;
func_800573B4 = L1_func_800552FC;
func_80057414 = L1_func_8005535C;
func_80057478 = L1_func_800553C0;
func_800575C8 = L1_func_80055510;
func_80057650 = L1_func_80055598;
func_80057728 = L1_func_80055670;
func_80057880 = L1_func_800557C8;
PROVIDE(L1_func_800557F4 = func_800578AC);
PROVIDE(func_800578AC = L1_func_800557F4);
func_800578CC = L1_func_80055814;
PROVIDE(L1_func_80055878 = func_80057930);
PROVIDE(func_80057930 = L1_func_80055878);
func_80057F08 = L1_func_80055E24;
func_8005803C = L1_func_80055F58;
func_80058138 = L1_func_80056054;
func_800581F4 = L1_func_80056110;
PROVIDE(L1_func_80056154 = func_80058238);
PROVIDE(func_80058238 = L1_func_80056154);
func_8005843C = L1_func_80056358;
func_800584A0 = L1_func_800563BC;
func_80058528 = L1_func_80056444;
func_80058590 = L1_func_800564AC;
func_8005861C = L1_func_80056538;
func_80058654 = L1_func_80056570;
func_800586C0 = L1_func_800565DC;
func_800586F8 = L1_func_80056614;
func_800587DC = L1_func_800566F8;
func_80058920 = L1_func_8005683C;
func_80058978 = L1_func_80056894;
func_80058E00 = L1_func_80056D1C;
func_80059074 = L1_func_80056F90;
func_80059158 = L1_func_80057074;
func_800591DC = L1_func_800570F8;
func_80059278 = L1_func_80057194;
func_8005929C = L1_func_800571B8;
PROVIDE(L1_func_800572F4 = func_800593D8);
PROVIDE(func_800593D8 = L1_func_800572F4);
func_80059488 = L1_func_800573A4;
func_800594F4 = L1_func_80057410;
func_80059520 = L1_func_8005743C;
func_80059560 = L1_func_8005747C;
func_800596E0 = L1_func_800575FC;
L1_func_80057648 = func_8005972C;
PROVIDE(L1_func_80057750 = func_80059834);
PROVIDE(func_80059834 = L1_func_80057750);
L1_func_80057A24 = func_80059B08;
func_80059B94 = L1_func_80057AB0;
L1_func_80057AD8 = func_80059BBC;
func_80059C10 = L1_func_80057B2C;
L1_func_80057B94 = func_80059C78;
L1_func_80057BFC = func_80059CE0;
L1_func_80058694 = func_8005A778;
func_8005A940 = L1_func_8005885C;
L1_func_80058A58 = func_8005AB3C;
L1_func_80058B10 = func_8005ABF4;
func_8005AC50 = L1_func_80058B6C;
L1_func_80058D00 = func_8005ADE4;
func_8005AE40 = L1_func_80058D5C;
func_8005AEE0 = L1_func_8005AD6C;
L1_func_8005ADB0 = func_8005AF24;
PROVIDE(L1_func_8005ADD4 = func_8005AF48);
PROVIDE(func_8005AF48 = L1_func_8005ADD4);
PROVIDE(L1_func_8005AEF8 = func_8005B06C);
PROVIDE(func_8005B06C = L1_func_8005AEF8);
func_8005B67C = L1_func_8005B508;
func_8005B6F8 = L1_func_8005B584;
func_8005B720 = L1_func_8005B5AC;
func_8005B840 = L1_func_8005B6CC;
func_8005B8E0 = L1_func_8005B76C;
func_8005B930 = L1_func_8005B7BC;
func_8005B9E0 = L1_func_8005B86C;
func_8005BAE0 = L1_func_8005B96C;
func_8005BBA4 = L1_func_8005BA30;
func_8005BC5C = L1_func_8005BAE8;
func_8005BDF4 = L1_func_8005BC80;
func_8005C064 = L1_func_8005BEF0;
func_8005C280 = L1_func_8005C10C;
PROVIDE(L1_func_8005C214 = func_8005C388);
PROVIDE(func_8005C388 = L1_func_8005C214);
func_8005C4B0 = L1_func_8005C33C;
L1_func_8005C864 = func_8005C9D8;
L1_func_8005C894 = func_8005CA08;
func_8005CA38 = L1_func_8005C8C4;
func_8005CB94 = L1_func_8005CA20;
L1_func_8005CB38 = func_8005CCAC;
func_8005CF3C = L1_func_8005CED0;
func_8005D034 = L1_func_8005CFC8;
func_8005D31C = L1_func_8005D2B0;
L1_func_8005D58C = func_8005D5F8;
func_8005D630 = L1_func_8005D5C4;
func_8005D69C = L1_func_8005D630;
L1_func_8005D654 = func_8005D6C0;
func_8005D700 = L1_func_8005D694;
func_8005D7CC = L1_func_8005D760;
L1_func_8005DA90 = func_8005DAFC;
PROVIDE(L1_func_8005DB7C = func_8005DBE8);
PROVIDE(func_8005DBE8 = L1_func_8005DB7C);
func_8005DCAC = L1_func_8005DC40;
L1_func_8005DF40 = func_8005DFAC;
func_8005DFE8 = L1_func_8005DF7C;
func_8005E08C = L1_func_8005E020;
func_8005E294 = L1_func_8005E228;
PROVIDE(L1_func_8005E424 = func_8005E490);
PROVIDE(func_8005E490 = L1_func_8005E424);
func_8005EB48 = L1_func_8005EADC;
func_8005EBD8 = L1_func_8005EB6C;
func_8005ECF0 = L1_func_8005EC84;
func_8005EE64 = L1_func_8005EE6C;
L1_func_8005F3B0 = func_8005F3A0;
func_8005F8D8 = L1_func_8005F93C;
func_8005FA44 = L1_func_8005FAA8;
L1_func_80060094 = func_80060020;
func_800603C8 = L1_func_8006043C;
func_800604DC = L1_func_800604B0;
L1_func_8006060C = func_80060638;
func_80060640 = L1_func_80060614;
func_800607C4 = L1_func_80060798;
func_80060910 = L1_func_800608E4;
func_80060AEC = L1_func_80060AC0;
L1_func_80061018 = func_80060FCC;
PROVIDE(L1_func_80061068 = func_80061060);
PROVIDE(func_80061060 = L1_func_80061068);
func_800615C0 = L1_func_800615C8;
L1_func_80061700 = func_800616F8;
func_80061700 = L1_func_80061708;
L1_func_80061DC0 = func_80061D18;
func_80061DEC = L1_func_80061EC4;
func_800621E4 = L1_func_80062300;
func_80062278 = L1_func_80062394;
L1_func_80062784 = func_80062668;
func_80062A4C = L1_func_80062B68;
func_80062E1C = L1_func_80062F38;
PROVIDE(L1_func_80062FAC = func_80062E90);
PROVIDE(func_80062E90 = L1_func_80062FAC);
func_80063114 = L1_func_800632AC;
func_80063218 = L1_func_800633B0;
func_80063328 = L1_func_800634C0;
func_80063520 = L1_func_800636B8;
func_80063618 = L1_func_800637B0;
L1_func_80063858 = func_800636C0;
L1_func_80063ADC = func_80063944;
func_80063988 = L1_func_80063B20;
func_80063B14 = L1_func_80063CAC;
func_80063BA8 = L1_func_80063D40;
L1_func_80063ED4 = func_80063D3C;
L1_func_80063EF8 = func_80063D60;
func_80063D9C = L1_func_80063F34;
func_80063DEC = L1_func_80063F84;
func_80063F94 = L1_func_8006412C;
func_80064124 = L1_func_8006439C;
func_80064264 = L1_func_800644DC;
func_800643A4 = L1_func_8006461C;
func_800643E8 = L1_func_80064660;
func_800645D4 = L1_func_8006484C;
func_80064954 = L1_func_80064A10;
func_80064B6C = L1_func_80064C28;
L1_func_80064E40 = func_80064D84;
func_80064FF8 = L1_func_80065510;
L1_func_80065588 = func_80065070;
func_800650A0 = L1_func_800655B8;
func_800650FC = L1_func_80065614;
L1_func_800658B4 = func_8006539C;
func_80065410 = L1_func_80065928;
PROVIDE(L1_func_80065A20 = func_80065508);
PROVIDE(func_80065508 = L1_func_80065A20);
func_80065B80 = L1_func_80066098;
func_80065D90 = L1_func_800662A8;
func_80065FA0 = L1_func_800664B8;
func_800661EC = L1_func_80066704;
L1_func_8006692C = func_80066414;
L1_func_80066968 = func_80066450;
func_8006648C = L1_func_800669A4;
L1_func_80066A60 = func_80066548;
L1_func_80066B14 = func_800665FC;
L1_func_80067F18 = func_800679D4;
func_80068C44 = L1_func_800689F0;
L1_func_80069318 = func_8006987C;
L1_func_80069328 = func_8006988C;
L1_func_800693DC = func_80069944;
func_80069954 = L1_func_80069478;
L1_func_8006981C = func_80069D94;
L1_func_80069850 = func_80069E24;
L1_func_800698B8 = func_80069EA8;
L1_func_8006B198 = func_8006BD8C;
L1_func_8006B1DC = func_8006BDD0;
L1_func_8006B230 = func_8006BE24;
func_8006BE68 = L1_func_8006B274;
PROVIDE(L1_func_8006B2C4 = func_8006BEB8);
PROVIDE(func_8006BEB8 = L1_func_8006B2C4);
func_8006D088 = L1_func_8006C494;
func_8006D4E8 = L1_func_8006C8F4;
PROVIDE(L1_func_8006CB88 = func_8006D77C);
PROVIDE(func_8006D77C = L1_func_8006CB88);
PROVIDE(L1_func_8006CEA4 = func_8006DA98);
PROVIDE(func_8006DA98 = L1_func_8006CEA4);
func_8006DFB4 = L1_func_8006D3C0;
PROVIDE(L1_func_8006D470 = func_8006E064);
PROVIDE(func_8006E064 = L1_func_8006D470);
func_8006E914 = L1_func_8006DD20;
PROVIDE(L1_func_8006E054 = func_8006EC48);
PROVIDE(func_8006EC48 = L1_func_8006E054);
func_8006F214 = L1_func_8006E620;
func_8006F5D4 = L1_func_8006E9E0;
func_8006F8B0 = L1_func_8006ECBC;
func_8006FA9C = L1_func_8006EEA8;
func_8006FC28 = L1_func_8006F034;
PROVIDE(L1_func_8006F168 = func_8006FD5C);
PROVIDE(func_8006FD5C = L1_func_8006F168);
func_800702A0 = L1_func_8006F6AC;
PROVIDE(L1_func_8006F784 = func_80070378);
PROVIDE(func_80070378 = L1_func_8006F784);
func_80070598 = L1_func_8006F9A4;
func_80070648 = L1_func_8006FA54;
func_800706F8 = L1_func_8006FB04;
func_80070AC8 = L1_func_8006FED4;
func_80070C64 = L1_func_80070070;
func_80070EC0 = L1_func_800702CC;
func_8007119C = L1_func_800705A8;
func_800712E4 = L1_func_800706F0;
func_8007222C = L1_func_80071638;
PROVIDE(L1_func_80072190 = func_80072D84);
PROVIDE(func_80072D84 = L1_func_80072190);
func_80073000 = L1_func_8007240C;
PROVIDE(L1_func_800726D0 = func_800732C4);
PROVIDE(func_800732C4 = L1_func_800726D0);
func_8007393C = L1_func_80072D48;
func_80073A1C = L1_func_80072E28;
PROVIDE(L1_func_8007369C = func_80074290);
PROVIDE(func_80074290 = L1_func_8007369C);
func_80074FDC = L1_func_800743E8;
PROVIDE(L1_func_800746D0 = func_800752C4);
PROVIDE(func_800752C4 = L1_func_800746D0);
func_80075BDC = L1_func_80074FE8;
func_80075EB4 = L1_func_800752C0;
PROVIDE(L1_func_800752E8 = func_80075EDC);
PROVIDE(func_80075EDC = L1_func_800752E8);
L1_func_800753A4 = func_80075F98;
L1_func_800753F0 = func_80075FE4;
func_80076050 = L1_func_8007545C;
func_800761B0 = L1_func_800755BC;
func_80076270 = L1_func_8007567C;
func_800763B4 = L1_func_800757C0;
L1_func_800758C0 = func_800764B4;
func_800764E4 = L1_func_800758F0;
func_80076514 = L1_func_80075920;
func_8007693C = L1_func_80075D48;
func_80076A90 = L1_func_80075E9C;
func_80076B14 = L1_func_80075F20;
L1_func_80075FA0 = func_80076B94;
L1_func_80075FE4 = func_80076BD8;
func_80076C08 = L1_func_80076014;
L1_func_800760B4 = func_80076CA8;
func_80076CF8 = L1_func_80076104;
func_80076D78 = L1_func_80076184;
L1_func_80076A8C = func_80077640;
L1_func_80077764 = func_80079020;
L1_func_800779FC = func_800792B8;
L1_func_80077CCC = func_80079588;
L1_func_80077D50 = func_8007960C;
L1_func_80077FC4 = func_80079880;
L1_func_800781B4 = func_80079A70;
L1_func_80078534 = func_80079DF0;
L1_func_800785A8 = func_80079E64;
L1_func_800787FC = func_8007A0B8;
L1_func_80078840 = func_8007A0FC;
L1_func_800788E0 = func_8007A19C;
L1_func_800792B8 = func_8007B1F0;
L1_func_80079390 = func_8007B2C8;
L1_func_800793EC = func_8007B324;
L1_func_800794A0 = func_8007B3D8;
L1_func_800794D4 = func_8007B40C;
L1_func_80079588 = func_8007B4C0;
L1_func_800797A8 = func_8007B6E0;
L1_func_8007980C = func_8007B730;
L1_func_800798A8 = func_8007B850;
L1_func_800798D4 = func_8007B87C;
L1_func_80079B94 = func_8007BB3C;
L1_func_80079C04 = func_8007BBAC;
L1_func_80079C54 = func_8007BBFC;
L1_func_80079D84 = func_8007BD2C;
L1_func_80079DB8 = func_8007BD78;
L1_func_80079E10 = func_8007BDD0;
L1_func_80079F84 = func_8007BF44;
L1_func_8007A040 = func_8007C038;
L1_func_8007A17C = func_8007C174;
L1_func_8007A1B0 = func_8007C1A8;
L1_func_8007A4E4 = func_8007C4C4;
L1_func_8007A554 = func_8007C534;
L1_func_8007A580 = func_8007C560;
L1_func_8007A614 = func_8007C5F4;
L1_func_8007A694 = func_8007C674;
L1_func_8007AA94 = func_8007CA74;
L1_func_8007AC7C = func_8007CC5C;
L1_func_8007CE30 = func_8007EE10;
L1_func_8007D184 = func_8007F164;
L1_func_8007D1E8 = func_8007F1C8;
L1_func_8007D260 = func_8007F240;
L1_func_8007D2B4 = func_8007F294;
L1_func_8007D914 = func_8007F8F4;
L1_func_8007DA88 = func_8007FA68;
L1_func_8007DE50 = func_8007FE30;
L1_func_8007E610 = func_800805F0;
L1_func_8007E6A4 = func_80080684;
L1_func_8007EB7C = func_80080B5C;
L1_func_8007EC78 = func_80080C58;
L1_func_8007ED98 = func_80080D78;
L1_func_8007EE34 = func_80080E14;
L1_func_8007EE64 = func_80080E44;
L1_func_8007EEBC = func_80080E9C;
L1_func_8007EECC = func_80080EAC;
L1_func_8007F040 = func_80081020;
L1_func_8007F0D8 = func_800810B8;
L1_func_8007F140 = func_80081120;
L1_func_8007F25C = func_8008123C;
L1_func_8007F2EC = func_800812CC;
L1_func_8007F34C = func_8008132C;
L1_func_8007F414 = func_800813F4;
L1_func_8007F4C0 = func_800814A0;
L1_func_8007F530 = func_80081510;
L1_func_8007F5F0 = func_800815D0;
L1_func_8007FAE8 = func_80081AC8;
L1_func_8007FCE0 = func_80081CC0;
L1_func_8007FF50 = func_80081F30;
L1_func_8007FF70 = func_80081F50;
L1_func_80080008 = func_80081FE8;
L1_func_800800A0 = func_80082080;
L1_func_800800BC = func_8008209C;
L1_func_8008013C = func_8008211C;
L1_func_80080154 = func_80082134;
L1_func_80080234 = func_80082214;
L1_func_80080464 = func_80082444;
L1_func_800806A0 = func_80082680;
L1_func_80080920 = func_80082900;
L1_func_80080944 = func_80082924;
L1_func_80080958 = func_80082938;
L1_func_80080998 = func_80082978;
L1_func_800809E0 = func_800829C0;
L1_func_80080A10 = func_800829F0;
L1_func_80080A34 = func_80082A14;
L1_func_80080CE4 = func_80082CC4;
L1_func_80080F44 = func_80082F24;
L1_func_80081094 = func_80083074;
L1_func_800811D0 = func_800831B0;
L1_func_80081204 = func_800831E4;
L1_func_80081348 = func_80083328;
L1_func_800813E8 = func_800833C8;
L1_func_80081410 = func_800833F0;
L1_func_80081448 = func_80083428;
L1_func_80081458 = func_80083438;
L1_func_800814CC = func_800834AC;
L1_func_800815A0 = func_80083580;
L1_func_80081A08 = func_800839E8;
L1_func_80081B74 = func_80083B54;
L1_func_80081C54 = func_80083C34;
L1_func_80081C84 = func_80083C64;
L1_func_80081CE4 = func_80083CC4;
L1_func_80081D14 = func_80083CF4;
L1_func_80082638 = func_80084618;
L1_func_800828AC = func_8008488C;
L1_func_8008297C = func_8008495C;
L1_func_80082B64 = func_80084B44;
L1_func_80082D00 = func_80084CE0;
L1_func_80082E04 = func_80084DE4;
L1_func_80082ED8 = func_80084EB8;
L1_func_80082EE8 = func_80084EC8;
L1_func_80082EF8 = func_80084ED8;
L1_func_80082F04 = func_80084EE4;
L1_func_80082F24 = func_80084F04;
L1_func_80082F44 = func_80084F24;
L1_func_80082F64 = func_80084F44;
L1_func_80082F78 = func_80084F58;
L1_func_80082F8C = func_80084F6C;
L1_func_800830C8 = func_800850A8;
L1_func_800831FC = func_800851DC;
L1_func_80083348 = func_80085328;
L1_func_80083368 = func_80085348;
L1_func_80083388 = func_80085368;
L1_func_800833AC = func_8008538C;
L1_func_800833CC = func_800853AC;
L1_func_800834D0 = func_800854B0;
L1_func_80083F14 = func_80085EF4;
L1_func_80084134 = func_80086114;
L1_func_80084164 = func_80086144;
L1_func_80084194 = func_80086174;
L1_func_800841C4 = func_800861A4;
L1_func_800841F8 = func_800861D8;
L1_func_80084228 = func_80086208;
L1_func_80084238 = func_80086218;
L1_func_80084250 = func_80086230;
L1_func_80084328 = func_80086308;
L1_func_800844F8 = func_800864D8;
L1_func_80084640 = func_80086620;
L1_func_800846E0 = func_800866C0;
L1_func_80084758 = func_80086738;
L1_func_80084E0C = func_80086DEC;
L1_func_800855BC = func_8008759C;
L1_func_8008571C = func_800876FC;
L1_func_8008596C = func_8008794C;
L1_func_800859B8 = func_80087998;
L1_func_80085B5C = func_80087B3C;
L1_func_80085BD0 = func_80087BB0;
L1_func_800865BC = func_8008859C;
L1_func_80086688 = func_80088668;
L1_func_80086780 = func_80088760;
L1_func_80086854 = func_80088834;
L1_func_8008688C = func_8008886C;
L1_func_800868D4 = func_800888B4;
L1_func_80086928 = func_80088908;
L1_func_80086A40 = func_80088A20;
L1_func_80086A6C = func_80088A4C;
L1_func_80086AD4 = func_80088AB4;
L1_func_80086C64 = func_80088C44;
L1_func_80086D30 = func_80088D10;
L1_func_80086D74 = func_80088D54;
L1_func_800870A8 = func_80089088;
L1_func_80087198 = func_80089178;
L1_func_800873A8 = func_80089388;
L1_func_80087620 = func_80089600;
L1_func_800876B0 = func_80089690;
L1_func_800876E4 = func_800896C4;
L1_func_80088C44 = func_8008AC24;
L1_func_8008A404 = func_8008C3E4;
L1_func_8008A904 = func_8008C8E4;
L1_func_8008C5A4 = func_8008E594;
L1_func_8008C5C4 = func_8008E5B4;
L1_func_8008C5D8 = func_8008E5C8;
L1_func_8008C638 = func_8008E628;
L1_func_8008CCB8 = func_8008EA18;
L1_func_8008D2EC = func_8008F04C;
L1_func_8008DAAC = func_8008F80C;
L1_func_8008DB68 = func_8008F8C8;
L1_func_8008DBDC = func_8008F93C;
L1_func_8008E03C = func_8009002C;
L1_func_8008E378 = func_80090368;
L1_func_8008FAE8 = func_80091AC8;
L1_func_80090004 = func_80091FE4;
L1_func_80090164 = func_80092144;
L1_func_80090880 = func_80092860;
L1_func_80090B00 = func_80092AE0;
L1_func_80090CC0 = func_80092CA0;
L1_func_80090D7C = func_80092D5C;
L1_func_80090FFC = func_80092FDC;
L1_func_80091080 = func_80093060;
L1_func_800910C4 = func_800930A4;
L1_func_80091168 = func_80093148;
L1_func_800911C0 = func_800931A0;
L1_func_800911E8 = func_800931C8;
L1_func_80091210 = func_800931F0;
L1_func_80091450 = func_80093430;
L1_func_80091480 = func_80093460;
L1_func_800919DC = func_800939BC;
L1_func_80091C5C = func_80093C3C;
L1_func_80091F24 = func_80093F04;
L1_func_80092330 = func_80094310;
L1_func_80092404 = func_800943E4;
L1_func_800924F4 = func_800944D4;
L1_func_800926D4 = func_800946B4;
L1_func_8009283C = func_8009481C;
L1_func_8009293C = func_8009491C;
L1_func_80092A34 = func_80094A14;
L1_func_80092F24 = func_80094F04;
L1_func_80092F5C = func_80094F3C;
L1_func_8009302C = func_8009500C;
L1_func_80093C64 = func_80095C44;
L1_func_80093E24 = func_80095E04;
L1_func_80093F24 = func_80095F04;
L1_func_80093F4C = func_80095F2C;
L1_func_80094434 = func_80096414;
L1_func_80094440 = func_80096420;
L1_func_800944C4 = func_800964A4;
L1_func_80094734 = func_80096714;
L1_func_8009476C = func_8009674C;
L1_func_80094840 = func_80096820;
L1_func_800948E8 = func_800968C8;
L1_func_80094CE0 = func_80096CC0;
L1_func_80094D48 = func_80096D28;
L1_func_80094D64 = func_80096D44;
L1_func_80094E2C = func_80096E0C;
L1_func_80094EC4 = func_80096EA4;
L1_func_80094F18 = func_80096EF8;
L1_func_80094F78 = func_80096F58;
L1_func_80094F98 = func_80096F78;
L1_func_80094FAC = func_80096F8C;
L1_func_80094FCC = func_80096FAC;
L1_func_80094FEC = func_80096FCC;
L1_func_8009500C = func_80096FEC;
L1_func_80095104 = func_800970E4;
L1_func_800957F0 = func_800977D0;
L1_func_80095914 = func_800978F4;
L1_func_80095934 = func_80097914;
L1_func_80095954 = func_80097934;
L1_func_80095A44 = func_80097A24;
L1_func_80095A64 = func_80097A44;
L1_func_80095D7C = func_80097D5C;
L1_func_80095ECC = func_80097EAC;
L1_func_80096270 = func_80098250;
L1_func_800963C4 = func_800983A4;
L1_func_80096738 = func_80098718;
L1_func_800967BC = func_8009879C;
L1_func_80096BC0 = func_80098BA0;
L1_func_80096C54 = func_80098C34;
L1_func_80096C9C = func_80098C7C;
L1_func_80096F50 = func_80098F30;
L1_func_80099EB0 = func_8009BE90;
L1_func_8009A0A0 = func_8009C080;
L1_func_8009A1F0 = func_8009C1D0;
L1_func_8009A3B0 = func_8009C390;
L1_func_8009A9E0 = func_8009C9C0;
L1_func_8009AB60 = func_8009CB40;
L1_func_8009B940 = func_8009D920;
L1_func_8009BEAC = func_8009DE8C;
L1_func_8009BF10 = func_8009DEF0;
L1_func_8009BFC0 = func_8009DFA0;
L1_func_800AACFC = func_800ADDC4;
L1_func_800AAEF8 = func_800ADFC0;
L1_gPsi = D_800B358C;
L1_g_Args = D_800B356C;
L1_g_CamPosX = D_800B361C;
L1_g_CamPosY = D_800B3620;
L1_g_CamRotX = D_800B35E4;
L1_g_CamTargetX = D_800B35D8;
L1_g_Camera = D_800B35D4;
L1_g_CheatCodeProgress = D_800B4558;
L1_g_CheatCodes = D_8009EC9C;
L1_g_CutScene = D_8009ECDC;
L1_g_DebugPageNames = D_8009EE30;
L1_g_DebugTextX = D_8009EFFC;
L1_g_DebugTextY = D_8009EFFE;
L1_g_DevMenu = D_800D6A64;
L1_g_FrameCap = D_800B44DC;
L1_g_FrameRate = D_8009ED8C;
L1_g_GodMode = D_8009ED1A;
L1_g_Invincible = D_8009EA68;
L1_g_MenuUpdateFunc = D_800D7E5C;
L1_g_PadAxes = D_800B489C;
L1_g_PadAxesPrev = D_800B48A0;
L1_g_PadHeld = D_800B4884;
L1_g_PadPressed = D_800B488C;
L1_g_PadPrev = D_800B4890;
L1_g_Player = D_800B4540;
L1_g_Projection = D_800B3680;
L1_g_Weapons = D_800B3694;
L1_gteMIMefunc = func_8008E474;
L1_gte_rotate_z_matrix = func_80095044;
L1_jtbl_800A6F68 = jtbl_800A9C48;
L1_jtbl_800A7168 = jtbl_800A9E48;
L1_jtbl_800A74B0 = jtbl_800AA190;
L1_jtbl_800A7764 = jtbl_800AA444;
L1_jtbl_800A7ED8 = jtbl_800AAC0C;
L1_jtbl_800A8028 = jtbl_800AAD5C;
L1_jtbl_800A8088 = jtbl_800AADBC;
L1_jtbl_800A859C = jtbl_800AB2D0;
L1_jtbl_800A8AC0 = jtbl_800AB844;
L1_jtbl_800A8BE8 = jtbl_800AB96C;
L1_jtbl_800A98E4 = jtbl_800AC994;
L1_jtbl_800A9AEC = jtbl_800ACBB0;
L1_jtbl_800A9DF8 = jtbl_800ACEBC;
L1_jtbl_800AA190 = jtbl_800AD254;
L1_jtbl_800AA1F0 = jtbl_800AD2B4;
L1_jtbl_800AA270 = jtbl_800AD334;
L1_jtbl_800AA2A8 = jtbl_800AD36C;
L1_jtbl_800AA330 = jtbl_800AD3F4;
L1_jtbl_800AA540 = jtbl_800AD604;
L1_jtbl_800AA560 = jtbl_800AD624;
L1_jtbl_800AA780 = jtbl_800AD844;
L1_jtbl_800AA860 = jtbl_800AD924;
L1_jtbl_800AA880 = jtbl_800AD944;
L1_malloc3 = func_8008D914;
L1_memchr = func_8008DBD4;
L1_memcpy = func_8008E464;
L1_memmove = func_800933B8;
L1_memset = func_8008E454;
L1_note2pitch = func_80091358;
L1_note2pitch2 = func_800913A4;
L1_printf = func_80080E7C;
L1_rand = func_80083A74;
L1_ratan2 = func_8008DFD4;
L1_rcos = func_8009C220;
L1_rsin = func_8009C2C0;
L1_setRC2wait = func_80097024;
L1_setjmp = func_80094C3C;
L1_sin_1 = func_8009C2FC;
L1_sprintf = func_80083D54;
L1_start = func_8002C8E4;
L1_startIntrDMA = func_80094C5C;
L1_startIntrVSync = func_80094AFC;
L1_strcat = func_80085EC0;
L1_strcmp = func_8008DC14;
L1_strcpy = func_80083C84;
L1_strlen = func_80083C54;
L1_strncmp = func_80094AEC;
L1_strncpy = func_800905D8;
L1_strstr = func_8008DD54;
L1_strtok = func_8008DC24;
L1_strtol = func_8008DD44;
L1_toupper = func_80083B44;
L1_vmNoiseOff = func_800924A0;
L1_vmNoiseOn = func_80090DE8;
L1_func_80026F30 = func_80026F30;
L1_func_80027248 = func_80027248;
L2_D_800A03C0 = D_8009E168;
L2_D_800A0425 = D_8009E1CD;
L2_D_800A0426 = D_8009E1CE;
L2_D_800A0438 = D_8009E1E0;
L2_D_800A0C92 = D_8009EA3A;
L2_D_800A0CC0 = D_8009EA68;
L2_D_800A0CC4 = D_8009EA6C;
L2_D_800A0CD4 = D_8009EA7C;
L2_D_800A0CDC = D_8009EA84;
L2_D_800A0CEC = D_8009EA94;
L2_D_800A0CF7 = D_8009EA9F;
L2_D_800A0EF4 = D_8009EC9C;
L2_D_800A0F34 = D_8009ECDC;
L2_D_800A0F88 = D_8009ED30;
L2_D_800A0F8C = D_8009ED34;
L2_D_800A0F9C = D_8009ED44;
L2_D_800A0FAB = D_8009ED53;
L2_D_800A0FD0 = D_8009ED78;
L2_D_800A0FE0 = D_8009ED88;
L2_D_800A0FE4 = D_8009ED8C;
L2_D_800A106C = D_8009EE14;
L2_D_800A11F0 = D_8009EF90;
L2_D_800A11FE = D_8009EF9E;
L2_D_800A1200 = D_8009EFA0;
L2_D_800A1204 = D_8009EFA4;
L2_D_800A1230 = D_8009EFD0;
L2_D_800A123C = D_8009EFDC;
L2_D_800A1240 = D_8009EFE0;
L2_D_800A1242 = D_8009EFE2;
L2_D_800A1244 = D_8009EFE4;
L2_D_800A1248 = D_8009EFE8;
L2_D_800A124C = D_8009EFEC;
L2_D_800A1254 = D_8009EFF4;
L2_D_800A1258 = D_8009EFF8;
L2_D_800A125A = D_8009EFFA;
L2_D_800A125C = D_8009EFFC;
L2_D_800A125E = D_8009EFFE;
L2_D_800A1268 = D_8009F008;
L2_D_800A1278 = D_8009F018;
L2_D_800A12CC = D_8009F06C;
L2_D_800A12D0 = D_8009F070;
L2_D_800A12D4 = D_8009F074;
L2_D_800A1344 = D_8009F0E4;
L2_D_800A1346 = D_8009F0E6;
L2_D_800A1366 = D_8009F106;
L2_D_800A14A8 = D_8009F250;
L2_D_800A1634 = D_8009F3EC;
L2_D_800A1640 = D_8009F3F8;
L2_D_800A167C = D_8009F434;
L2_D_800A19A0 = D_8009F6F8;
L2_D_800A1A1C = D_8009F774;
L2_D_800A1C74 = D_8009F9CC;
L2_D_800A1CC4 = D_8009FA1C;
L2_D_800A1EEC = D_8009FC44;
L2_D_800A3E74 = D_800A1584;
L2_D_800A3E8C = D_800A159C;
L2_D_800A40AC = D_800A17B4;
L2_D_800AC49C = D_800A9BA0;
L2_D_800AC4AC = D_800A9BB0;
L2_D_800AC4D4 = D_800A9BD8;
L2_D_800AC6FC = D_800A9E00;
L2_D_800AC80C = D_800A9F10;
L2_D_800AC820 = D_800A9F24;
L2_D_800ACB1C = D_800AA220;
L2_D_800ACB40 = D_800AA244;
L2_D_800ACB4C = D_800AA250;
L2_D_800ACB88 = D_800AA28C;
L2_D_800ACB9C = D_800AA2A0;
L2_D_800ACC18 = D_800AA31C;
L2_D_800ACC2C = D_800AA330;
L2_D_800ACC40 = D_800AA344;
L2_D_800ACC54 = D_800AA358;
L2_D_800ACC7C = D_800AA380;
L2_D_800ACC88 = D_800AA38C;
L2_D_800ACC9C = D_800AA3A0;
L2_D_800ACF24 = D_800AA628;
L2_D_800ACF38 = D_800AA63C;
L2_D_800ACF48 = D_800AA64C;
L2_D_800ACF5C = D_800AA660;
L2_D_800ACF70 = D_800AA674;
L2_D_800ACF94 = D_800AA698;
L2_D_800ACFCC = D_800AA6D0;
L2_D_800AD400 = D_800AAAF4;
L2_D_800AD428 = D_800AAB1C;
L2_D_800AD820 = D_800AAF14;
L2_D_800ADA08 = D_800AB0FC;
L2_D_800ADA50 = D_800AB144;
L2_D_800ADA58 = D_800AB14C;
L2_D_800ADC24 = D_800AB318;
L2_D_800ADD00 = D_800AB3F4;
L2_D_800ADE00 = D_800AB52C;
L2_D_800ADE10 = D_800AB53C;
L2_D_800ADE20 = D_800AB54C;
L2_D_800ADE6C = D_800AB598;
L2_D_800ADE80 = D_800AB5AC;
L2_D_800ADEB8 = D_800AB5E4;
L2_D_800AE5A4 = D_800ABCA4;
L2_D_800AF09C = D_800AC73C;
L2_D_800AF0A0 = D_800AC740;
L2_D_800AF140 = D_800AC7E0;
L2_D_800AF160 = D_800AC800;
L2_D_800AF188 = D_800AC828;
L2_D_800AF28C = D_800AC92C;
L2_D_800B0F58 = D_800AE608;
L2_D_800B0FF8 = D_800AE6A8;
L2_D_800B0FFC = D_800AE6AC;
L2_D_800B1018 = D_800AE6C8;
L2_D_800B102C = D_800AE6DC;
L2_D_800B117C = D_800AE80C;
L2_D_800B118C = D_800AE81C;
L2_D_800B1DC4 = D_800AF454;
L2_D_800B1F2C = D_800AF5A0;
L2_D_800B1F30 = D_800AF5A4;
L2_D_800B1FA0 = D_800AF614;
L2_D_800B4E3C = D_800B2398;
L2_D_800B4E6C = D_800B23C8;
L2_D_800B56B4 = D_800B2C10;
L2_D_800B5738 = D_800B2C94;
L2_D_800B5739 = D_800B2C95;
L2_D_800B5F3C = D_800B3498;
L2_D_800B5F49 = D_800B34A5;
L2_D_800B5F4A = D_800B34A6;
L2_D_800B5F4B = D_800B34A7;
L2_D_800B5F50 = D_800B34AC;
L2_D_800B5FB4 = D_800B3510;
L2_D_800B6010 = D_800B356C;
L2_D_800B6014 = D_800B3570;
L2_D_800B6030 = D_800B358C;
L2_D_800B6038 = D_800B3594;
L2_D_800B603C = D_800B3598;
L2_D_800B6054 = D_800B35B0;
L2_D_800B6058 = D_800B35B4;
L2_D_800B605C = D_800B35B8;
L2_D_800B6060 = D_800B35BC;
L2_D_800B6064 = D_800B35C0;
L2_D_800B60C0 = D_800B361C;
L2_D_800B6104 = D_800B3660;
L2_D_800B6120 = D_800B367C;
L2_D_800B6138 = D_800B3694;
L2_D_800B6A94 = D_800B3FF0;
L2_D_800B6C78 = D_800B41D4;
L2_D_800B6C8C = D_800B41E8;
L2_D_800B6C94 = D_800B41F0;
L2_D_800B6CA8 = D_800B4204;
L2_D_800B6D4C = D_800B42A8;
L2_D_800B6F80 = D_800B44DC;
L2_D_800B6F88 = D_800B44E4;
L2_D_800B6F8C = D_800B44E8;
L2_D_800B6FC4 = D_800B4520;
L2_D_800B6FE4 = D_800B4540;
L2_D_800B6FFC = D_800B4558;
L2_D_800B7084 = D_800B45E0;
L2_D_800B70F4 = D_800B4650;
L2_D_800B7114 = D_800B4670;
L2_D_800B7140 = D_800B469C;
L2_D_800B7170 = D_800B46CC;
L2_D_800B7284 = D_800B47E0;
L2_D_800B7288 = D_800B47E4;
L2_D_800B72A4 = D_800B4800;
L2_D_800B72B4 = D_800B4810;
L2_D_800B72B8 = D_800B4814;
L2_D_800B72C0 = D_800B481C;
L2_D_800B72C8 = D_800B4824;
L2_D_800B7318 = D_800B4874;
L2_D_800B7324 = D_800B4880;
L2_D_800B7328 = D_800B4884;
L2_D_800B7330 = D_800B488C;
L2_D_800B7334 = D_800B4890;
L2_D_800B7338 = D_800B4894;
L2_D_800B733C = D_800B4898;
L2_D_800B7340 = D_800B489C;
L2_D_800B7344 = D_800B48A0;
L2_D_800BF408 = D_800BC964;
L2_D_800BF46C = D_800BC9C8;
L2_D_800C625C = D_800C5694;
L2_D_800CD020 = D_800CE334;
L2_D_800D5318 = D_800D662C;
L2_D_800D55A0 = D_800D68B4;
L2_D_800D55A4 = D_800D68B8;
L2_D_800D55A8 = D_800D68BC;
L2_D_800D5670 = D_800D6984;
L2_D_800D58E0 = D_800D6BF4;
L2_D_800D6B48 = D_800D7E5C;
L2_D_800D6B70 = D_800D7E84;
L2_D_800D6BB8 = D_800D7EC0;
L2_D_800D6D20 = D_800D8024;
L2_D_800D6D54 = D_800D8058;
L2_D_800D6D6C = D_800D8070;
L2_D_800D6D84 = D_800D8088;
L2_D_800D6D9C = D_800D80A0;
L2_D_800D70B4 = D_800D83B8;
L2_D_800D8500 = D_800D9804;
L2_D_800D85DC = D_800D98E0;
L2_D_800D869C = D_800D99A0;
L2_D_800D8840 = D_800D9B44;
L2_D_800D9C5C = D_800DAF60;
L2_D_800D9F14 = D_800DB218;
L2_D_800D9FE4 = D_800DB2E8;
L2_D_800DA034 = D_800DB338;
L2_D_800DA084 = D_800DB388;
L2_D_800DA088 = D_800DB38C;
L2_D_800DA12C = D_800DB430;
L2_D_800DA20C = D_800DB510;
L2_D_800DA210 = D_800DB514;
L2_D_800DA264 = D_800DB568;
L2_D_800DA348 = D_800DB64C;
L2_D_800DA410 = D_800DB714;
L2_D_800DA414 = D_800DB718;
L2_D_800DA894 = D_800DBB98;
L2_D_800DA8AC = D_800DBBB0;
L2_D_800DAD80 = D_800DC084;
L2_D_800DADD0 = D_800DC0D4;
L2_D_800DAE20 = D_800DC124;
L2_D_800DAE24 = D_800DC128;
L2_D_800DAE44 = D_800DC148;
L2_D_800DB3D8 = D_800DC6DC;
L2_D_800DB814 = D_800DCA58;
L2_D_800DBA48 = D_800DCC44;
L2_D_800DBA6C = D_800DCC68;
L2_D_800DBA70 = D_800DCC6C;
L2_D_800DBA98 = D_800DCC94;
L2_D_800DCAE0 = D_800DDCD0;
L2_D_800DCD68 = D_800DDF58;
L2_D_800E0068 = D_800E2518;
L2_D_800E006C = D_800E251C;
L2_D_800E0070 = D_800E2520;
L2_D_800E0074 = D_800E2524;
L2_D_800E0078 = D_800E2528;
L2_D_800E007C = D_800E252C;
L2_D_800E0080 = D_800E2530;
L2_D_800E0084 = D_800E2534;
L2_D_800E0088 = D_800E2538;
L2_D_800E008C = D_800E253C;
L2_D_800E00E4 = D_800E2594;
L2_D_800E00E8 = D_800E2598;
L2_D_800E00EC = D_800E259C;
L2_D_800E01B0 = D_800E2660;
L2_D_800E01B4 = D_800E2664;
L2_D_800E01B8 = D_800E2668;
L2_D_800E01BC = D_800E266C;
L2_D_800E01C4 = D_800E2674;
L2_D_800E01C8 = D_800E2678;
L2_D_800E01D0 = D_800E2680;
L2_D_800E01D4 = D_800E2684;
L2_D_800E01D8 = D_800E2688;
L2_D_800E01DC = D_800E268C;
L2_D_800E0228 = D_800E26D8;
L2_D_800E022C = D_800E26DC;
L2_D_800E030C = D_800E27BC;
L2_D_800E0310 = D_800E27C0;
L2_D_800E04FC = D_800E29AC;
L2_D_800E0500 = D_800E29B0;
L2_D_800E0504 = D_800E29B4;
L2_D_800E1510 = D_800E39CC;
L2_D_800E1514 = D_800E39D0;
L2_D_800E1554 = D_800E3A10;
L2_D_800E1628 = D_800E3AE4;
L2_D_800E6694 = D_800E7934;
L2_D_800E680C = D_800E7AAC;
L2_D_800E6810 = D_800E7AB0;
L2_D_800F4010 = D_800F62B0;
L2_D_800F430C = D_800F6540;
L2_D_800F4458 = D_800F668C;
L2_D_800F44DC = D_800F6710;
L2_D_80100D94 = D_80102FC8;
L2_func_8002680C = func_8002680C;
func_800268CC = L2_func_800268CC;
L2_func_80026B00 = func_80026B00;
func_80026C38 = L2_func_80026C38;
L2_func_80026F5C = func_80026F30;
L2_func_80027274 = func_80027248;
func_800274F4 = L2_func_80027520;
func_800287C8 = L2_func_800288B4;
L2_func_800288F4 = func_80028808;
L2_func_800289D8 = func_800288EC;
L2_func_80028B20 = func_80028A34;
func_80028A9C = L2_func_80028B88;
func_80029114 = L2_func_80029200;
L2_func_80029378 = func_8002928C;
L2_func_80029A30 = func_80029944;
L2_func_8002A7E4 = func_8002A6F8;
L2_func_8002A8E8 = func_8002A7FC;
func_8002ABA0 = L2_func_8002AC8C;
func_8002AECC = L2_func_8002AFB8;
func_8002AFE4 = L2_func_8002B0D0;
func_8002B140 = L2_func_8002B22C;
L2_func_8002B464 = func_8002B378;
func_8002BC10 = L2_func_8002BCFC;
func_8002BEC0 = L2_func_8002BFAC;
L2_func_8002C330 = func_8002C244;
func_8002C3B4 = L2_func_8002C4A0;
func_8002C740 = L2_func_8002C82C;
L2_func_8002D39C = func_8002D2B0;
func_8002E16C = L2_func_8002E24C;
func_8002E1C4 = L2_func_8002E2A4;
func_8002E21C = L2_func_8002E2FC;
func_8002E2AC = L2_func_8002E38C;
func_8002E368 = L2_func_8002E440;
func_8002E430 = L2_func_8002E508;
func_8002E4C0 = L2_func_8002E598;
func_8002E51C = L2_func_8002E5F4;
func_8002E5C4 = L2_func_8002E69C;
func_8002F170 = L2_func_8002F214;
func_8002F288 = L2_func_8002F32C;
func_8002F2C0 = L2_func_8002F364;
func_8002F540 = L2_func_8002F5E4;
func_8002F608 = L2_func_8002F6AC;
L2_func_8002F6D4 = func_8002F630;
L2_func_8002F814 = func_8002F770;
func_8002FEB0 = L2_func_8002FF60;
func_800303B0 = L2_func_80030454;
func_80030400 = L2_func_800304A4;
L2_func_80030504 = func_80030460;
L2_func_80030704 = func_80030660;
L2_func_800307C0 = func_8003071C;
func_8003079C = L2_func_80030840;
func_80030914 = L2_func_800309B8;
func_80030F5C = L2_func_80031000;
func_80031DC4 = L2_func_80031E68;
L2_func_80031F34 = func_80031E90;
func_80032444 = L2_func_800324E8;
L2_func_80032684 = func_800325E0;
func_80032768 = L2_func_8003280C;
L2_func_8003292C = func_80032888;
L2_func_80033254 = func_800331B0;
func_8003343C = L2_func_800334E0;
L2_func_80035C7C = func_80035BE4;
L2_func_800368C8 = func_80036830;
func_800371D4 = L2_func_8003726C;
func_80037C40 = L2_func_80037CD8;
L2_func_8003815C = func_800380C4;
L2_func_8003838C = func_800382F4;
func_8003843C = L2_func_800384D4;
L2_func_800387C4 = func_8003872C;
func_80038898 = L2_func_80038930;
func_80038CC4 = L2_func_80038D5C;
func_8003913C = L2_func_800391D4;
func_80039394 = L2_func_800393F8;
func_800396E8 = L2_func_8003974C;
func_80039708 = L2_func_8003976C;
func_800397BC = L2_func_800398F0;
L2_func_80039920 = func_800397EC;
func_8003990C = L2_func_80039A40;
func_80039AAC = L2_func_80039C5C;
func_80039F60 = L2_func_8003A110;
func_8003A214 = L2_func_8003A3C4;
L2_func_8003A3FC = func_8003A24C;
func_8003A388 = L2_func_8003A538;
func_8003A450 = L2_func_8003A600;
L2_func_8003AA8C = func_8003A8DC;
func_8003B55C = L2_func_8003B70C;
L2_func_8003BC0C = func_8003BA5C;
L2_func_8003D7E4 = func_8003D654;
func_8003D7FC = L2_func_8003D98C;
func_800409A0 = L2_func_80040B30;
func_80041800 = L2_func_80041990;
func_80041EC8 = L2_func_80042058;
func_80042038 = L2_func_800421C8;
func_80042558 = L2_func_800426E8;
func_8004261C = L2_func_800427AC;
func_800436E4 = L2_func_80043874;
L2_func_80043908 = func_80043778;
L2_func_80043AFC = func_8004396C;
func_80043A84 = L2_func_80043C14;
L2_func_80043C4C = func_80043ABC;
L2_func_80043E58 = func_80043CC8;
func_80045494 = L2_func_80045624;
func_80045598 = L2_func_80045728;
func_80045630 = L2_func_800457C0;
func_80045738 = L2_func_800458C8;
func_80045CF8 = L2_func_80045E88;
L2_func_80046098 = func_80045F08;
func_80045FE4 = L2_func_80046174;
func_8004613C = L2_func_800462CC;
func_800464A8 = L2_func_80046638;
func_80046548 = L2_func_800466D8;
L2_func_800481FC = func_8004806C;
L2_func_8004857C = func_800483EC;
func_800483FC = L2_func_8004858C;
func_80048488 = L2_func_80048618;
func_80048934 = L2_func_80048AC4;
L2_func_80048B04 = func_80048974;
func_8004897C = L2_func_80048B0C;
func_80048AE4 = L2_func_80048C74;
L2_func_80048F5C = func_80048DCC;
L2_func_800497E4 = func_80049768;
func_80049C04 = L2_func_80049C80;
L2_func_80049EB8 = func_80049E3C;
L2_func_8004A9F8 = func_8004A97C;
func_8004AEB8 = L2_func_8004AF34;
func_8004AEFC = L2_func_8004AF78;
func_8004AF20 = L2_func_8004AF9C;
func_8004AF54 = L2_func_8004AFD0;
func_8004AF8C = L2_func_8004B008;
func_8004AF9C = L2_func_8004B018;
func_8004B3F0 = L2_func_8004B46C;
func_8004B430 = L2_func_8004B4AC;
func_8004B47C = L2_func_8004B4F8;
func_8004BBFC = L2_func_8004BC78;
func_8004BC30 = L2_func_8004BCAC;
func_8004BC40 = L2_func_8004BCBC;
func_8004BC58 = L2_func_8004BCD4;
L2_func_8004BDD8 = func_8004BD5C;
L2_func_8004BE84 = func_8004BE08;
func_8004BE44 = L2_func_8004BEC0;
func_8004C0C0 = L2_func_8004C13C;
func_8004C4B4 = L2_func_8004C530;
L2_func_8004C604 = func_8004C588;
func_8004CB70 = L2_func_8004CBF4;
func_8004CC40 = L2_func_8004CCC4;
func_8004CE34 = L2_func_8004CEB8;
func_8004D0F0 = L2_func_8004D174;
func_8004D408 = L2_func_8004D48C;
L2_func_8004DC58 = func_8004DBD4;
func_8004DF58 = L2_func_8004DFDC;
func_8004E040 = L2_func_8004E0C4;
func_8004E12C = L2_func_8004E1B0;
func_8004E27C = L2_func_8004E300;
func_8004E808 = L2_func_8004E88C;
func_8004EA64 = L2_func_8004EAE8;
L2_func_8004EDDC = func_8004ED58;
func_8004F134 = L2_func_8004F24C;
L2_func_8004F288 = func_8004F170;
L2_func_8004F314 = func_8004F1FC;
func_8004F8A4 = L2_func_8004F9BC;
L2_func_800501B0 = func_80050098;
func_80050678 = L2_func_80050790;
L2_func_80050AA4 = func_8005098C;
func_80050C60 = L2_func_80050D78;
func_8005132C = L2_func_80051444;
func_80054D3C = L2_func_80054E54;
func_80055070 = L2_func_80055188;
func_80055580 = L2_func_80055698;
func_80055620 = L2_func_80055738;
L2_func_8005590C = func_8005595C;
func_80055988 = L2_func_80055938;
func_80055A70 = L2_func_80055A20;
func_80055CDC = L2_func_80055C8C;
func_80055FC8 = L2_func_80055F78;
func_80056174 = L2_func_800560EC;
func_800585E4 = L2_func_80058570;
func_80059810 = L2_func_8005979C;
func_80059B08 = L2_func_80059A94;
func_80059BBC = L2_func_80059B48;
func_80059C78 = L2_func_80059C04;
func_80059CE0 = L2_func_80059C6C;
L2_func_80059EF0 = func_80059F64;
L2_func_8005AE6C = func_8005AEE0;
func_8005AF24 = L2_func_8005AEB0;
L2_func_8005BA6C = func_8005BAE0;
L2_func_8005C964 = func_8005C9D8;
L2_func_8005C994 = func_8005CA08;
L2_func_8005C9C4 = func_8005CA38;
L2_func_8005CB20 = func_8005CB94;
func_8005CC6C = L2_func_8005CBF8;
func_8005CFAC = L2_func_8005CF80;
func_8005D5F8 = L2_func_8005D5CC;
L2_func_8005D670 = func_8005D69C;
L2_func_8005D6D4 = func_8005D700;
func_8005DAFC = L2_func_8005DAD0;
func_8005DFAC = L2_func_8005DF80;
func_8005ED20 = L2_func_8005ECF4;
func_8005EDF4 = L2_func_8005EDC8;
L2_func_8005EF48 = func_8005EF74;
L2_func_8005F374 = func_8005F3A0;
func_8005F778 = L2_func_8005F74C;
L2_func_8005F8AC = func_8005F8D8;
L2_func_8005FBBC = func_8005FBE8;
func_8005FEF0 = L2_func_8005FEC4;
L2_func_80060594 = func_800604DC;
func_800605B4 = L2_func_8006066C;
L2_func_800606F8 = func_80060640;
L2_func_800609C8 = func_80060910;
func_80060B88 = L2_func_80060C40;
func_80060E0C = L2_func_80060EC4;
func_80060E28 = L2_func_80060EE0;
L2_func_8006114C = func_80061060;
L2_func_800616AC = func_800615C0;
L2_func_800617EC = func_80061700;
func_800617A4 = L2_func_80061890;
L2_func_80061A24 = func_80061920;
L2_func_80061CE8 = func_80061BE4;
func_80061D18 = L2_func_80061E1C;
func_80061E60 = L2_func_80061F64;
L2_func_800622F4 = func_800621E4;
L2_func_80063630 = func_80063520;
func_800636C0 = L2_func_800637D0;
func_80063944 = L2_func_80063A54;
L2_func_80063A98 = func_80063988;
func_80063D3C = L2_func_80063E4C;
L2_func_80063EFC = func_80063DEC;
func_80064D84 = L2_func_80064C38;
func_80065070 = L2_func_80064F24;
L2_func_80064FB0 = func_800650FC;
func_8006539C = L2_func_80065250;
func_80066548 = L2_func_800663FC;
func_8006987C = L2_func_80069DD8;
L2_func_8006B2F0 = func_8006AAAC;
func_8006BDD0 = L2_func_8006E97C;
func_8006BE24 = L2_func_8006E9D0;
L2_func_80072648 = func_8006FA9C;
L2_func_800727D4 = func_8006FC28;
func_800759DC = L2_func_80078588;
func_80075A2C = L2_func_800785D8;
func_80075F98 = L2_func_80078B44;
func_80075FE4 = L2_func_80078B90;
func_80076494 = L2_func_80079040;
func_800764C0 = L2_func_8007906C;
func_80076B00 = L2_func_800796AC;
func_80076B94 = L2_func_80079740;
func_80076BD8 = L2_func_80079784;
func_80076CA8 = L2_func_80079854;
func_80076FDC = L2_func_80079B2C;
func_800773CC = L2_func_80079F1C;
func_80077640 = L2_func_8007A190;
func_80077750 = L2_func_8007A2A0;
func_80077804 = L2_func_8007A354;
L2_func_8007A4D4 = func_80077984;
func_80077B28 = L2_func_8007A678;
L2_func_8007D6E0 = func_8007B4C0;
L2_func_8007E33C = func_8007C174;
L2_func_8007E370 = func_8007C1A8;
L2_func_8007F098 = func_8007CED0;
L2_func_8007F210 = func_8007D048;
L2_func_8007F36C = func_8007D1A4;
L2_func_8007F520 = func_8007D358;
L2_func_8007FF68 = func_8007DDA0;
L2_func_800800D4 = func_8007DF0C;
L2_func_80080238 = func_8007E070;
L2_func_800803A8 = func_8007E1E0;
L2_func_80080518 = func_8007E350;
L2_func_80080660 = func_8007E498;
L2_func_800807A0 = func_8007E5D8;
L2_func_80080930 = func_8007E768;
L2_func_80080AC8 = func_8007E900;
L2_func_80080C04 = func_8007EA3C;
L2_func_80080D44 = func_8007EB7C;
L2_func_80080E8C = func_8007ECC4;
L2_func_80081390 = func_8007F1C8;
L2_func_80083044 = func_80080E7C;
L2_func_80083064 = func_80080E9C;
L2_func_80083074 = func_80080EAC;
L2_func_80083280 = func_800810B8;
L2_func_80083494 = func_800812CC;
L2_func_800855E0 = func_80083418;
L2_func_800855F0 = func_80083428;
L2_func_80085600 = func_80083438;
L2_func_80085C3C = func_80083A74;
L2_func_80085D5C = func_80083B94;
L2_func_80085E1C = func_80083C54;
L2_func_80085E4C = func_80083C84;
L2_func_80085E7C = func_80083CB4;
L2_func_80085E8C = func_80083CC4;
L2_func_80085EDC = func_80083D14;
L2_func_80085F1C = func_80083D54;
L2_func_80086EA8 = func_80084CE0;
L2_func_80086FAC = func_80084DE4;
L2_func_800870CC = func_80084F04;
L2_func_80087120 = func_80084F58;
L2_func_80087134 = func_80084F6C;
L2_func_800873A4 = func_800851DC;
L2_func_80087574 = func_800853AC;
L2_func_80089774 = func_800875AC;
L2_func_80089AF4 = func_8008792C;
L2_func_80089BB4 = func_800879EC;
L2_func_80089D04 = func_80087B3C;
L2_func_80089D64 = func_80087B9C;
L2_func_80089D94 = func_80087BCC;
L2_func_8008A0C4 = func_80087EFC;
L2_func_8008A724 = func_8008855C;
L2_func_8008AAD0 = func_80088908;
L2_func_8008C0C0 = func_80089EF8;
L2_func_8008C48C = func_8008A2C4;
L2_func_8008C6CC = func_8008A504;
L2_func_8008C90C = func_8008A744;
L2_func_8008CBBC = func_8008A9F4;
L2_func_8008CE0C = func_8008AC44;
L2_func_8008D02C = func_8008AE64;
L2_func_8008D33C = func_8008B174;
L2_func_8008D66C = func_8008B4A4;
L2_func_8008D92C = func_8008B764;
L2_func_8008DB6C = func_8008B9A4;
L2_func_8008DCEC = func_8008BB24;
L2_func_8008DF2C = func_8008BD64;
L2_func_8008E09C = func_8008BED4;
L2_func_8008E28C = func_8008C0C4;
L2_func_8008E5CC = func_8008C404;
L2_func_8008E7EC = func_8008C624;
L2_func_8008EAFC = func_8008C934;
L2_func_8008ECEC = func_8008CB24;
L2_func_8008EEEC = func_8008CD24;
L2_func_8008F21C = func_8008D054;
L2_func_8008F49C = func_8008D2D4;
L2_func_8008F74C = func_8008D584;
L2_func_8008FCDC = func_8008DB14;
L2_func_8008FDAC = func_8008DBE4;
L2_func_8008FF2C = func_8008DD64;
L2_func_8008FFCC = func_8008DE04;
L2_func_8009003C = func_8008DE74;
L2_func_800900AC = func_8008DEE4;
L2_func_800912A4 = func_8008F04C;
D_1F8003D4 = 0x1F8003D4;
D_1F8003D8 = 0x1F8003D8;
D_1F8003DC = 0x1F8003DC;
L1_D_800AB540_b = L1_D_800AB540;
L1_D_800AB540_c = L1_D_800AB540;
L1_D_8009CE24 = L1_D_8009CE20 + 4;
